VERSION "created by canmatrix"

NS_ :

BS_:

BU_: ARC ADC

BO_ 1380 ARC_OD_38_39_FR: 64 ARC
 SG_ DistHeight_Obj_39_FR : 487|8@0+ (0.2,-10) [-10|41] "m"  ADC
 SG_ DistHeight_Obj_38_FR : 479|8@0+ (0.2,-10) [-10|41] "m"  ADC
 SG_ ARC_OD_DistX_Obj_38_FR : 7|12@0+ (0.1,-152) [-152|257.5] "m"  ADC
 SG_ ARC_OD_Classification_Obj_38_FR : 98|3@0+ (1,0) [0|7] ""  ADC
 SG_ ARC_OD_AabsYStd_Obj_38_FR : 111|8@0+ (0.25,0) [0|63.75] "m/s^2"  ADC
 SG_ ARC_OD_ClassConf_Obj_38_FR : 119|7@0+ (1,0) [0|127] "%"  ADC
 SG_ ARC_OD_ProbOfExist_Obj_38_FR : 112|7@0+ (1,0) [0|127] "%"  ADC
 SG_ ARC_OD_VabsX_Obj_38_FR : 11|11@0+ (0.125,-128) [-128|127.875] "m/s"  ADC
 SG_ ARC_OD_DynProp_Obj_38_FR : 130|3@0+ (1,0) [0|7] ""  ADC
 SG_ ARC_OD_Length_Obj_38_FR : 136|7@0+ (0.2,0) [0|25.4] "m"  ADC
 SG_ ARC_OD_MaintenanceState_Obj_0021 : 145|2@0+ (1,0) [0|3] ""  ADC
 SG_ ARC_OD_Width_Obj_38_FR : 159|7@0+ (0.2,0) [0|25.4] "m"  ADC
 SG_ ARC_OD_RCS_Obj_38_FR : 152|9@0+ (0.2,-51.1) [-51.1|51.1] "dBsm"  ADC
 SG_ ARC_OD_Orientation_Obj_38_FR : 175|10@0+ (0.01,-5.11) [-5.11|5.12] "rad"  ADC
 SG_ ARC_OD_LifeCycle_Obj_38_FR : 207|16@0+ (1,0) [0|65535] ""  ADC
 SG_ ARC_OD_DistX_Obj_39_FR : 223|12@0+ (0.1,-152) [-152|257.5] "m"  ADC
 SG_ ARC_OD_VabsX_Obj_39_FR : 227|11@0+ (0.125,-128) [-128|127.875] "m/s"  ADC
 SG_ ARC_OD_AabsX_Obj_39_FR : 232|9@0+ (0.125,-31.875) [-31.875|32] "m/s^2"  ADC
 SG_ ARC_OD_AabsX_Obj_38_FR : 16|9@0+ (0.125,-31.875) [-31.875|32] "m/s^2"  ADC
 SG_ ARC_OD_DistY_Obj_39_FR : 255|12@0+ (0.0875,-179.113) [-179.113|179.2] "m"  ADC
 SG_ ARC_OD_VabsY_Obj_39_FR : 259|11@0+ (0.125,-128) [-128|127.875] "m/s"  ADC
 SG_ ARC_OD_AabsY_Obj_39_FR : 264|9@0+ (0.125,-31.875) [-31.875|32] "m/s^2"  ADC
 SG_ ARC_OD_DistXStd_Obj_39_FR : 287|8@0+ (0.05,0) [0|12.75] "m"  ADC
 SG_ ARC_OD_DistYStd_Obj_39_FR : 295|8@0+ (0.1,0) [0|25.5] "m"  ADC
 SG_ ARC_OD_VabsXStd_Obj_39_FR : 303|7@0+ (0.1,0) [0|12.7] "m/s"  ADC
 SG_ ARC_OD_VabsYStd_Obj_39_FR : 296|7@0+ (0.2,0) [0|25.4] "m/s"  ADC
 SG_ ARC_OD_AabsXStd_Obj_39_FR : 305|7@0+ (0.25,0) [0|31.75] "m/s^2"  ADC
 SG_ ARC_OD_Classification_Obj_39_FR : 314|3@0+ (1,0) [0|7] ""  ADC
 SG_ ARC_OD_AabsYStd_Obj_39_FR : 327|8@0+ (0.25,0) [0|63.75] "m/s^2"  ADC
 SG_ ARC_OD_ClassConf_Obj_39_FR : 335|7@0+ (1,0) [0|127] "%"  ADC
 SG_ ARC_OD_DistY_Obj_38_FR : 39|12@0+ (0.0875,-179.113) [-179.113|179.2] "m"  ADC
 SG_ ARC_OD_ProbOfExist_Obj_39_FR : 328|7@0+ (1,0) [0|127] "%"  ADC
 SG_ ARC_OD_DynProp_Obj_39_FR : 346|3@0+ (1,0) [0|7] ""  ADC
 SG_ ARC_OD_Length_Obj_39_FR : 352|7@0+ (0.2,0) [0|25.4] "m"  ADC
 SG_ ARC_OD_MaintenanceState_Obj_0022 : 361|2@0+ (1,0) [0|3] ""  ADC
 SG_ ARC_OD_Width_Obj_39_FR : 375|7@0+ (0.2,0) [0|25.4] "m"  ADC
 SG_ ARC_OD_RCS_Obj_39_FR : 368|9@0+ (0.2,-51.1) [-51.1|51.1] "dBsm"  ADC
 SG_ ARC_OD_Orientation_Obj_39_FR : 391|10@0+ (0.01,-5.11) [-5.11|5.12] "rad"  ADC
 SG_ ARC_OD_LifeCycle_Obj_39_FR : 423|16@0+ (1,0) [0|65535] ""  ADC
 SG_ ARC_OD_ObstacleProb_Obj_38_FR : 447|7@0+ (1,0) [0|127] "%"  ADC
 SG_ ARC_OD_ObstacleProb_Obj_39_FR : 455|7@0+ (1,0) [0|127] "%"  ADC
 SG_ ARC_OD_VabsY_Obj_38_FR : 43|11@0+ (0.125,-128) [-128|127.875] "m/s"  ADC
 SG_ ARC_OD_ID_38_FR : 463|8@0+ (1,0) [0|255] ""  ADC
 SG_ ARC_OD_ID_39_FR : 471|8@0+ (1,0) [0|255] ""  ADC
 SG_ ARC_OD_MsgCounter_Obj_38_39_FR : 491|4@0+ (1,0) [0|15] ""  ADC
 SG_ ARC_OD_CRC8_Obj_38_39_FR : 511|8@0+ (1,0) [0|256] ""  ADC
 SG_ ARC_OD_AabsY_Obj_38_FR : 48|9@0+ (0.125,-31.875) [-31.875|32] "m/s^2"  ADC
 SG_ ARC_OD_DistXStd_Obj_38_FR : 71|8@0+ (0.05,0) [0|12.75] "m"  ADC
 SG_ ARC_OD_DistYStd_Obj_38_FR : 79|8@0+ (0.1,0) [0|25.5] "m"  ADC
 SG_ ARC_OD_VabsXStd_Obj_38_FR : 87|7@0+ (0.1,0) [0|12.7] "m/s"  ADC
 SG_ ARC_OD_VabsYStd_Obj_38_FR : 80|7@0+ (0.2,0) [0|25.4] "m/s"  ADC
 SG_ ARC_OD_AabsXStd_Obj_38_FR : 89|7@0+ (0.25,0) [0|31.75] "m/s^2"  ADC

BO_ 1379 ARC_OD_36_37_FR: 64 ARC
 SG_ DistHeight_Obj_37_FR : 487|8@0+ (0.2,-10) [-10|41] "m"  ADC
 SG_ DistHeight_Obj_36_FR : 479|8@0+ (0.2,-10) [-10|41] "m"  ADC
 SG_ ARC_OD_DistX_Obj_36_FR : 7|12@0+ (0.1,-152) [-152|257.5] "m"  ADC
 SG_ ARC_OD_Classification_Obj_36_FR : 98|3@0+ (1,0) [0|7] ""  ADC
 SG_ ARC_OD_AabsYStd_Obj_36_FR : 111|8@0+ (0.25,0) [0|63.75] "m/s^2"  ADC
 SG_ ARC_OD_ClassConf_Obj_36_FR : 119|7@0+ (1,0) [0|127] "%"  ADC
 SG_ ARC_OD_ProbOfExist_Obj_36_FR : 112|7@0+ (1,0) [0|127] "%"  ADC
 SG_ ARC_OD_VabsX_Obj_36_FR : 11|11@0+ (0.125,-128) [-128|127.875] "m/s"  ADC
 SG_ ARC_OD_DynProp_Obj_36_FR : 130|3@0+ (1,0) [0|7] ""  ADC
 SG_ ARC_OD_Length_Obj_36_FR : 136|7@0+ (0.2,0) [0|25.4] "m"  ADC
 SG_ ARC_OD_MaintenanceState_Obj_0023 : 145|2@0+ (1,0) [0|3] ""  ADC
 SG_ ARC_OD_Width_Obj_36_FR : 159|7@0+ (0.2,0) [0|25.4] "m"  ADC
 SG_ ARC_OD_RCS_Obj_36_FR : 152|9@0+ (0.2,-51.1) [-51.1|51.1] "dBsm"  ADC
 SG_ ARC_OD_Orientation_Obj_36_FR : 175|10@0+ (0.01,-5.11) [-5.11|5.12] "rad"  ADC
 SG_ ARC_OD_LifeCycle_Obj_36_FR : 207|16@0+ (1,0) [0|65535] ""  ADC
 SG_ ARC_OD_DistX_Obj_37_FR : 223|12@0+ (0.1,-152) [-152|257.5] "m"  ADC
 SG_ ARC_OD_VabsX_Obj_37_FR : 227|11@0+ (0.125,-128) [-128|127.875] "m/s"  ADC
 SG_ ARC_OD_AabsX_Obj_37_FR : 232|9@0+ (0.125,-31.875) [-31.875|32] "m/s^2"  ADC
 SG_ ARC_OD_AabsX_Obj_36_FR : 16|9@0+ (0.125,-31.875) [-31.875|32] "m/s^2"  ADC
 SG_ ARC_OD_DistY_Obj_37_FR : 255|12@0+ (0.0875,-179.113) [-179.113|179.2] "m"  ADC
 SG_ ARC_OD_VabsY_Obj_37_FR : 259|11@0+ (0.125,-128) [-128|127.875] "m/s"  ADC
 SG_ ARC_OD_AabsY_Obj_37_FR : 264|9@0+ (0.125,-31.875) [-31.875|32] "m/s^2"  ADC
 SG_ ARC_OD_DistXStd_Obj_37_FR : 287|8@0+ (0.05,0) [0|12.75] "m"  ADC
 SG_ ARC_OD_DistYStd_Obj_37_FR : 295|8@0+ (0.1,0) [0|25.5] "m"  ADC
 SG_ ARC_OD_VabsXStd_Obj_37_FR : 303|7@0+ (0.1,0) [0|12.7] "m/s"  ADC
 SG_ ARC_OD_VabsYStd_Obj_37_FR : 296|7@0+ (0.2,0) [0|25.4] "m/s"  ADC
 SG_ ARC_OD_AabsXStd_Obj_37_FR : 305|7@0+ (0.25,0) [0|31.75] "m/s^2"  ADC
 SG_ ARC_OD_Classification_Obj_37_FR : 314|3@0+ (1,0) [0|7] ""  ADC
 SG_ ARC_OD_AabsYStd_Obj_37_FR : 327|8@0+ (0.25,0) [0|63.75] "m/s^2"  ADC
 SG_ ARC_OD_ClassConf_Obj_37_FR : 335|7@0+ (1,0) [0|127] "%"  ADC
 SG_ ARC_OD_DistY_Obj_36_FR : 39|12@0+ (0.0875,-179.113) [-179.113|179.2] "m"  ADC
 SG_ ARC_OD_ProbOfExist_Obj_37_FR : 328|7@0+ (1,0) [0|127] "%"  ADC
 SG_ ARC_OD_DynProp_Obj_37_FR : 346|3@0+ (1,0) [0|7] ""  ADC
 SG_ ARC_OD_Length_Obj_37_FR : 352|7@0+ (0.2,0) [0|25.4] "m"  ADC
 SG_ ARC_OD_MaintenanceState_Obj_0024 : 361|2@0+ (1,0) [0|3] ""  ADC
 SG_ ARC_OD_Width_Obj_37_FR : 375|7@0+ (0.2,0) [0|25.4] "m"  ADC
 SG_ ARC_OD_RCS_Obj_37_FR : 368|9@0+ (0.2,-51.1) [-51.1|51.1] "dBsm"  ADC
 SG_ ARC_OD_Orientation_Obj_37_FR : 391|10@0+ (0.01,-5.11) [-5.11|5.12] "rad"  ADC
 SG_ ARC_OD_LifeCycle_Obj_37_FR : 423|16@0+ (1,0) [0|65535] ""  ADC
 SG_ ARC_OD_ObstacleProb_Obj_36_FR : 447|7@0+ (1,0) [0|127] "%"  ADC
 SG_ ARC_OD_ObstacleProb_Obj_37_FR : 455|7@0+ (1,0) [0|127] "%"  ADC
 SG_ ARC_OD_VabsY_Obj_36_FR : 43|11@0+ (0.125,-128) [-128|127.875] "m/s"  ADC
 SG_ ARC_OD_ID_36_FR : 463|8@0+ (1,0) [0|255] ""  ADC
 SG_ ARC_OD_ID_37_FR : 471|8@0+ (1,0) [0|255] ""  ADC
 SG_ ARC_OD_MsgCounter_Obj_36_37_FR : 491|4@0+ (1,0) [0|15] ""  ADC
 SG_ ARC_OD_CRC8_Obj_36_37_FR : 511|8@0+ (1,0) [0|256] ""  ADC
 SG_ ARC_OD_AabsY_Obj_36_FR : 48|9@0+ (0.125,-31.875) [-31.875|32] "m/s^2"  ADC
 SG_ ARC_OD_DistXStd_Obj_36_FR : 71|8@0+ (0.05,0) [0|12.75] "m"  ADC
 SG_ ARC_OD_DistYStd_Obj_36_FR : 79|8@0+ (0.1,0) [0|25.5] "m"  ADC
 SG_ ARC_OD_VabsXStd_Obj_36_FR : 87|7@0+ (0.1,0) [0|12.7] "m/s"  ADC
 SG_ ARC_OD_VabsYStd_Obj_36_FR : 80|7@0+ (0.2,0) [0|25.4] "m/s"  ADC
 SG_ ARC_OD_AabsXStd_Obj_36_FR : 89|7@0+ (0.25,0) [0|31.75] "m/s^2"  ADC

BO_ 1378 ARC_OD_34_35_FR: 64 ARC
 SG_ DistHeight_Obj_35_FR : 487|8@0+ (0.2,-10) [-10|41] "m"  ADC
 SG_ DistHeight_Obj_34_FR : 479|8@0+ (0.2,-10) [-10|41] "m"  ADC
 SG_ ARC_OD_DistX_Obj_34_FR : 7|12@0+ (0.1,-152) [-152|257.5] "m"  ADC
 SG_ ARC_OD_Classification_Obj_34_FR : 98|3@0+ (1,0) [0|7] ""  ADC
 SG_ ARC_OD_AabsYStd_Obj_34_FR : 111|8@0+ (0.25,0) [0|63.75] "m/s^2"  ADC
 SG_ ARC_OD_ClassConf_Obj_34_FR : 119|7@0+ (1,0) [0|127] "%"  ADC
 SG_ ARC_OD_ProbOfExist_Obj_34_FR : 112|7@0+ (1,0) [0|127] "%"  ADC
 SG_ ARC_OD_VabsX_Obj_34_FR : 11|11@0+ (0.125,-128) [-128|127.875] "m/s"  ADC
 SG_ ARC_OD_DynProp_Obj_34_FR : 130|3@0+ (1,0) [0|7] ""  ADC
 SG_ ARC_OD_Length_Obj_34_FR : 136|7@0+ (0.2,0) [0|25.4] "m"  ADC
 SG_ ARC_OD_MaintenanceState_Obj_0025 : 145|2@0+ (1,0) [0|3] ""  ADC
 SG_ ARC_OD_Width_Obj_34_FR : 159|7@0+ (0.2,0) [0|25.4] "m"  ADC
 SG_ ARC_OD_RCS_Obj_34_FR : 152|9@0+ (0.2,-51.1) [-51.1|51.1] "dBsm"  ADC
 SG_ ARC_OD_Orientation_Obj_34_FR : 175|10@0+ (0.01,-5.11) [-5.11|5.12] "rad"  ADC
 SG_ ARC_OD_LifeCycle_Obj_34_FR : 207|16@0+ (1,0) [0|65535] ""  ADC
 SG_ ARC_OD_DistX_Obj_35_FR : 223|12@0+ (0.1,-152) [-152|257.5] "m"  ADC
 SG_ ARC_OD_VabsX_Obj_35_FR : 227|11@0+ (0.125,-128) [-128|127.875] "m/s"  ADC
 SG_ ARC_OD_AabsX_Obj_35_FR : 232|9@0+ (0.125,-31.875) [-31.875|32] "m/s^2"  ADC
 SG_ ARC_OD_AabsX_Obj_34_FR : 16|9@0+ (0.125,-31.875) [-31.875|32] "m/s^2"  ADC
 SG_ ARC_OD_DistY_Obj_35_FR : 255|12@0+ (0.0875,-179.113) [-179.113|179.2] "m"  ADC
 SG_ ARC_OD_VabsY_Obj_35_FR : 259|11@0+ (0.125,-128) [-128|127.875] "m/s"  ADC
 SG_ ARC_OD_AabsY_Obj_35_FR : 264|9@0+ (0.125,-31.875) [-31.875|32] "m/s^2"  ADC
 SG_ ARC_OD_DistXStd_Obj_35_FR : 287|8@0+ (0.05,0) [0|12.75] "m"  ADC
 SG_ ARC_OD_DistYStd_Obj_35_FR : 295|8@0+ (0.1,0) [0|25.5] "m"  ADC
 SG_ ARC_OD_VabsXStd_Obj_35_FR : 303|7@0+ (0.1,0) [0|12.7] "m/s"  ADC
 SG_ ARC_OD_VabsYStd_Obj_35_FR : 296|7@0+ (0.2,0) [0|25.4] "m/s"  ADC
 SG_ ARC_OD_AabsXStd_Obj_35_FR : 305|7@0+ (0.25,0) [0|31.75] "m/s^2"  ADC
 SG_ ARC_OD_Classification_Obj_35_FR : 314|3@0+ (1,0) [0|7] ""  ADC
 SG_ ARC_OD_AabsYStd_Obj_35_FR : 327|8@0+ (0.25,0) [0|63.75] "m/s^2"  ADC
 SG_ ARC_OD_ClassConf_Obj_35_FR : 335|7@0+ (1,0) [0|127] "%"  ADC
 SG_ ARC_OD_DistY_Obj_34_FR : 39|12@0+ (0.0875,-179.113) [-179.113|179.2] "m"  ADC
 SG_ ARC_OD_ProbOfExist_Obj_35_FR : 328|7@0+ (1,0) [0|127] "%"  ADC
 SG_ ARC_OD_DynProp_Obj_35_FR : 346|3@0+ (1,0) [0|7] ""  ADC
 SG_ ARC_OD_Length_Obj_35_FR : 352|7@0+ (0.2,0) [0|25.4] "m"  ADC
 SG_ ARC_OD_MaintenanceState_Obj_0026 : 361|2@0+ (1,0) [0|3] ""  ADC
 SG_ ARC_OD_Width_Obj_35_FR : 375|7@0+ (0.2,0) [0|25.4] "m"  ADC
 SG_ ARC_OD_RCS_Obj_35_FR : 368|9@0+ (0.2,-51.1) [-51.1|51.1] "dBsm"  ADC
 SG_ ARC_OD_Orientation_Obj_35_FR : 391|10@0+ (0.01,-5.11) [-5.11|5.12] "rad"  ADC
 SG_ ARC_OD_LifeCycle_Obj_35_FR : 423|16@0+ (1,0) [0|65535] ""  ADC
 SG_ ARC_OD_ObstacleProb_Obj_34_FR : 447|7@0+ (1,0) [0|127] "%"  ADC
 SG_ ARC_OD_ObstacleProb_Obj_35_FR : 455|7@0+ (1,0) [0|127] "%"  ADC
 SG_ ARC_OD_VabsY_Obj_34_FR : 43|11@0+ (0.125,-128) [-128|127.875] "m/s"  ADC
 SG_ ARC_OD_ID_34_FR : 463|8@0+ (1,0) [0|255] ""  ADC
 SG_ ARC_OD_ID_35_FR : 471|8@0+ (1,0) [0|255] ""  ADC
 SG_ ARC_OD_MsgCounter_Obj_34_35_FR : 491|4@0+ (1,0) [0|15] ""  ADC
 SG_ ARC_OD_CRC8_Obj_34_35_FR : 511|8@0+ (1,0) [0|256] ""  ADC
 SG_ ARC_OD_AabsY_Obj_34_FR : 48|9@0+ (0.125,-31.875) [-31.875|32] "m/s^2"  ADC
 SG_ ARC_OD_DistXStd_Obj_34_FR : 71|8@0+ (0.05,0) [0|12.75] "m"  ADC
 SG_ ARC_OD_DistYStd_Obj_34_FR : 79|8@0+ (0.1,0) [0|25.5] "m"  ADC
 SG_ ARC_OD_VabsXStd_Obj_34_FR : 87|7@0+ (0.1,0) [0|12.7] "m/s"  ADC
 SG_ ARC_OD_VabsYStd_Obj_34_FR : 80|7@0+ (0.2,0) [0|25.4] "m/s"  ADC
 SG_ ARC_OD_AabsXStd_Obj_34_FR : 89|7@0+ (0.25,0) [0|31.75] "m/s^2"  ADC

BO_ 1377 ARC_OD_32_33_FR: 64 ARC
 SG_ DistHeight_Obj_33_FR : 487|8@0+ (0.2,-10) [-10|41] "m"  ADC
 SG_ DistHeight_Obj_32_FR : 479|8@0+ (0.2,-10) [-10|41] "m"  ADC
 SG_ ARC_OD_DistX_Obj_32_FR : 7|12@0+ (0.1,-152) [-152|257.5] "m"  ADC
 SG_ ARC_OD_Classification_Obj_32_FR : 98|3@0+ (1,0) [0|7] ""  ADC
 SG_ ARC_OD_AabsYStd_Obj_32_FR : 111|8@0+ (0.25,0) [0|63.75] "m/s^2"  ADC
 SG_ ARC_OD_ClassConf_Obj_32_FR : 119|7@0+ (1,0) [0|127] "%"  ADC
 SG_ ARC_OD_ProbOfExist_Obj_32_FR : 112|7@0+ (1,0) [0|127] "%"  ADC
 SG_ ARC_OD_VabsX_Obj_32_FR : 11|11@0+ (0.125,-128) [-128|127.875] "m/s"  ADC
 SG_ ARC_OD_DynProp_Obj_32_FR : 130|3@0+ (1,0) [0|7] ""  ADC
 SG_ ARC_OD_Length_Obj_32_FR : 136|7@0+ (0.2,0) [0|25.4] "m"  ADC
 SG_ ARC_OD_MaintenanceState_Obj_0027 : 145|2@0+ (1,0) [0|3] ""  ADC
 SG_ ARC_OD_Width_Obj_32_FR : 159|7@0+ (0.2,0) [0|25.4] "m"  ADC
 SG_ ARC_OD_RCS_Obj_32_FR : 152|9@0+ (0.2,-51.1) [-51.1|51.1] "dBsm"  ADC
 SG_ ARC_OD_Orientation_Obj_32_FR : 175|10@0+ (0.01,-5.11) [-5.11|5.12] "rad"  ADC
 SG_ ARC_OD_LifeCycle_Obj_32_FR : 207|16@0+ (1,0) [0|65535] ""  ADC
 SG_ ARC_OD_DistX_Obj_33_FR : 223|12@0+ (0.1,-152) [-152|257.5] "m"  ADC
 SG_ ARC_OD_VabsX_Obj_33_FR : 227|11@0+ (0.125,-128) [-128|127.875] "m/s"  ADC
 SG_ ARC_OD_AabsX_Obj_33_FR : 232|9@0+ (0.125,-31.875) [-31.875|32] "m/s^2"  ADC
 SG_ ARC_OD_AabsX_Obj_32_FR : 16|9@0+ (0.125,-31.875) [-31.875|32] "m/s^2"  ADC
 SG_ ARC_OD_DistY_Obj_33_FR : 255|12@0+ (0.0875,-179.113) [-179.113|179.2] "m"  ADC
 SG_ ARC_OD_VabsY_Obj_33_FR : 259|11@0+ (0.125,-128) [-128|127.875] "m/s"  ADC
 SG_ ARC_OD_AabsY_Obj_33_FR : 264|9@0+ (0.125,-31.875) [-31.875|32] "m/s^2"  ADC
 SG_ ARC_OD_DistXStd_Obj_33_FR : 287|8@0+ (0.05,0) [0|12.75] "m"  ADC
 SG_ ARC_OD_DistYStd_Obj_33_FR : 295|8@0+ (0.1,0) [0|25.5] "m"  ADC
 SG_ ARC_OD_VabsXStd_Obj_33_FR : 303|7@0+ (0.1,0) [0|12.7] "m/s"  ADC
 SG_ ARC_OD_VabsYStd_Obj_33_FR : 296|7@0+ (0.2,0) [0|25.4] "m/s"  ADC
 SG_ ARC_OD_AabsXStd_Obj_33_FR : 305|7@0+ (0.25,0) [0|31.75] "m/s^2"  ADC
 SG_ ARC_OD_Classification_Obj_33_FR : 314|3@0+ (1,0) [0|7] ""  ADC
 SG_ ARC_OD_AabsYStd_Obj_33_FR : 327|8@0+ (0.25,0) [0|63.75] "m/s^2"  ADC
 SG_ ARC_OD_ClassConf_Obj_33_FR : 335|7@0+ (1,0) [0|127] "%"  ADC
 SG_ ARC_OD_DistY_Obj_32_FR : 39|12@0+ (0.0875,-179.113) [-179.113|179.2] "m"  ADC
 SG_ ARC_OD_ProbOfExist_Obj_33_FR : 328|7@0+ (1,0) [0|127] "%"  ADC
 SG_ ARC_OD_DynProp_Obj_33_FR : 346|3@0+ (1,0) [0|7] ""  ADC
 SG_ ARC_OD_Length_Obj_33_FR : 352|7@0+ (0.2,0) [0|25.4] "m"  ADC
 SG_ ARC_OD_MaintenanceState_Obj_0028 : 361|2@0+ (1,0) [0|3] ""  ADC
 SG_ ARC_OD_Width_Obj_33_FR : 375|7@0+ (0.2,0) [0|25.4] "m"  ADC
 SG_ ARC_OD_RCS_Obj_33_FR : 368|9@0+ (0.2,-51.1) [-51.1|51.1] "dBsm"  ADC
 SG_ ARC_OD_Orientation_Obj_33_FR : 391|10@0+ (0.01,-5.11) [-5.11|5.12] "rad"  ADC
 SG_ ARC_OD_LifeCycle_Obj_33_FR : 423|16@0+ (1,0) [0|65535] ""  ADC
 SG_ ARC_OD_ObstacleProb_Obj_32_FR : 447|7@0+ (1,0) [0|127] "%"  ADC
 SG_ ARC_OD_ObstacleProb_Obj_33_FR : 455|7@0+ (1,0) [0|127] "%"  ADC
 SG_ ARC_OD_VabsY_Obj_32_FR : 43|11@0+ (0.125,-128) [-128|127.875] "m/s"  ADC
 SG_ ARC_OD_ID_32_FR : 463|8@0+ (1,0) [0|255] ""  ADC
 SG_ ARC_OD_ID_33_FR : 471|8@0+ (1,0) [0|255] ""  ADC
 SG_ ARC_OD_MsgCounter_Obj_32_33_FR : 491|4@0+ (1,0) [0|15] ""  ADC
 SG_ ARC_OD_CRC8_Obj_32_33_FR : 511|8@0+ (1,0) [0|256] ""  ADC
 SG_ ARC_OD_AabsY_Obj_32_FR : 48|9@0+ (0.125,-31.875) [-31.875|32] "m/s^2"  ADC
 SG_ ARC_OD_DistXStd_Obj_32_FR : 71|8@0+ (0.05,0) [0|12.75] "m"  ADC
 SG_ ARC_OD_DistYStd_Obj_32_FR : 79|8@0+ (0.1,0) [0|25.5] "m"  ADC
 SG_ ARC_OD_VabsXStd_Obj_32_FR : 87|7@0+ (0.1,0) [0|12.7] "m/s"  ADC
 SG_ ARC_OD_VabsYStd_Obj_32_FR : 80|7@0+ (0.2,0) [0|25.4] "m/s"  ADC
 SG_ ARC_OD_AabsXStd_Obj_32_FR : 89|7@0+ (0.25,0) [0|31.75] "m/s^2"  ADC

BO_ 1376 ARC_OD_30_31_FR: 64 ARC
 SG_ DistHeight_Obj_31_FR : 487|8@0+ (0.2,-10) [-10|41] "m"  ADC
 SG_ DistHeight_Obj_30_FR : 479|8@0+ (0.2,-10) [-10|41] "m"  ADC
 SG_ ARC_OD_DistX_Obj_30_FR : 7|12@0+ (0.1,-152) [-152|257.5] "m"  ADC
 SG_ ARC_OD_Classification_Obj_30_FR : 98|3@0+ (1,0) [0|7] ""  ADC
 SG_ ARC_OD_AabsYStd_Obj_30_FR : 111|8@0+ (0.25,0) [0|63.75] "m/s^2"  ADC
 SG_ ARC_OD_ClassConf_Obj_30_FR : 119|7@0+ (1,0) [0|127] "%"  ADC
 SG_ ARC_OD_ProbOfExist_Obj_30_FR : 112|7@0+ (1,0) [0|127] "%"  ADC
 SG_ ARC_OD_VabsX_Obj_30_FR : 11|11@0+ (0.125,-128) [-128|127.875] "m/s"  ADC
 SG_ ARC_OD_DynProp_Obj_30_FR : 130|3@0+ (1,0) [0|7] ""  ADC
 SG_ ARC_OD_Length_Obj_30_FR : 136|7@0+ (0.2,0) [0|25.4] "m"  ADC
 SG_ ARC_OD_MaintenanceState_Obj_0029 : 145|2@0+ (1,0) [0|3] ""  ADC
 SG_ ARC_OD_Width_Obj_30_FR : 159|7@0+ (0.2,0) [0|25.4] "m"  ADC
 SG_ ARC_OD_RCS_Obj_30_FR : 152|9@0+ (0.2,-51.1) [-51.1|51.1] "dBsm"  ADC
 SG_ ARC_OD_Orientation_Obj_30_FR : 175|10@0+ (0.01,-5.11) [-5.11|5.12] "rad"  ADC
 SG_ ARC_OD_LifeCycle_Obj_30_FR : 207|16@0+ (1,0) [0|65535] ""  ADC
 SG_ ARC_OD_DistX_Obj_31_FR : 223|12@0+ (0.1,-152) [-152|257.5] "m"  ADC
 SG_ ARC_OD_VabsX_Obj_31_FR : 227|11@0+ (0.125,-128) [-128|127.875] "m/s"  ADC
 SG_ ARC_OD_AabsX_Obj_31_FR : 232|9@0+ (0.125,-31.875) [-31.875|32] "m/s^2"  ADC
 SG_ ARC_OD_AabsX_Obj_30_FR : 16|9@0+ (0.125,-31.875) [-31.875|32] "m/s^2"  ADC
 SG_ ARC_OD_DistY_Obj_31_FR : 255|12@0+ (0.0875,-179.113) [-179.113|179.2] "m"  ADC
 SG_ ARC_OD_VabsY_Obj_31_FR : 259|11@0+ (0.125,-128) [-128|127.875] "m/s"  ADC
 SG_ ARC_OD_AabsY_Obj_31_FR : 264|9@0+ (0.125,-31.875) [-31.875|32] "m/s^2"  ADC
 SG_ ARC_OD_DistXStd_Obj_31_FR : 287|8@0+ (0.05,0) [0|12.75] "m"  ADC
 SG_ ARC_OD_DistYStd_Obj_31_FR : 295|8@0+ (0.1,0) [0|25.5] "m"  ADC
 SG_ ARC_OD_VabsXStd_Obj_31_FR : 303|7@0+ (0.1,0) [0|12.7] "m/s"  ADC
 SG_ ARC_OD_VabsYStd_Obj_31_FR : 296|7@0+ (0.2,0) [0|25.4] "m/s"  ADC
 SG_ ARC_OD_AabsXStd_Obj_31_FR : 305|7@0+ (0.25,0) [0|31.75] "m/s^2"  ADC
 SG_ ARC_OD_Classification_Obj_31_FR : 314|3@0+ (1,0) [0|7] ""  ADC
 SG_ ARC_OD_AabsYStd_Obj_31_FR : 327|8@0+ (0.25,0) [0|63.75] "m/s^2"  ADC
 SG_ ARC_OD_ClassConf_Obj_31_FR : 335|7@0+ (1,0) [0|127] "%"  ADC
 SG_ ARC_OD_DistY_Obj_30_FR : 39|12@0+ (0.0875,-179.113) [-179.113|179.2] "m"  ADC
 SG_ ARC_OD_ProbOfExist_Obj_31_FR : 328|7@0+ (1,0) [0|127] "%"  ADC
 SG_ ARC_OD_DynProp_Obj_31_FR : 346|3@0+ (1,0) [0|7] ""  ADC
 SG_ ARC_OD_Length_Obj_31_FR : 352|7@0+ (0.2,0) [0|25.4] "m"  ADC
 SG_ ARC_OD_MaintenanceState_Obj_0030 : 361|2@0+ (1,0) [0|3] ""  ADC
 SG_ ARC_OD_Width_Obj_31_FR : 375|7@0+ (0.2,0) [0|25.4] "m"  ADC
 SG_ ARC_OD_RCS_Obj_31_FR : 368|9@0+ (0.2,-51.1) [-51.1|51.1] "dBsm"  ADC
 SG_ ARC_OD_Orientation_Obj_31_FR : 391|10@0+ (0.01,-5.11) [-5.11|5.12] "rad"  ADC
 SG_ ARC_OD_LifeCycle_Obj_31_FR : 423|16@0+ (1,0) [0|65535] ""  ADC
 SG_ ARC_OD_ObstacleProb_Obj_30_FR : 447|7@0+ (1,0) [0|127] "%"  ADC
 SG_ ARC_OD_ObstacleProb_Obj_31_FR : 455|7@0+ (1,0) [0|127] "%"  ADC
 SG_ ARC_OD_VabsY_Obj_30_FR : 43|11@0+ (0.125,-128) [-128|127.875] "m/s"  ADC
 SG_ ARC_OD_ID_30_FR : 463|8@0+ (1,0) [0|255] ""  ADC
 SG_ ARC_OD_ID_31_FR : 471|8@0+ (1,0) [0|255] ""  ADC
 SG_ ARC_OD_MsgCounter_Obj_30_31_FR : 491|4@0+ (1,0) [0|15] ""  ADC
 SG_ ARC_OD_CRC8_Obj_30_31_FR : 511|8@0+ (1,0) [0|256] ""  ADC
 SG_ ARC_OD_AabsY_Obj_30_FR : 48|9@0+ (0.125,-31.875) [-31.875|32] "m/s^2"  ADC
 SG_ ARC_OD_DistXStd_Obj_30_FR : 71|8@0+ (0.05,0) [0|12.75] "m"  ADC
 SG_ ARC_OD_DistYStd_Obj_30_FR : 79|8@0+ (0.1,0) [0|25.5] "m"  ADC
 SG_ ARC_OD_VabsXStd_Obj_30_FR : 87|7@0+ (0.1,0) [0|12.7] "m/s"  ADC
 SG_ ARC_OD_VabsYStd_Obj_30_FR : 80|7@0+ (0.2,0) [0|25.4] "m/s"  ADC
 SG_ ARC_OD_AabsXStd_Obj_30_FR : 89|7@0+ (0.25,0) [0|31.75] "m/s^2"  ADC

BO_ 1375 ARC_OD_28_29_FR: 64 ARC
 SG_ DistHeight_Obj_29_FR : 487|8@0+ (0.2,-10) [-10|41] "m"  ADC
 SG_ DistHeight_Obj_28_FR : 479|8@0+ (0.2,-10) [-10|41] "m"  ADC
 SG_ ARC_OD_DistX_Obj_28_FR : 7|12@0+ (0.1,-152) [-152|257.5] "m"  ADC
 SG_ ARC_OD_Classification_Obj_28_FR : 98|3@0+ (1,0) [0|7] ""  ADC
 SG_ ARC_OD_AabsYStd_Obj_28_FR : 111|8@0+ (0.25,0) [0|63.75] "m/s^2"  ADC
 SG_ ARC_OD_ClassConf_Obj_28_FR : 119|7@0+ (1,0) [0|127] "%"  ADC
 SG_ ARC_OD_ProbOfExist_Obj_28_FR : 112|7@0+ (1,0) [0|127] "%"  ADC
 SG_ ARC_OD_VabsX_Obj_28_FR : 11|11@0+ (0.125,-128) [-128|127.875] "m/s"  ADC
 SG_ ARC_OD_DynProp_Obj_28_FR : 130|3@0+ (1,0) [0|7] ""  ADC
 SG_ ARC_OD_Length_Obj_28_FR : 136|7@0+ (0.2,0) [0|25.4] "m"  ADC
 SG_ ARC_OD_MaintenanceState_Obj_0031 : 145|2@0+ (1,0) [0|3] ""  ADC
 SG_ ARC_OD_Width_Obj_28_FR : 159|7@0+ (0.2,0) [0|25.4] "m"  ADC
 SG_ ARC_OD_RCS_Obj_28_FR : 152|9@0+ (0.2,-51.1) [-51.1|51.1] "dBsm"  ADC
 SG_ ARC_OD_Orientation_Obj_28_FR : 175|10@0+ (0.01,-5.11) [-5.11|5.12] "rad"  ADC
 SG_ ARC_OD_LifeCycle_Obj_28_FR : 207|16@0+ (1,0) [0|65535] ""  ADC
 SG_ ARC_OD_DistX_Obj_29_FR : 223|12@0+ (0.1,-152) [-152|257.5] "m"  ADC
 SG_ ARC_OD_VabsX_Obj_29_FR : 227|11@0+ (0.125,-128) [-128|127.875] "m/s"  ADC
 SG_ ARC_OD_AabsX_Obj_29_FR : 232|9@0+ (0.125,-31.875) [-31.875|32] "m/s^2"  ADC
 SG_ ARC_OD_AabsX_Obj_28_FR : 16|9@0+ (0.125,-31.875) [-31.875|32] "m/s^2"  ADC
 SG_ ARC_OD_DistY_Obj_29_FR : 255|12@0+ (0.0875,-179.113) [-179.113|179.2] "m"  ADC
 SG_ ARC_OD_VabsY_Obj_29_FR : 259|11@0+ (0.125,-128) [-128|127.875] "m/s"  ADC
 SG_ ARC_OD_AabsY_Obj_29_FR : 264|9@0+ (0.125,-31.875) [-31.875|32] "m/s^2"  ADC
 SG_ ARC_OD_DistXStd_Obj_29_FR : 287|8@0+ (0.05,0) [0|12.75] "m"  ADC
 SG_ ARC_OD_DistYStd_Obj_29_FR : 295|8@0+ (0.1,0) [0|25.5] "m"  ADC
 SG_ ARC_OD_VabsXStd_Obj_29_FR : 303|7@0+ (0.1,0) [0|12.7] "m/s"  ADC
 SG_ ARC_OD_VabsYStd_Obj_29_FR : 296|7@0+ (0.2,0) [0|25.4] "m/s"  ADC
 SG_ ARC_OD_AabsXStd_Obj_29_FR : 305|7@0+ (0.25,0) [0|31.75] "m/s^2"  ADC
 SG_ ARC_OD_Classification_Obj_29_FR : 314|3@0+ (1,0) [0|7] ""  ADC
 SG_ ARC_OD_AabsYStd_Obj_29_FR : 327|8@0+ (0.25,0) [0|63.75] "m/s^2"  ADC
 SG_ ARC_OD_ClassConf_Obj_29_FR : 335|7@0+ (1,0) [0|127] "%"  ADC
 SG_ ARC_OD_DistY_Obj_28_FR : 39|12@0+ (0.0875,-179.113) [-179.113|179.2] "m"  ADC
 SG_ ARC_OD_ProbOfExist_Obj_29_FR : 328|7@0+ (1,0) [0|127] "%"  ADC
 SG_ ARC_OD_DynProp_Obj_29_FR : 346|3@0+ (1,0) [0|7] ""  ADC
 SG_ ARC_OD_Length_Obj_29_FR : 352|7@0+ (0.2,0) [0|25.4] "m"  ADC
 SG_ ARC_OD_MaintenanceState_Obj_0032 : 361|2@0+ (1,0) [0|3] ""  ADC
 SG_ ARC_OD_Width_Obj_29_FR : 375|7@0+ (0.2,0) [0|25.4] "m"  ADC
 SG_ ARC_OD_RCS_Obj_29_FR : 368|9@0+ (0.2,-51.1) [-51.1|51.1] "dBsm"  ADC
 SG_ ARC_OD_Orientation_Obj_29_FR : 391|10@0+ (0.01,-5.11) [-5.11|5.12] "rad"  ADC
 SG_ ARC_OD_LifeCycle_Obj_29_FR : 423|16@0+ (1,0) [0|65535] ""  ADC
 SG_ ARC_OD_ObstacleProb_Obj_28_FR : 447|7@0+ (1,0) [0|127] "%"  ADC
 SG_ ARC_OD_ObstacleProb_Obj_29_FR : 455|7@0+ (1,0) [0|127] "%"  ADC
 SG_ ARC_OD_VabsY_Obj_28_FR : 43|11@0+ (0.125,-128) [-128|127.875] "m/s"  ADC
 SG_ ARC_OD_ID_28_FR : 463|8@0+ (1,0) [0|255] ""  ADC
 SG_ ARC_OD_ID_29_FR : 471|8@0+ (1,0) [0|255] ""  ADC
 SG_ ARC_OD_MsgCounter_Obj_28_29_FR : 491|4@0+ (1,0) [0|15] ""  ADC
 SG_ ARC_OD_CRC8_Obj_28_29_FR : 511|8@0+ (1,0) [0|256] ""  ADC
 SG_ ARC_OD_AabsY_Obj_28_FR : 48|9@0+ (0.125,-31.875) [-31.875|32] "m/s^2"  ADC
 SG_ ARC_OD_DistXStd_Obj_28_FR : 71|8@0+ (0.05,0) [0|12.75] "m"  ADC
 SG_ ARC_OD_DistYStd_Obj_28_FR : 79|8@0+ (0.1,0) [0|25.5] "m"  ADC
 SG_ ARC_OD_VabsXStd_Obj_28_FR : 87|7@0+ (0.1,0) [0|12.7] "m/s"  ADC
 SG_ ARC_OD_VabsYStd_Obj_28_FR : 80|7@0+ (0.2,0) [0|25.4] "m/s"  ADC
 SG_ ARC_OD_AabsXStd_Obj_28_FR : 89|7@0+ (0.25,0) [0|31.75] "m/s^2"  ADC

BO_ 1374 ARC_OD_26_27_FR: 64 ARC
 SG_ DistHeight_Obj_27_FR : 487|8@0+ (0.2,-10) [-10|41] "m"  ADC
 SG_ DistHeight_Obj_26_FR : 479|8@0+ (0.2,-10) [-10|41] "m"  ADC
 SG_ ARC_OD_DistX_Obj_26_FR : 7|12@0+ (0.1,-152) [-152|257.5] "m"  ADC
 SG_ ARC_OD_Classification_Obj_26_FR : 98|3@0+ (1,0) [0|7] ""  ADC
 SG_ ARC_OD_AabsYStd_Obj_26_FR : 111|8@0+ (0.25,0) [0|63.75] "m/s^2"  ADC
 SG_ ARC_OD_ClassConf_Obj_26_FR : 119|7@0+ (1,0) [0|127] "%"  ADC
 SG_ ARC_OD_ProbOfExist_Obj_26_FR : 112|7@0+ (1,0) [0|127] "%"  ADC
 SG_ ARC_OD_VabsX_Obj_26_FR : 11|11@0+ (0.125,-128) [-128|127.875] "m/s"  ADC
 SG_ ARC_OD_DynProp_Obj_26_FR : 130|3@0+ (1,0) [0|7] ""  ADC
 SG_ ARC_OD_Length_Obj_26_FR : 136|7@0+ (0.2,0) [0|25.4] "m"  ADC
 SG_ ARC_OD_MaintenanceState_Obj_0033 : 145|2@0+ (1,0) [0|3] ""  ADC
 SG_ ARC_OD_Width_Obj_26_FR : 159|7@0+ (0.2,0) [0|25.4] "m"  ADC
 SG_ ARC_OD_RCS_Obj_26_FR : 152|9@0+ (0.2,-51.1) [-51.1|51.1] "dBsm"  ADC
 SG_ ARC_OD_Orientation_Obj_26_FR : 175|10@0+ (0.01,-5.11) [-5.11|5.12] "rad"  ADC
 SG_ ARC_OD_LifeCycle_Obj_26_FR : 207|16@0+ (1,0) [0|65535] ""  ADC
 SG_ ARC_OD_DistX_Obj_27_FR : 223|12@0+ (0.1,-152) [-152|257.5] "m"  ADC
 SG_ ARC_OD_VabsX_Obj_27_FR : 227|11@0+ (0.125,-128) [-128|127.875] "m/s"  ADC
 SG_ ARC_OD_AabsX_Obj_27_FR : 232|9@0+ (0.125,-31.875) [-31.875|32] "m/s^2"  ADC
 SG_ ARC_OD_AabsX_Obj_26_FR : 16|9@0+ (0.125,-31.875) [-31.875|32] "m/s^2"  ADC
 SG_ ARC_OD_DistY_Obj_27_FR : 255|12@0+ (0.0875,-179.113) [-179.113|179.2] "m"  ADC
 SG_ ARC_OD_VabsY_Obj_27_FR : 259|11@0+ (0.125,-128) [-128|127.875] "m/s"  ADC
 SG_ ARC_OD_AabsY_Obj_27_FR : 264|9@0+ (0.125,-31.875) [-31.875|32] "m/s^2"  ADC
 SG_ ARC_OD_DistXStd_Obj_27_FR : 287|8@0+ (0.05,0) [0|12.75] "m"  ADC
 SG_ ARC_OD_DistYStd_Obj_27_FR : 295|8@0+ (0.1,0) [0|25.5] "m"  ADC
 SG_ ARC_OD_VabsXStd_Obj_27_FR : 303|7@0+ (0.1,0) [0|12.7] "m/s"  ADC
 SG_ ARC_OD_VabsYStd_Obj_27_FR : 296|7@0+ (0.2,0) [0|25.4] "m/s"  ADC
 SG_ ARC_OD_AabsXStd_Obj_27_FR : 305|7@0+ (0.25,0) [0|31.75] "m/s^2"  ADC
 SG_ ARC_OD_Classification_Obj_27_FR : 314|3@0+ (1,0) [0|7] ""  ADC
 SG_ ARC_OD_AabsYStd_Obj_27_FR : 327|8@0+ (0.25,0) [0|63.75] "m/s^2"  ADC
 SG_ ARC_OD_ClassConf_Obj_27_FR : 335|7@0+ (1,0) [0|127] "%"  ADC
 SG_ ARC_OD_DistY_Obj_26_FR : 39|12@0+ (0.0875,-179.113) [-179.113|179.2] "m"  ADC
 SG_ ARC_OD_ProbOfExist_Obj_27_FR : 328|7@0+ (1,0) [0|127] "%"  ADC
 SG_ ARC_OD_DynProp_Obj_27_FR : 346|3@0+ (1,0) [0|7] ""  ADC
 SG_ ARC_OD_Length_Obj_27_FR : 352|7@0+ (0.2,0) [0|25.4] "m"  ADC
 SG_ ARC_OD_MaintenanceState_Obj_0034 : 361|2@0+ (1,0) [0|3] ""  ADC
 SG_ ARC_OD_Width_Obj_27_FR : 375|7@0+ (0.2,0) [0|25.4] "m"  ADC
 SG_ ARC_OD_RCS_Obj_27_FR : 368|9@0+ (0.2,-51.1) [-51.1|51.1] "dBsm"  ADC
 SG_ ARC_OD_Orientation_Obj_27_FR : 391|10@0+ (0.01,-5.11) [-5.11|5.12] "rad"  ADC
 SG_ ARC_OD_LifeCycle_Obj_27_FR : 423|16@0+ (1,0) [0|65535] ""  ADC
 SG_ ARC_OD_ObstacleProb_Obj_26_FR : 447|7@0+ (1,0) [0|127] "%"  ADC
 SG_ ARC_OD_ObstacleProb_Obj_27_FR : 455|7@0+ (1,0) [0|127] "%"  ADC
 SG_ ARC_OD_VabsY_Obj_26_FR : 43|11@0+ (0.125,-128) [-128|127.875] "m/s"  ADC
 SG_ ARC_OD_ID_26_FR : 463|8@0+ (1,0) [0|255] ""  ADC
 SG_ ARC_OD_ID_27_FR : 471|8@0+ (1,0) [0|255] ""  ADC
 SG_ ARC_OD_MsgCounter_Obj_26_27_FR : 491|4@0+ (1,0) [0|15] ""  ADC
 SG_ ARC_OD_CRC8_Obj_26_27_FR : 511|8@0+ (1,0) [0|256] ""  ADC
 SG_ ARC_OD_AabsY_Obj_26_FR : 48|9@0+ (0.125,-31.875) [-31.875|32] "m/s^2"  ADC
 SG_ ARC_OD_DistXStd_Obj_26_FR : 71|8@0+ (0.05,0) [0|12.75] "m"  ADC
 SG_ ARC_OD_DistYStd_Obj_26_FR : 79|8@0+ (0.1,0) [0|25.5] "m"  ADC
 SG_ ARC_OD_VabsXStd_Obj_26_FR : 87|7@0+ (0.1,0) [0|12.7] "m/s"  ADC
 SG_ ARC_OD_VabsYStd_Obj_26_FR : 80|7@0+ (0.2,0) [0|25.4] "m/s"  ADC
 SG_ ARC_OD_AabsXStd_Obj_26_FR : 89|7@0+ (0.25,0) [0|31.75] "m/s^2"  ADC

BO_ 1373 ARC_OD_24_25_FR: 64 ARC
 SG_ DistHeight_Obj_25_FR : 487|8@0+ (0.2,-10) [-10|41] "m"  ADC
 SG_ DistHeight_Obj_24_FR : 479|8@0+ (0.2,-10) [-10|41] "m"  ADC
 SG_ ARC_OD_DistX_Obj_24_FR : 7|12@0+ (0.1,-152) [-152|257.5] "m"  ADC
 SG_ ARC_OD_Classification_Obj_24_FR : 98|3@0+ (1,0) [0|7] ""  ADC
 SG_ ARC_OD_AabsYStd_Obj_24_FR : 111|8@0+ (0.25,0) [0|63.75] "m/s^2"  ADC
 SG_ ARC_OD_ClassConf_Obj_24_FR : 119|7@0+ (1,0) [0|127] "%"  ADC
 SG_ ARC_OD_ProbOfExist_Obj_24_FR : 112|7@0+ (1,0) [0|127] "%"  ADC
 SG_ ARC_OD_VabsX_Obj_24_FR : 11|11@0+ (0.125,-128) [-128|127.875] "m/s"  ADC
 SG_ ARC_OD_DynProp_Obj_24_FR : 130|3@0+ (1,0) [0|7] ""  ADC
 SG_ ARC_OD_Length_Obj_24_FR : 136|7@0+ (0.2,0) [0|25.4] "m"  ADC
 SG_ ARC_OD_MaintenanceState_Obj_0035 : 145|2@0+ (1,0) [0|3] ""  ADC
 SG_ ARC_OD_Width_Obj_24_FR : 159|7@0+ (0.2,0) [0|25.4] "m"  ADC
 SG_ ARC_OD_RCS_Obj_24_FR : 152|9@0+ (0.2,-51.1) [-51.1|51.1] "dBsm"  ADC
 SG_ ARC_OD_Orientation_Obj_24_FR : 175|10@0+ (0.01,-5.11) [-5.11|5.12] "rad"  ADC
 SG_ ARC_OD_LifeCycle_Obj_24_FR : 207|16@0+ (1,0) [0|65535] ""  ADC
 SG_ ARC_OD_DistX_Obj_25_FR : 223|12@0+ (0.1,-152) [-152|257.5] "m"  ADC
 SG_ ARC_OD_VabsX_Obj_25_FR : 227|11@0+ (0.125,-128) [-128|127.875] "m/s"  ADC
 SG_ ARC_OD_AabsX_Obj_25_FR : 232|9@0+ (0.125,-31.875) [-31.875|32] "m/s^2"  ADC
 SG_ ARC_OD_AabsX_Obj_24_FR : 16|9@0+ (0.125,-31.875) [-31.875|32] "m/s^2"  ADC
 SG_ ARC_OD_DistY_Obj_25_FR : 255|12@0+ (0.0875,-179.113) [-179.113|179.2] "m"  ADC
 SG_ ARC_OD_VabsY_Obj_25_FR : 259|11@0+ (0.125,-128) [-128|127.875] "m/s"  ADC
 SG_ ARC_OD_AabsY_Obj_25_FR : 264|9@0+ (0.125,-31.875) [-31.875|32] "m/s^2"  ADC
 SG_ ARC_OD_DistXStd_Obj_25_FR : 287|8@0+ (0.05,0) [0|12.75] "m"  ADC
 SG_ ARC_OD_DistYStd_Obj_25_FR : 295|8@0+ (0.1,0) [0|25.5] "m"  ADC
 SG_ ARC_OD_VabsXStd_Obj_25_FR : 303|7@0+ (0.1,0) [0|12.7] "m/s"  ADC
 SG_ ARC_OD_VabsYStd_Obj_25_FR : 296|7@0+ (0.2,0) [0|25.4] "m/s"  ADC
 SG_ ARC_OD_AabsXStd_Obj_25_FR : 305|7@0+ (0.25,0) [0|31.75] "m/s^2"  ADC
 SG_ ARC_OD_Classification_Obj_25_FR : 314|3@0+ (1,0) [0|7] ""  ADC
 SG_ ARC_OD_AabsYStd_Obj_25_FR : 327|8@0+ (0.25,0) [0|63.75] "m/s^2"  ADC
 SG_ ARC_OD_ClassConf_Obj_25_FR : 335|7@0+ (1,0) [0|127] "%"  ADC
 SG_ ARC_OD_DistY_Obj_24_FR : 39|12@0+ (0.0875,-179.113) [-179.113|179.2] "m"  ADC
 SG_ ARC_OD_ProbOfExist_Obj_25_FR : 328|7@0+ (1,0) [0|127] "%"  ADC
 SG_ ARC_OD_DynProp_Obj_25_FR : 346|3@0+ (1,0) [0|7] ""  ADC
 SG_ ARC_OD_Length_Obj_25_FR : 352|7@0+ (0.2,0) [0|25.4] "m"  ADC
 SG_ ARC_OD_MaintenanceState_Obj_0036 : 361|2@0+ (1,0) [0|3] ""  ADC
 SG_ ARC_OD_Width_Obj_25_FR : 375|7@0+ (0.2,0) [0|25.4] "m"  ADC
 SG_ ARC_OD_RCS_Obj_25_FR : 368|9@0+ (0.2,-51.1) [-51.1|51.1] "dBsm"  ADC
 SG_ ARC_OD_Orientation_Obj_25_FR : 391|10@0+ (0.01,-5.11) [-5.11|5.12] "rad"  ADC
 SG_ ARC_OD_LifeCycle_Obj_25_FR : 423|16@0+ (1,0) [0|65535] ""  ADC
 SG_ ARC_OD_ObstacleProb_Obj_24_FR : 447|7@0+ (1,0) [0|127] "%"  ADC
 SG_ ARC_OD_ObstacleProb_Obj_25_FR : 455|7@0+ (1,0) [0|127] "%"  ADC
 SG_ ARC_OD_VabsY_Obj_24_FR : 43|11@0+ (0.125,-128) [-128|127.875] "m/s"  ADC
 SG_ ARC_OD_ID_24_FR : 463|8@0+ (1,0) [0|255] ""  ADC
 SG_ ARC_OD_ID_25_FR : 471|8@0+ (1,0) [0|255] ""  ADC
 SG_ ARC_OD_MsgCounter_Obj_24_25_FR : 491|4@0+ (1,0) [0|15] ""  ADC
 SG_ ARC_OD_CRC8_Obj_24_25_FR : 511|8@0+ (1,0) [0|256] ""  ADC
 SG_ ARC_OD_AabsY_Obj_24_FR : 48|9@0+ (0.125,-31.875) [-31.875|32] "m/s^2"  ADC
 SG_ ARC_OD_DistXStd_Obj_24_FR : 71|8@0+ (0.05,0) [0|12.75] "m"  ADC
 SG_ ARC_OD_DistYStd_Obj_24_FR : 79|8@0+ (0.1,0) [0|25.5] "m"  ADC
 SG_ ARC_OD_VabsXStd_Obj_24_FR : 87|7@0+ (0.1,0) [0|12.7] "m/s"  ADC
 SG_ ARC_OD_VabsYStd_Obj_24_FR : 80|7@0+ (0.2,0) [0|25.4] "m/s"  ADC
 SG_ ARC_OD_AabsXStd_Obj_24_FR : 89|7@0+ (0.25,0) [0|31.75] "m/s^2"  ADC

BO_ 1372 ARC_OD_22_23_FR: 64 ARC
 SG_ DistHeight_Obj_23_FR : 487|8@0+ (0.2,-10) [-10|41] "m"  ADC
 SG_ DistHeight_Obj_22_FR : 479|8@0+ (0.2,-10) [-10|41] "m"  ADC
 SG_ ARC_OD_DistX_Obj_22_FR : 7|12@0+ (0.1,-152) [-152|257.5] "m"  ADC
 SG_ ARC_OD_Classification_Obj_22_FR : 98|3@0+ (1,0) [0|7] ""  ADC
 SG_ ARC_OD_AabsYStd_Obj_22_FR : 111|8@0+ (0.25,0) [0|63.75] "m/s^2"  ADC
 SG_ ARC_OD_ClassConf_Obj_22_FR : 119|7@0+ (1,0) [0|127] "%"  ADC
 SG_ ARC_OD_ProbOfExist_Obj_22_FR : 112|7@0+ (1,0) [0|127] "%"  ADC
 SG_ ARC_OD_VabsX_Obj_22_FR : 11|11@0+ (0.125,-128) [-128|127.875] "m/s"  ADC
 SG_ ARC_OD_DynProp_Obj_22_FR : 130|3@0+ (1,0) [0|7] ""  ADC
 SG_ ARC_OD_Length_Obj_22_FR : 136|7@0+ (0.2,0) [0|25.4] "m"  ADC
 SG_ ARC_OD_MaintenanceState_Obj_0037 : 145|2@0+ (1,0) [0|3] ""  ADC
 SG_ ARC_OD_Width_Obj_22_FR : 159|7@0+ (0.2,0) [0|25.4] "m"  ADC
 SG_ ARC_OD_RCS_Obj_22_FR : 152|9@0+ (0.2,-51.1) [-51.1|51.1] "dBsm"  ADC
 SG_ ARC_OD_Orientation_Obj_22_FR : 175|10@0+ (0.01,-5.11) [-5.11|5.12] "rad"  ADC
 SG_ ARC_OD_LifeCycle_Obj_22_FR : 207|16@0+ (1,0) [0|65535] ""  ADC
 SG_ ARC_OD_DistX_Obj_23_FR : 223|12@0+ (0.1,-152) [-152|257.5] "m"  ADC
 SG_ ARC_OD_VabsX_Obj_23_FR : 227|11@0+ (0.125,-128) [-128|127.875] "m/s"  ADC
 SG_ ARC_OD_AabsX_Obj_23_FR : 232|9@0+ (0.125,-31.875) [-31.875|32] "m/s^2"  ADC
 SG_ ARC_OD_AabsX_Obj_22_FR : 16|9@0+ (0.125,-31.875) [-31.875|32] "m/s^2"  ADC
 SG_ ARC_OD_DistY_Obj_23_FR : 255|12@0+ (0.0875,-179.113) [-179.113|179.2] "m"  ADC
 SG_ ARC_OD_VabsY_Obj_23_FR : 259|11@0+ (0.125,-128) [-128|127.875] "m/s"  ADC
 SG_ ARC_OD_AabsY_Obj_23_FR : 264|9@0+ (0.125,-31.875) [-31.875|32] "m/s^2"  ADC
 SG_ ARC_OD_DistXStd_Obj_23_FR : 287|8@0+ (0.05,0) [0|12.75] "m"  ADC
 SG_ ARC_OD_DistYStd_Obj_23_FR : 295|8@0+ (0.1,0) [0|25.5] "m"  ADC
 SG_ ARC_OD_VabsXStd_Obj_23_FR : 303|7@0+ (0.1,0) [0|12.7] "m/s"  ADC
 SG_ ARC_OD_VabsYStd_Obj_23_FR : 296|7@0+ (0.2,0) [0|25.4] "m/s"  ADC
 SG_ ARC_OD_AabsXStd_Obj_23_FR : 305|7@0+ (0.25,0) [0|31.75] "m/s^2"  ADC
 SG_ ARC_OD_Classification_Obj_23_FR : 314|3@0+ (1,0) [0|7] ""  ADC
 SG_ ARC_OD_AabsYStd_Obj_23_FR : 327|8@0+ (0.25,0) [0|63.75] "m/s^2"  ADC
 SG_ ARC_OD_ClassConf_Obj_23_FR : 335|7@0+ (1,0) [0|127] "%"  ADC
 SG_ ARC_OD_DistY_Obj_22_FR : 39|12@0+ (0.0875,-179.113) [-179.113|179.2] "m"  ADC
 SG_ ARC_OD_ProbOfExist_Obj_23_FR : 328|7@0+ (1,0) [0|127] "%"  ADC
 SG_ ARC_OD_DynProp_Obj_23_FR : 346|3@0+ (1,0) [0|7] ""  ADC
 SG_ ARC_OD_Length_Obj_23_FR : 352|7@0+ (0.2,0) [0|25.4] "m"  ADC
 SG_ ARC_OD_MaintenanceState_Obj_0038 : 361|2@0+ (1,0) [0|3] ""  ADC
 SG_ ARC_OD_Width_Obj_23_FR : 375|7@0+ (0.2,0) [0|25.4] "m"  ADC
 SG_ ARC_OD_RCS_Obj_23_FR : 368|9@0+ (0.2,-51.1) [-51.1|51.1] "dBsm"  ADC
 SG_ ARC_OD_Orientation_Obj_23_FR : 391|10@0+ (0.01,-5.11) [-5.11|5.12] "rad"  ADC
 SG_ ARC_OD_LifeCycle_Obj_23_FR : 423|16@0+ (1,0) [0|65535] ""  ADC
 SG_ ARC_OD_ObstacleProb_Obj_22_FR : 447|7@0+ (1,0) [0|127] "%"  ADC
 SG_ ARC_OD_ObstacleProb_Obj_23_FR : 455|7@0+ (1,0) [0|127] "%"  ADC
 SG_ ARC_OD_VabsY_Obj_22_FR : 43|11@0+ (0.125,-128) [-128|127.875] "m/s"  ADC
 SG_ ARC_OD_ID_22_FR : 463|8@0+ (1,0) [0|255] ""  ADC
 SG_ ARC_OD_ID_23_FR : 471|8@0+ (1,0) [0|255] ""  ADC
 SG_ ARC_OD_MsgCounter_Obj_22_23_FR : 491|4@0+ (1,0) [0|15] ""  ADC
 SG_ ARC_OD_CRC8_Obj_22_23_FR : 511|8@0+ (1,0) [0|256] ""  ADC
 SG_ ARC_OD_AabsY_Obj_22_FR : 48|9@0+ (0.125,-31.875) [-31.875|32] "m/s^2"  ADC
 SG_ ARC_OD_DistXStd_Obj_22_FR : 71|8@0+ (0.05,0) [0|12.75] "m"  ADC
 SG_ ARC_OD_DistYStd_Obj_22_FR : 79|8@0+ (0.1,0) [0|25.5] "m"  ADC
 SG_ ARC_OD_VabsXStd_Obj_22_FR : 87|7@0+ (0.1,0) [0|12.7] "m/s"  ADC
 SG_ ARC_OD_VabsYStd_Obj_22_FR : 80|7@0+ (0.2,0) [0|25.4] "m/s"  ADC
 SG_ ARC_OD_AabsXStd_Obj_22_FR : 89|7@0+ (0.25,0) [0|31.75] "m/s^2"  ADC

BO_ 1371 ARC_OD_20_21_FR: 64 ARC
 SG_ DistHeight_Obj_21_FR : 487|8@0+ (0.2,-10) [-10|41] "m"  ADC
 SG_ DistHeight_Obj_20_FR : 479|8@0+ (0.2,-10) [-10|41] "m"  ADC
 SG_ ARC_OD_DistX_Obj_20_FR : 7|12@0+ (0.1,-152) [-152|257.5] "m"  ADC
 SG_ ARC_OD_Classification_Obj_20_FR : 98|3@0+ (1,0) [0|7] ""  ADC
 SG_ ARC_OD_AabsYStd_Obj_20_FR : 111|8@0+ (0.25,0) [0|63.75] "m/s^2"  ADC
 SG_ ARC_OD_ClassConf_Obj_20_FR : 119|7@0+ (1,0) [0|127] "%"  ADC
 SG_ ARC_OD_ProbOfExist_Obj_20_FR : 112|7@0+ (1,0) [0|127] "%"  ADC
 SG_ ARC_OD_VabsX_Obj_20_FR : 11|11@0+ (0.125,-128) [-128|127.875] "m/s"  ADC
 SG_ ARC_OD_DynProp_Obj_20_FR : 130|3@0+ (1,0) [0|7] ""  ADC
 SG_ ARC_OD_Length_Obj_20_FR : 136|7@0+ (0.2,0) [0|25.4] "m"  ADC
 SG_ ARC_OD_MaintenanceState_Obj_0039 : 145|2@0+ (1,0) [0|3] ""  ADC
 SG_ ARC_OD_Width_Obj_20_FR : 159|7@0+ (0.2,0) [0|25.4] "m"  ADC
 SG_ ARC_OD_RCS_Obj_20_FR : 152|9@0+ (0.2,-51.1) [-51.1|51.1] "dBsm"  ADC
 SG_ ARC_OD_Orientation_Obj_20_FR : 175|10@0+ (0.01,-5.11) [-5.11|5.12] "rad"  ADC
 SG_ ARC_OD_LifeCycle_Obj_20_FR : 207|16@0+ (1,0) [0|65535] ""  ADC
 SG_ ARC_OD_DistX_Obj_21_FR : 223|12@0+ (0.1,-152) [-152|257.5] "m"  ADC
 SG_ ARC_OD_VabsX_Obj_21_FR : 227|11@0+ (0.125,-128) [-128|127.875] "m/s"  ADC
 SG_ ARC_OD_AabsX_Obj_21_FR : 232|9@0+ (0.125,-31.875) [-31.875|32] "m/s^2"  ADC
 SG_ ARC_OD_AabsX_Obj_20_FR : 16|9@0+ (0.125,-31.875) [-31.875|32] "m/s^2"  ADC
 SG_ ARC_OD_DistY_Obj_21_FR : 255|12@0+ (0.0875,-179.113) [-179.113|179.2] "m"  ADC
 SG_ ARC_OD_VabsY_Obj_21_FR : 259|11@0+ (0.125,-128) [-128|127.875] "m/s"  ADC
 SG_ ARC_OD_AabsY_Obj_21_FR : 264|9@0+ (0.125,-31.875) [-31.875|32] "m/s^2"  ADC
 SG_ ARC_OD_DistXStd_Obj_21_FR : 287|8@0+ (0.05,0) [0|12.75] "m"  ADC
 SG_ ARC_OD_DistYStd_Obj_21_FR : 295|8@0+ (0.1,0) [0|25.5] "m"  ADC
 SG_ ARC_OD_VabsXStd_Obj_21_FR : 303|7@0+ (0.1,0) [0|12.7] "m/s"  ADC
 SG_ ARC_OD_VabsYStd_Obj_21_FR : 296|7@0+ (0.2,0) [0|25.4] "m/s"  ADC
 SG_ ARC_OD_AabsXStd_Obj_21_FR : 305|7@0+ (0.25,0) [0|31.75] "m/s^2"  ADC
 SG_ ARC_OD_Classification_Obj_21_FR : 314|3@0+ (1,0) [0|7] ""  ADC
 SG_ ARC_OD_AabsYStd_Obj_21_FR : 327|8@0+ (0.25,0) [0|63.75] "m/s^2"  ADC
 SG_ ARC_OD_ClassConf_Obj_21_FR : 335|7@0+ (1,0) [0|127] "%"  ADC
 SG_ ARC_OD_DistY_Obj_20_FR : 39|12@0+ (0.0875,-179.113) [-179.113|179.2] "m"  ADC
 SG_ ARC_OD_ProbOfExist_Obj_21_FR : 328|7@0+ (1,0) [0|127] "%"  ADC
 SG_ ARC_OD_DynProp_Obj_21_FR : 346|3@0+ (1,0) [0|7] ""  ADC
 SG_ ARC_OD_Length_Obj_21_FR : 352|7@0+ (0.2,0) [0|25.4] "m"  ADC
 SG_ ARC_OD_MaintenanceState_Obj_0040 : 361|2@0+ (1,0) [0|3] ""  ADC
 SG_ ARC_OD_Width_Obj_21_FR : 375|7@0+ (0.2,0) [0|25.4] "m"  ADC
 SG_ ARC_OD_RCS_Obj_21_FR : 368|9@0+ (0.2,-51.1) [-51.1|51.1] "dBsm"  ADC
 SG_ ARC_OD_Orientation_Obj_21_FR : 391|10@0+ (0.01,-5.11) [-5.11|5.12] "rad"  ADC
 SG_ ARC_OD_LifeCycle_Obj_21_FR : 423|16@0+ (1,0) [0|65535] ""  ADC
 SG_ ARC_OD_ObstacleProb_Obj_20_FR : 447|7@0+ (1,0) [0|127] "%"  ADC
 SG_ ARC_OD_ObstacleProb_Obj_21_FR : 455|7@0+ (1,0) [0|127] "%"  ADC
 SG_ ARC_OD_VabsY_Obj_20_FR : 43|11@0+ (0.125,-128) [-128|127.875] "m/s"  ADC
 SG_ ARC_OD_ID_20_FR : 463|8@0+ (1,0) [0|255] ""  ADC
 SG_ ARC_OD_ID_21_FR : 471|8@0+ (1,0) [0|255] ""  ADC
 SG_ ARC_OD_MsgCounter_Obj_20_21_FR : 491|4@0+ (1,0) [0|15] ""  ADC
 SG_ ARC_OD_CRC8_Obj_20_21_FR : 511|8@0+ (1,0) [0|256] ""  ADC
 SG_ ARC_OD_AabsY_Obj_20_FR : 48|9@0+ (0.125,-31.875) [-31.875|32] "m/s^2"  ADC
 SG_ ARC_OD_DistXStd_Obj_20_FR : 71|8@0+ (0.05,0) [0|12.75] "m"  ADC
 SG_ ARC_OD_DistYStd_Obj_20_FR : 79|8@0+ (0.1,0) [0|25.5] "m"  ADC
 SG_ ARC_OD_VabsXStd_Obj_20_FR : 87|7@0+ (0.1,0) [0|12.7] "m/s"  ADC
 SG_ ARC_OD_VabsYStd_Obj_20_FR : 80|7@0+ (0.2,0) [0|25.4] "m/s"  ADC
 SG_ ARC_OD_AabsXStd_Obj_20_FR : 89|7@0+ (0.25,0) [0|31.75] "m/s^2"  ADC

BO_ 1370 ARC_OD_18_19_FR: 64 ARC
 SG_ DistHeight_Obj_19_FR : 487|8@0+ (0.2,-10) [-10|41] "m"  ADC
 SG_ DistHeight_Obj_18_FR : 479|8@0+ (0.2,-10) [-10|41] "m"  ADC
 SG_ ARC_OD_DistX_Obj_18_FR : 7|12@0+ (0.1,-152) [-152|257.5] "m"  ADC
 SG_ ARC_OD_Classification_Obj_18_FR : 98|3@0+ (1,0) [0|7] ""  ADC
 SG_ ARC_OD_AabsYStd_Obj_18_FR : 111|8@0+ (0.25,0) [0|63.75] "m/s^2"  ADC
 SG_ ARC_OD_ClassConf_Obj_18_FR : 119|7@0+ (1,0) [0|127] "%"  ADC
 SG_ ARC_OD_ProbOfExist_Obj_18_FR : 112|7@0+ (1,0) [0|127] "%"  ADC
 SG_ ARC_OD_VabsX_Obj_18_FR : 11|11@0+ (0.125,-128) [-128|127.875] "m/s"  ADC
 SG_ ARC_OD_DynProp_Obj_18_FR : 130|3@0+ (1,0) [0|7] ""  ADC
 SG_ ARC_OD_Length_Obj_18_FR : 136|7@0+ (0.2,0) [0|25.4] "m"  ADC
 SG_ ARC_OD_MaintenanceState_Obj_0041 : 145|2@0+ (1,0) [0|3] ""  ADC
 SG_ ARC_OD_Width_Obj_18_FR : 159|7@0+ (0.2,0) [0|25.4] "m"  ADC
 SG_ ARC_OD_RCS_Obj_18_FR : 152|9@0+ (0.2,-51.1) [-51.1|51.1] "dBsm"  ADC
 SG_ ARC_OD_Orientation_Obj_18_FR : 175|10@0+ (0.01,-5.11) [-5.11|5.12] "rad"  ADC
 SG_ ARC_OD_LifeCycle_Obj_18_FR : 207|16@0+ (1,0) [0|65535] ""  ADC
 SG_ ARC_OD_DistX_Obj_19_FR : 223|12@0+ (0.1,-152) [-152|257.5] "m"  ADC
 SG_ ARC_OD_VabsX_Obj_19_FR : 227|11@0+ (0.125,-128) [-128|127.875] "m/s"  ADC
 SG_ ARC_OD_AabsX_Obj_19_FR : 232|9@0+ (0.125,-31.875) [-31.875|32] "m/s^2"  ADC
 SG_ ARC_OD_AabsX_Obj_18_FR : 16|9@0+ (0.125,-31.875) [-31.875|32] "m/s^2"  ADC
 SG_ ARC_OD_DistY_Obj_19_FR : 255|12@0+ (0.0875,-179.113) [-179.113|179.2] "m"  ADC
 SG_ ARC_OD_VabsY_Obj_19_FR : 259|11@0+ (0.125,-128) [-128|127.875] "m/s"  ADC
 SG_ ARC_OD_AabsY_Obj_19_FR : 264|9@0+ (0.125,-31.875) [-31.875|32] "m/s^2"  ADC
 SG_ ARC_OD_DistXStd_Obj_19_FR : 287|8@0+ (0.05,0) [0|12.75] "m"  ADC
 SG_ ARC_OD_DistYStd_Obj_19_FR : 295|8@0+ (0.1,0) [0|25.5] "m"  ADC
 SG_ ARC_OD_VabsXStd_Obj_19_FR : 303|7@0+ (0.1,0) [0|12.7] "m/s"  ADC
 SG_ ARC_OD_VabsYStd_Obj_19_FR : 296|7@0+ (0.2,0) [0|25.4] "m/s"  ADC
 SG_ ARC_OD_AabsXStd_Obj_19_FR : 305|7@0+ (0.25,0) [0|31.75] "m/s^2"  ADC
 SG_ ARC_OD_Classification_Obj_19_FR : 314|3@0+ (1,0) [0|7] ""  ADC
 SG_ ARC_OD_AabsYStd_Obj_19_FR : 327|8@0+ (0.25,0) [0|63.75] "m/s^2"  ADC
 SG_ ARC_OD_ClassConf_Obj_19_FR : 335|7@0+ (1,0) [0|127] "%"  ADC
 SG_ ARC_OD_DistY_Obj_18_FR : 39|12@0+ (0.0875,-179.113) [-179.113|179.2] "m"  ADC
 SG_ ARC_OD_ProbOfExist_Obj_19_FR : 328|7@0+ (1,0) [0|127] "%"  ADC
 SG_ ARC_OD_DynProp_Obj_19_FR : 346|3@0+ (1,0) [0|7] ""  ADC
 SG_ ARC_OD_Length_Obj_19_FR : 352|7@0+ (0.2,0) [0|25.4] "m"  ADC
 SG_ ARC_OD_MaintenanceState_Obj_0042 : 361|2@0+ (1,0) [0|3] ""  ADC
 SG_ ARC_OD_Width_Obj_19_FR : 375|7@0+ (0.2,0) [0|25.4] "m"  ADC
 SG_ ARC_OD_RCS_Obj_19_FR : 368|9@0+ (0.2,-51.1) [-51.1|51.1] "dBsm"  ADC
 SG_ ARC_OD_Orientation_Obj_19_FR : 391|10@0+ (0.01,-5.11) [-5.11|5.12] "rad"  ADC
 SG_ ARC_OD_LifeCycle_Obj_19_FR : 423|16@0+ (1,0) [0|65535] ""  ADC
 SG_ ARC_OD_ObstacleProb_Obj_18_FR : 447|7@0+ (1,0) [0|127] "%"  ADC
 SG_ ARC_OD_ObstacleProb_Obj_19_FR : 455|7@0+ (1,0) [0|127] "%"  ADC
 SG_ ARC_OD_VabsY_Obj_18_FR : 43|11@0+ (0.125,-128) [-128|127.875] "m/s"  ADC
 SG_ ARC_OD_ID_18_FR : 463|8@0+ (1,0) [0|255] ""  ADC
 SG_ ARC_OD_ID_19_FR : 471|8@0+ (1,0) [0|255] ""  ADC
 SG_ ARC_OD_MsgCounter_Obj_18_19_FR : 491|4@0+ (1,0) [0|15] ""  ADC
 SG_ ARC_OD_CRC8_Obj_18_19_FR : 511|8@0+ (1,0) [0|256] ""  ADC
 SG_ ARC_OD_AabsY_Obj_18_FR : 48|9@0+ (0.125,-31.875) [-31.875|32] "m/s^2"  ADC
 SG_ ARC_OD_DistXStd_Obj_18_FR : 71|8@0+ (0.05,0) [0|12.75] "m"  ADC
 SG_ ARC_OD_DistYStd_Obj_18_FR : 79|8@0+ (0.1,0) [0|25.5] "m"  ADC
 SG_ ARC_OD_VabsXStd_Obj_18_FR : 87|7@0+ (0.1,0) [0|12.7] "m/s"  ADC
 SG_ ARC_OD_VabsYStd_Obj_18_FR : 80|7@0+ (0.2,0) [0|25.4] "m/s"  ADC
 SG_ ARC_OD_AabsXStd_Obj_18_FR : 89|7@0+ (0.25,0) [0|31.75] "m/s^2"  ADC

BO_ 1369 ARC_OD_16_17_FR: 64 ARC
 SG_ DistHeight_Obj_17_FR : 487|8@0+ (0.2,-10) [-10|41] "m"  ADC
 SG_ DistHeight_Obj_16_FR : 479|8@0+ (0.2,-10) [-10|41] "m"  ADC
 SG_ ARC_OD_DistX_Obj_16_FR : 7|12@0+ (0.1,-152) [-152|257.5] "m"  ADC
 SG_ ARC_OD_Classification_Obj_16_FR : 98|3@0+ (1,0) [0|7] ""  ADC
 SG_ ARC_OD_AabsYStd_Obj_16_FR : 111|8@0+ (0.25,0) [0|63.75] "m/s^2"  ADC
 SG_ ARC_OD_ClassConf_Obj_16_FR : 119|7@0+ (1,0) [0|127] "%"  ADC
 SG_ ARC_OD_ProbOfExist_Obj_16_FR : 112|7@0+ (1,0) [0|127] "%"  ADC
 SG_ ARC_OD_VabsX_Obj_16_FR : 11|11@0+ (0.125,-128) [-128|127.875] "m/s"  ADC
 SG_ ARC_OD_DynProp_Obj_16_FR : 130|3@0+ (1,0) [0|7] ""  ADC
 SG_ ARC_OD_Length_Obj_16_FR : 136|7@0+ (0.2,0) [0|25.4] "m"  ADC
 SG_ ARC_OD_MaintenanceState_Obj_0043 : 145|2@0+ (1,0) [0|3] ""  ADC
 SG_ ARC_OD_Width_Obj_16_FR : 159|7@0+ (0.2,0) [0|25.4] "m"  ADC
 SG_ ARC_OD_RCS_Obj_16_FR : 152|9@0+ (0.2,-51.1) [-51.1|51.1] "dBsm"  ADC
 SG_ ARC_OD_Orientation_Obj_16_FR : 175|10@0+ (0.01,-5.11) [-5.11|5.12] "rad"  ADC
 SG_ ARC_OD_LifeCycle_Obj_16_FR : 207|16@0+ (1,0) [0|65535] ""  ADC
 SG_ ARC_OD_DistX_Obj_17_FR : 223|12@0+ (0.1,-152) [-152|257.5] "m"  ADC
 SG_ ARC_OD_VabsX_Obj_17_FR : 227|11@0+ (0.125,-128) [-128|127.875] "m/s"  ADC
 SG_ ARC_OD_AabsX_Obj_17_FR : 232|9@0+ (0.125,-31.875) [-31.875|32] "m/s^2"  ADC
 SG_ ARC_OD_AabsX_Obj_16_FR : 16|9@0+ (0.125,-31.875) [-31.875|32] "m/s^2"  ADC
 SG_ ARC_OD_DistY_Obj_17_FR : 255|12@0+ (0.0875,-179.113) [-179.113|179.2] "m"  ADC
 SG_ ARC_OD_VabsY_Obj_17_FR : 259|11@0+ (0.125,-128) [-128|127.875] "m/s"  ADC
 SG_ ARC_OD_AabsY_Obj_17_FR : 264|9@0+ (0.125,-31.875) [-31.875|32] "m/s^2"  ADC
 SG_ ARC_OD_DistXStd_Obj_17_FR : 287|8@0+ (0.05,0) [0|12.75] "m"  ADC
 SG_ ARC_OD_DistYStd_Obj_17_FR : 295|8@0+ (0.1,0) [0|25.5] "m"  ADC
 SG_ ARC_OD_VabsXStd_Obj_17_FR : 303|7@0+ (0.1,0) [0|12.7] "m/s"  ADC
 SG_ ARC_OD_VabsYStd_Obj_17_FR : 296|7@0+ (0.2,0) [0|25.4] "m/s"  ADC
 SG_ ARC_OD_AabsXStd_Obj_17_FR : 305|7@0+ (0.25,0) [0|31.75] "m/s^2"  ADC
 SG_ ARC_OD_Classification_Obj_17_FR : 314|3@0+ (1,0) [0|7] ""  ADC
 SG_ ARC_OD_AabsYStd_Obj_17_FR : 327|8@0+ (0.25,0) [0|63.75] "m/s^2"  ADC
 SG_ ARC_OD_ClassConf_Obj_17_FR : 335|7@0+ (1,0) [0|127] "%"  ADC
 SG_ ARC_OD_DistY_Obj_16_FR : 39|12@0+ (0.0875,-179.113) [-179.113|179.2] "m"  ADC
 SG_ ARC_OD_ProbOfExist_Obj_17_FR : 328|7@0+ (1,0) [0|127] "%"  ADC
 SG_ ARC_OD_DynProp_Obj_17_FR : 346|3@0+ (1,0) [0|7] ""  ADC
 SG_ ARC_OD_Length_Obj_17_FR : 352|7@0+ (0.2,0) [0|25.4] "m"  ADC
 SG_ ARC_OD_MaintenanceState_Obj_0044 : 361|2@0+ (1,0) [0|3] ""  ADC
 SG_ ARC_OD_Width_Obj_17_FR : 375|7@0+ (0.2,0) [0|25.4] "m"  ADC
 SG_ ARC_OD_RCS_Obj_17_FR : 368|9@0+ (0.2,-51.1) [-51.1|51.1] "dBsm"  ADC
 SG_ ARC_OD_Orientation_Obj_17_FR : 391|10@0+ (0.01,-5.11) [-5.11|5.12] "rad"  ADC
 SG_ ARC_OD_LifeCycle_Obj_17_FR : 423|16@0+ (1,0) [0|65535] ""  ADC
 SG_ ARC_OD_ObstacleProb_Obj_16_FR : 447|7@0+ (1,0) [0|127] "%"  ADC
 SG_ ARC_OD_ObstacleProb_Obj_17_FR : 455|7@0+ (1,0) [0|127] "%"  ADC
 SG_ ARC_OD_VabsY_Obj_16_FR : 43|11@0+ (0.125,-128) [-128|127.875] "m/s"  ADC
 SG_ ARC_OD_ID_16_FR : 463|8@0+ (1,0) [0|255] ""  ADC
 SG_ ARC_OD_ID_17_FR : 471|8@0+ (1,0) [0|255] ""  ADC
 SG_ ARC_OD_MsgCounter_Obj_16_17_FR : 491|4@0+ (1,0) [0|15] ""  ADC
 SG_ ARC_OD_CRC8_Obj_16_17_FR : 511|8@0+ (1,0) [0|256] ""  ADC
 SG_ ARC_OD_AabsY_Obj_16_FR : 48|9@0+ (0.125,-31.875) [-31.875|32] "m/s^2"  ADC
 SG_ ARC_OD_DistXStd_Obj_16_FR : 71|8@0+ (0.05,0) [0|12.75] "m"  ADC
 SG_ ARC_OD_DistYStd_Obj_16_FR : 79|8@0+ (0.1,0) [0|25.5] "m"  ADC
 SG_ ARC_OD_VabsXStd_Obj_16_FR : 87|7@0+ (0.1,0) [0|12.7] "m/s"  ADC
 SG_ ARC_OD_VabsYStd_Obj_16_FR : 80|7@0+ (0.2,0) [0|25.4] "m/s"  ADC
 SG_ ARC_OD_AabsXStd_Obj_16_FR : 89|7@0+ (0.25,0) [0|31.75] "m/s^2"  ADC

BO_ 1368 ARC_OD_14_15_FR: 64 ARC
 SG_ DistHeight_Obj_15_FR : 487|8@0+ (0.2,-10) [-10|41] "m"  ADC
 SG_ DistHeight_Obj_14_FR : 479|8@0+ (0.2,-10) [-10|41] "m"  ADC
 SG_ ARC_OD_DistX_Obj_14_FR : 7|12@0+ (0.1,-152) [-152|257.5] "m"  ADC
 SG_ ARC_OD_Classification_Obj_14_FR : 98|3@0+ (1,0) [0|7] ""  ADC
 SG_ ARC_OD_AabsYStd_Obj_14_FR : 111|8@0+ (0.25,0) [0|63.75] "m/s^2"  ADC
 SG_ ARC_OD_ClassConf_Obj_14_FR : 119|7@0+ (1,0) [0|127] "%"  ADC
 SG_ ARC_OD_ProbOfExist_Obj_14_FR : 112|7@0+ (1,0) [0|127] "%"  ADC
 SG_ ARC_OD_VabsX_Obj_14_FR : 11|11@0+ (0.125,-128) [-128|127.875] "m/s"  ADC
 SG_ ARC_OD_DynProp_Obj_14_FR : 130|3@0+ (1,0) [0|7] ""  ADC
 SG_ ARC_OD_Length_Obj_14_FR : 136|7@0+ (0.2,0) [0|25.4] "m"  ADC
 SG_ ARC_OD_MaintenanceState_Obj_0045 : 145|2@0+ (1,0) [0|3] ""  ADC
 SG_ ARC_OD_Width_Obj_14_FR : 159|7@0+ (0.2,0) [0|25.4] "m"  ADC
 SG_ ARC_OD_RCS_Obj_14_FR : 152|9@0+ (0.2,-51.1) [-51.1|51.1] "dBsm"  ADC
 SG_ ARC_OD_Orientation_Obj_14_FR : 175|10@0+ (0.01,-5.11) [-5.11|5.12] "rad"  ADC
 SG_ ARC_OD_LifeCycle_Obj_14_FR : 207|16@0+ (1,0) [0|65535] ""  ADC
 SG_ ARC_OD_DistX_Obj_15_FR : 223|12@0+ (0.1,-152) [-152|257.5] "m"  ADC
 SG_ ARC_OD_VabsX_Obj_15_FR : 227|11@0+ (0.125,-128) [-128|127.875] "m/s"  ADC
 SG_ ARC_OD_AabsX_Obj_15_FR : 232|9@0+ (0.125,-31.875) [-31.875|32] "m/s^2"  ADC
 SG_ ARC_OD_AabsX_Obj_14_FR : 16|9@0+ (0.125,-31.875) [-31.875|32] "m/s^2"  ADC
 SG_ ARC_OD_DistY_Obj_15_FR : 255|12@0+ (0.0875,-179.113) [-179.113|179.2] "m"  ADC
 SG_ ARC_OD_VabsY_Obj_15_FR : 259|11@0+ (0.125,-128) [-128|127.875] "m/s"  ADC
 SG_ ARC_OD_AabsY_Obj_15_FR : 264|9@0+ (0.125,-31.875) [-31.875|32] "m/s^2"  ADC
 SG_ ARC_OD_DistXStd_Obj_15_FR : 287|8@0+ (0.05,0) [0|12.75] "m"  ADC
 SG_ ARC_OD_DistYStd_Obj_15_FR : 295|8@0+ (0.1,0) [0|25.5] "m"  ADC
 SG_ ARC_OD_VabsXStd_Obj_15_FR : 303|7@0+ (0.1,0) [0|12.7] "m/s"  ADC
 SG_ ARC_OD_VabsYStd_Obj_15_FR : 296|7@0+ (0.2,0) [0|25.4] "m/s"  ADC
 SG_ ARC_OD_AabsXStd_Obj_15_FR : 305|7@0+ (0.25,0) [0|31.75] "m/s^2"  ADC
 SG_ ARC_OD_Classification_Obj_15_FR : 314|3@0+ (1,0) [0|7] ""  ADC
 SG_ ARC_OD_AabsYStd_Obj_15_FR : 327|8@0+ (0.25,0) [0|63.75] "m/s^2"  ADC
 SG_ ARC_OD_ClassConf_Obj_15_FR : 335|7@0+ (1,0) [0|127] "%"  ADC
 SG_ ARC_OD_DistY_Obj_14_FR : 39|12@0+ (0.0875,-179.113) [-179.113|179.2] "m"  ADC
 SG_ ARC_OD_ProbOfExist_Obj_15_FR : 328|7@0+ (1,0) [0|127] "%"  ADC
 SG_ ARC_OD_DynProp_Obj_15_FR : 346|3@0+ (1,0) [0|7] ""  ADC
 SG_ ARC_OD_Length_Obj_15_FR : 352|7@0+ (0.2,0) [0|25.4] "m"  ADC
 SG_ ARC_OD_MaintenanceState_Obj_0046 : 361|2@0+ (1,0) [0|3] ""  ADC
 SG_ ARC_OD_Width_Obj_15_FR : 375|7@0+ (0.2,0) [0|25.4] "m"  ADC
 SG_ ARC_OD_RCS_Obj_15_FR : 368|9@0+ (0.2,-51.1) [-51.1|51.1] "dBsm"  ADC
 SG_ ARC_OD_Orientation_Obj_15_FR : 391|10@0+ (0.01,-5.11) [-5.11|5.12] "rad"  ADC
 SG_ ARC_OD_LifeCycle_Obj_15_FR : 423|16@0+ (1,0) [0|65535] ""  ADC
 SG_ ARC_OD_ObstacleProb_Obj_14_FR : 447|7@0+ (1,0) [0|127] "%"  ADC
 SG_ ARC_OD_ObstacleProb_Obj_15_FR : 455|7@0+ (1,0) [0|127] "%"  ADC
 SG_ ARC_OD_VabsY_Obj_14_FR : 43|11@0+ (0.125,-128) [-128|127.875] "m/s"  ADC
 SG_ ARC_OD_ID_14_FR : 463|8@0+ (1,0) [0|255] ""  ADC
 SG_ ARC_OD_ID_15_FR : 471|8@0+ (1,0) [0|255] ""  ADC
 SG_ ARC_OD_MsgCounter_Obj_14_15_FR : 491|4@0+ (1,0) [0|15] ""  ADC
 SG_ ARC_OD_CRC8_Obj_14_15_FR : 511|8@0+ (1,0) [0|256] ""  ADC
 SG_ ARC_OD_AabsY_Obj_14_FR : 48|9@0+ (0.125,-31.875) [-31.875|32] "m/s^2"  ADC
 SG_ ARC_OD_DistXStd_Obj_14_FR : 71|8@0+ (0.05,0) [0|12.75] "m"  ADC
 SG_ ARC_OD_DistYStd_Obj_14_FR : 79|8@0+ (0.1,0) [0|25.5] "m"  ADC
 SG_ ARC_OD_VabsXStd_Obj_14_FR : 87|7@0+ (0.1,0) [0|12.7] "m/s"  ADC
 SG_ ARC_OD_VabsYStd_Obj_14_FR : 80|7@0+ (0.2,0) [0|25.4] "m/s"  ADC
 SG_ ARC_OD_AabsXStd_Obj_14_FR : 89|7@0+ (0.25,0) [0|31.75] "m/s^2"  ADC

BO_ 1367 ARC_OD_12_13_FR: 64 ARC
 SG_ DistHeight_Obj_13_FR : 487|8@0+ (0.2,-10) [-10|41] "m"  ADC
 SG_ DistHeight_Obj_12_FR : 479|8@0+ (0.2,-10) [-10|41] "m"  ADC
 SG_ ARC_OD_DistX_Obj_12_FR : 7|12@0+ (0.1,-152) [-152|257.5] "m"  ADC
 SG_ ARC_OD_Classification_Obj_12_FR : 98|3@0+ (1,0) [0|7] ""  ADC
 SG_ ARC_OD_AabsYStd_Obj_12_FR : 111|8@0+ (0.25,0) [0|63.75] "m/s^2"  ADC
 SG_ ARC_OD_ClassConf_Obj_12_FR : 119|7@0+ (1,0) [0|127] "%"  ADC
 SG_ ARC_OD_ProbOfExist_Obj_12_FR : 112|7@0+ (1,0) [0|127] "%"  ADC
 SG_ ARC_OD_VabsX_Obj_12_FR : 11|11@0+ (0.125,-128) [-128|127.875] "m/s"  ADC
 SG_ ARC_OD_DynProp_Obj_12_FR : 130|3@0+ (1,0) [0|7] ""  ADC
 SG_ ARC_OD_Length_Obj_12_FR : 136|7@0+ (0.2,0) [0|25.4] "m"  ADC
 SG_ ARC_OD_MaintenanceState_Obj_0047 : 145|2@0+ (1,0) [0|3] ""  ADC
 SG_ ARC_OD_Width_Obj_12_FR : 159|7@0+ (0.2,0) [0|25.4] "m"  ADC
 SG_ ARC_OD_RCS_Obj_12_FR : 152|9@0+ (0.2,-51.1) [-51.1|51.1] "dBsm"  ADC
 SG_ ARC_OD_Orientation_Obj_12_FR : 175|10@0+ (0.01,-5.11) [-5.11|5.12] "rad"  ADC
 SG_ ARC_OD_LifeCycle_Obj_12_FR : 207|16@0+ (1,0) [0|65535] ""  ADC
 SG_ ARC_OD_DistX_Obj_13_FR : 223|12@0+ (0.1,-152) [-152|257.5] "m"  ADC
 SG_ ARC_OD_VabsX_Obj_13_FR : 227|11@0+ (0.125,-128) [-128|127.875] "m/s"  ADC
 SG_ ARC_OD_AabsX_Obj_13_FR : 232|9@0+ (0.125,-31.875) [-31.875|32] "m/s^2"  ADC
 SG_ ARC_OD_AabsX_Obj_12_FR : 16|9@0+ (0.125,-31.875) [-31.875|32] "m/s^2"  ADC
 SG_ ARC_OD_DistY_Obj_13_FR : 255|12@0+ (0.0875,-179.113) [-179.113|179.2] "m"  ADC
 SG_ ARC_OD_VabsY_Obj_13_FR : 259|11@0+ (0.125,-128) [-128|127.875] "m/s"  ADC
 SG_ ARC_OD_AabsY_Obj_13_FR : 264|9@0+ (0.125,-31.875) [-31.875|32] "m/s^2"  ADC
 SG_ ARC_OD_DistXStd_Obj_13_FR : 287|8@0+ (0.05,0) [0|12.75] "m"  ADC
 SG_ ARC_OD_DistYStd_Obj_13_FR : 295|8@0+ (0.1,0) [0|25.5] "m"  ADC
 SG_ ARC_OD_VabsXStd_Obj_13_FR : 303|7@0+ (0.1,0) [0|12.7] "m/s"  ADC
 SG_ ARC_OD_VabsYStd_Obj_13_FR : 296|7@0+ (0.2,0) [0|25.4] "m/s"  ADC
 SG_ ARC_OD_AabsXStd_Obj_13_FR : 305|7@0+ (0.25,0) [0|31.75] "m/s^2"  ADC
 SG_ ARC_OD_Classification_Obj_13_FR : 314|3@0+ (1,0) [0|7] ""  ADC
 SG_ ARC_OD_AabsYStd_Obj_13_FR : 327|8@0+ (0.25,0) [0|63.75] "m/s^2"  ADC
 SG_ ARC_OD_ClassConf_Obj_13_FR : 335|7@0+ (1,0) [0|127] "%"  ADC
 SG_ ARC_OD_DistY_Obj_12_FR : 39|12@0+ (0.0875,-179.113) [-179.113|179.2] "m"  ADC
 SG_ ARC_OD_ProbOfExist_Obj_13_FR : 328|7@0+ (1,0) [0|127] "%"  ADC
 SG_ ARC_OD_DynProp_Obj_13_FR : 346|3@0+ (1,0) [0|7] ""  ADC
 SG_ ARC_OD_Length_Obj_13_FR : 352|7@0+ (0.2,0) [0|25.4] "m"  ADC
 SG_ ARC_OD_MaintenanceState_Obj_0048 : 361|2@0+ (1,0) [0|3] ""  ADC
 SG_ ARC_OD_Width_Obj_13_FR : 375|7@0+ (0.2,0) [0|25.4] "m"  ADC
 SG_ ARC_OD_RCS_Obj_13_FR : 368|9@0+ (0.2,-51.1) [-51.1|51.1] "dBsm"  ADC
 SG_ ARC_OD_Orientation_Obj_13_FR : 391|10@0+ (0.01,-5.11) [-5.11|5.12] "rad"  ADC
 SG_ ARC_OD_LifeCycle_Obj_13_FR : 423|16@0+ (1,0) [0|65535] ""  ADC
 SG_ ARC_OD_ObstacleProb_Obj_12_FR : 447|7@0+ (1,0) [0|127] "%"  ADC
 SG_ ARC_OD_ObstacleProb_Obj_13_FR : 455|7@0+ (1,0) [0|127] "%"  ADC
 SG_ ARC_OD_VabsY_Obj_12_FR : 43|11@0+ (0.125,-128) [-128|127.875] "m/s"  ADC
 SG_ ARC_OD_ID_12_FR : 463|8@0+ (1,0) [0|255] ""  ADC
 SG_ ARC_OD_ID_13_FR : 471|8@0+ (1,0) [0|255] ""  ADC
 SG_ ARC_OD_MsgCounter_Obj_12_13_FR : 491|4@0+ (1,0) [0|15] ""  ADC
 SG_ ARC_OD_CRC8_Obj_12_13_FR : 511|8@0+ (1,0) [0|256] ""  ADC
 SG_ ARC_OD_AabsY_Obj_12_FR : 48|9@0+ (0.125,-31.875) [-31.875|32] "m/s^2"  ADC
 SG_ ARC_OD_DistXStd_Obj_12_FR : 71|8@0+ (0.05,0) [0|12.75] "m"  ADC
 SG_ ARC_OD_DistYStd_Obj_12_FR : 79|8@0+ (0.1,0) [0|25.5] "m"  ADC
 SG_ ARC_OD_VabsXStd_Obj_12_FR : 87|7@0+ (0.1,0) [0|12.7] "m/s"  ADC
 SG_ ARC_OD_VabsYStd_Obj_12_FR : 80|7@0+ (0.2,0) [0|25.4] "m/s"  ADC
 SG_ ARC_OD_AabsXStd_Obj_12_FR : 89|7@0+ (0.25,0) [0|31.75] "m/s^2"  ADC

BO_ 1366 ARC_OD_10_11_FR: 64 ARC
 SG_ DistHeight_Obj_11_FR : 487|8@0+ (0.2,-10) [-10|41] "m"  ADC
 SG_ DistHeight_Obj_10_FR : 479|8@0+ (0.2,-10) [-10|41] "m"  ADC
 SG_ ARC_OD_DistX_Obj_10_FR : 7|12@0+ (0.1,-152) [-152|257.5] "m"  ADC
 SG_ ARC_OD_Classification_Obj_10_FR : 98|3@0+ (1,0) [0|7] ""  ADC
 SG_ ARC_OD_AabsYStd_Obj_10_FR : 111|8@0+ (0.25,0) [0|63.75] "m/s^2"  ADC
 SG_ ARC_OD_ClassConf_Obj_10_FR : 119|7@0+ (1,0) [0|127] "%"  ADC
 SG_ ARC_OD_ProbOfExist_Obj_10_FR : 112|7@0+ (1,0) [0|127] "%"  ADC
 SG_ ARC_OD_VabsX_Obj_10_FR : 11|11@0+ (0.125,-128) [-128|127.875] "m/s"  ADC
 SG_ ARC_OD_DynProp_Obj_10_FR : 130|3@0+ (1,0) [0|7] ""  ADC
 SG_ ARC_OD_Length_Obj_10_FR : 136|7@0+ (0.2,0) [0|25.4] "m"  ADC
 SG_ ARC_OD_MaintenanceState_Obj_0049 : 145|2@0+ (1,0) [0|3] ""  ADC
 SG_ ARC_OD_Width_Obj_10_FR : 159|7@0+ (0.2,0) [0|25.4] "m"  ADC
 SG_ ARC_OD_RCS_Obj_10_FR : 152|9@0+ (0.2,-51.1) [-51.1|51.1] "dBsm"  ADC
 SG_ ARC_OD_Orientation_Obj_10_FR : 175|10@0+ (0.01,-5.11) [-5.11|5.12] "rad"  ADC
 SG_ ARC_OD_LifeCycle_Obj_10_FR : 207|16@0+ (1,0) [0|65535] ""  ADC
 SG_ ARC_OD_DistX_Obj_11_FR : 223|12@0+ (0.1,-152) [-152|257.5] "m"  ADC
 SG_ ARC_OD_VabsX_Obj_11_FR : 227|11@0+ (0.125,-128) [-128|127.875] "m/s"  ADC
 SG_ ARC_OD_AabsX_Obj_11_FR : 232|9@0+ (0.125,-31.875) [-31.875|32] "m/s^2"  ADC
 SG_ ARC_OD_AabsX_Obj_10_FR : 16|9@0+ (0.125,-31.875) [-31.875|32] "m/s^2"  ADC
 SG_ ARC_OD_DistY_Obj_11_FR : 255|12@0+ (0.0875,-179.113) [-179.113|179.2] "m"  ADC
 SG_ ARC_OD_VabsY_Obj_11_FR : 259|11@0+ (0.125,-128) [-128|127.875] "m/s"  ADC
 SG_ ARC_OD_AabsY_Obj_11_FR : 264|9@0+ (0.125,-31.875) [-31.875|32] "m/s^2"  ADC
 SG_ ARC_OD_DistXStd_Obj_11_FR : 287|8@0+ (0.05,0) [0|12.75] "m"  ADC
 SG_ ARC_OD_DistYStd_Obj_11_FR : 295|8@0+ (0.1,0) [0|25.5] "m"  ADC
 SG_ ARC_OD_VabsXStd_Obj_11_FR : 303|7@0+ (0.1,0) [0|12.7] "m/s"  ADC
 SG_ ARC_OD_VabsYStd_Obj_11_FR : 296|7@0+ (0.2,0) [0|25.4] "m/s"  ADC
 SG_ ARC_OD_AabsXStd_Obj_11_FR : 305|7@0+ (0.25,0) [0|31.75] "m/s^2"  ADC
 SG_ ARC_OD_Classification_Obj_11_FR : 314|3@0+ (1,0) [0|7] ""  ADC
 SG_ ARC_OD_AabsYStd_Obj_11_FR : 327|8@0+ (0.25,0) [0|63.75] "m/s^2"  ADC
 SG_ ARC_OD_ClassConf_Obj_11_FR : 335|7@0+ (1,0) [0|127] "%"  ADC
 SG_ ARC_OD_DistY_Obj_10_FR : 39|12@0+ (0.0875,-179.113) [-179.113|179.2] "m"  ADC
 SG_ ARC_OD_ProbOfExist_Obj_11_FR : 328|7@0+ (1,0) [0|127] "%"  ADC
 SG_ ARC_OD_DynProp_Obj_11_FR : 346|3@0+ (1,0) [0|7] ""  ADC
 SG_ ARC_OD_Length_Obj_11_FR : 352|7@0+ (0.2,0) [0|25.4] "m"  ADC
 SG_ ARC_OD_MaintenanceState_Obj_0050 : 361|2@0+ (1,0) [0|3] ""  ADC
 SG_ ARC_OD_Width_Obj_11_FR : 375|7@0+ (0.2,0) [0|25.4] "m"  ADC
 SG_ ARC_OD_RCS_Obj_11_FR : 368|9@0+ (0.2,-51.1) [-51.1|51.1] "dBsm"  ADC
 SG_ ARC_OD_Orientation_Obj_11_FR : 391|10@0+ (0.01,-5.11) [-5.11|5.12] "rad"  ADC
 SG_ ARC_OD_LifeCycle_Obj_11_FR : 423|16@0+ (1,0) [0|65535] ""  ADC
 SG_ ARC_OD_ObstacleProb_Obj_10_FR : 447|7@0+ (1,0) [0|127] "%"  ADC
 SG_ ARC_OD_ObstacleProb_Obj_11_FR : 455|7@0+ (1,0) [0|127] "%"  ADC
 SG_ ARC_OD_VabsY_Obj_10_FR : 43|11@0+ (0.125,-128) [-128|127.875] "m/s"  ADC
 SG_ ARC_OD_ID_10_FR : 463|8@0+ (1,0) [0|255] ""  ADC
 SG_ ARC_OD_ID_11_FR : 471|8@0+ (1,0) [0|255] ""  ADC
 SG_ ARC_OD_MsgCounter_Obj_10_11_FR : 491|4@0+ (1,0) [0|15] ""  ADC
 SG_ ARC_OD_CRC8_Obj_10_11_FR : 511|8@0+ (1,0) [0|256] ""  ADC
 SG_ ARC_OD_AabsY_Obj_10_FR : 48|9@0+ (0.125,-31.875) [-31.875|32] "m/s^2"  ADC
 SG_ ARC_OD_DistXStd_Obj_10_FR : 71|8@0+ (0.05,0) [0|12.75] "m"  ADC
 SG_ ARC_OD_DistYStd_Obj_10_FR : 79|8@0+ (0.1,0) [0|25.5] "m"  ADC
 SG_ ARC_OD_VabsXStd_Obj_10_FR : 87|7@0+ (0.1,0) [0|12.7] "m/s"  ADC
 SG_ ARC_OD_VabsYStd_Obj_10_FR : 80|7@0+ (0.2,0) [0|25.4] "m/s"  ADC
 SG_ ARC_OD_AabsXStd_Obj_10_FR : 89|7@0+ (0.25,0) [0|31.75] "m/s^2"  ADC

BO_ 1365 ARC_OD_08_09_FR: 64 ARC
 SG_ DistHeight_Obj_09_FR : 487|8@0+ (0.2,-10) [-10|41] "m"  ADC
 SG_ DistHeight_Obj_08_FR : 479|8@0+ (0.2,-10) [-10|41] "m"  ADC
 SG_ ARC_OD_DistX_Obj_08_FR : 7|12@0+ (0.1,-152) [-152|257.5] "m"  ADC
 SG_ ARC_OD_Classification_Obj_08_FR : 98|3@0+ (1,0) [0|7] ""  ADC
 SG_ ARC_OD_AabsYStd_Obj_08_FR : 111|8@0+ (0.25,0) [0|63.75] "m/s^2"  ADC
 SG_ ARC_OD_ClassConf_Obj_08_FR : 119|7@0+ (1,0) [0|127] "%"  ADC
 SG_ ARC_OD_ProbOfExist_Obj_08_FR : 112|7@0+ (1,0) [0|127] "%"  ADC
 SG_ ARC_OD_VabsX_Obj_08_FR : 11|11@0+ (0.125,-128) [-128|127.875] "m/s"  ADC
 SG_ ARC_OD_DynProp_Obj_08_FR : 130|3@0+ (1,0) [0|7] ""  ADC
 SG_ ARC_OD_Length_Obj_08_FR : 136|7@0+ (0.2,0) [0|25.4] "m"  ADC
 SG_ ARC_OD_MaintenanceState_Obj_0051 : 145|2@0+ (1,0) [0|3] ""  ADC
 SG_ ARC_OD_Width_Obj_08_FR : 159|7@0+ (0.2,0) [0|25.4] "m"  ADC
 SG_ ARC_OD_RCS_Obj_08_FR : 152|9@0+ (0.2,-51.1) [-51.1|51.1] "dBsm"  ADC
 SG_ ARC_OD_Orientation_Obj_08_FR : 175|10@0+ (0.01,-5.11) [-5.11|5.12] "rad"  ADC
 SG_ ARC_OD_LifeCycle_Obj_08_FR : 207|16@0+ (1,0) [0|65535] ""  ADC
 SG_ ARC_OD_DistX_Obj_09_FR : 223|12@0+ (0.1,-152) [-152|257.5] "m"  ADC
 SG_ ARC_OD_VabsX_Obj_09_FR : 227|11@0+ (0.125,-128) [-128|127.875] "m/s"  ADC
 SG_ ARC_OD_AabsX_Obj_09_FR : 232|9@0+ (0.125,-31.875) [-31.875|32] "m/s^2"  ADC
 SG_ ARC_OD_AabsX_Obj_08_FR : 16|9@0+ (0.125,-31.875) [-31.875|32] "m/s^2"  ADC
 SG_ ARC_OD_DistY_Obj_09_FR : 255|12@0+ (0.0875,-179.113) [-179.113|179.2] "m"  ADC
 SG_ ARC_OD_VabsY_Obj_09_FR : 259|11@0+ (0.125,-128) [-128|127.875] "m/s"  ADC
 SG_ ARC_OD_AabsY_Obj_09_FR : 264|9@0+ (0.125,-31.875) [-31.875|32] "m/s^2"  ADC
 SG_ ARC_OD_DistXStd_Obj_09_FR : 287|8@0+ (0.05,0) [0|12.75] "m"  ADC
 SG_ ARC_OD_DistYStd_Obj_09_FR : 295|8@0+ (0.1,0) [0|25.5] "m"  ADC
 SG_ ARC_OD_VabsXStd_Obj_09_FR : 303|7@0+ (0.1,0) [0|12.7] "m/s"  ADC
 SG_ ARC_OD_VabsYStd_Obj_09_FR : 296|7@0+ (0.2,0) [0|25.4] "m/s"  ADC
 SG_ ARC_OD_AabsXStd_Obj_09_FR : 305|7@0+ (0.25,0) [0|31.75] "m/s^2"  ADC
 SG_ ARC_OD_Classification_Obj_09_FR : 314|3@0+ (1,0) [0|7] ""  ADC
 SG_ ARC_OD_AabsYStd_Obj_09_FR : 327|8@0+ (0.25,0) [0|63.75] "m/s^2"  ADC
 SG_ ARC_OD_ClassConf_Obj_09_FR : 335|7@0+ (1,0) [0|127] "%"  ADC
 SG_ ARC_OD_DistY_Obj_08_FR : 39|12@0+ (0.0875,-179.113) [-179.113|179.2] "m"  ADC
 SG_ ARC_OD_ProbOfExist_Obj_09_FR : 328|7@0+ (1,0) [0|127] "%"  ADC
 SG_ ARC_OD_DynProp_Obj_09_FR : 346|3@0+ (1,0) [0|7] ""  ADC
 SG_ ARC_OD_Length_Obj_09_FR : 352|7@0+ (0.2,0) [0|25.4] "m"  ADC
 SG_ ARC_OD_MaintenanceState_Obj_0052 : 361|2@0+ (1,0) [0|3] ""  ADC
 SG_ ARC_OD_Width_Obj_09_FR : 375|7@0+ (0.2,0) [0|25.4] "m"  ADC
 SG_ ARC_OD_RCS_Obj_09_FR : 368|9@0+ (0.2,-51.1) [-51.1|51.1] "dBsm"  ADC
 SG_ ARC_OD_Orientation_Obj_09_FR : 391|10@0+ (0.01,-5.11) [-5.11|5.12] "rad"  ADC
 SG_ ARC_OD_LifeCycle_Obj_09_FR : 423|16@0+ (1,0) [0|65535] ""  ADC
 SG_ ARC_OD_ObstacleProb_Obj_08_FR : 447|7@0+ (1,0) [0|127] "%"  ADC
 SG_ ARC_OD_ObstacleProb_Obj_09_FR : 455|7@0+ (1,0) [0|127] "%"  ADC
 SG_ ARC_OD_VabsY_Obj_08_FR : 43|11@0+ (0.125,-128) [-128|127.875] "m/s"  ADC
 SG_ ARC_OD_ID_08_FR : 463|8@0+ (1,0) [0|255] ""  ADC
 SG_ ARC_OD_ID_09_FR : 471|8@0+ (1,0) [0|255] ""  ADC
 SG_ ARC_OD_MsgCounter_Obj_08_09_FR : 491|4@0+ (1,0) [0|15] ""  ADC
 SG_ ARC_OD_CRC8_Obj_08_09_FR : 511|8@0+ (1,0) [0|256] ""  ADC
 SG_ ARC_OD_AabsY_Obj_08_FR : 48|9@0+ (0.125,-31.875) [-31.875|32] "m/s^2"  ADC
 SG_ ARC_OD_DistXStd_Obj_08_FR : 71|8@0+ (0.05,0) [0|12.75] "m"  ADC
 SG_ ARC_OD_DistYStd_Obj_08_FR : 79|8@0+ (0.1,0) [0|25.5] "m"  ADC
 SG_ ARC_OD_VabsXStd_Obj_08_FR : 87|7@0+ (0.1,0) [0|12.7] "m/s"  ADC
 SG_ ARC_OD_VabsYStd_Obj_08_FR : 80|7@0+ (0.2,0) [0|25.4] "m/s"  ADC
 SG_ ARC_OD_AabsXStd_Obj_08_FR : 89|7@0+ (0.25,0) [0|31.75] "m/s^2"  ADC

BO_ 1364 ARC_OD_06_07_FR: 64 ARC
 SG_ DistHeight_Obj_07_FR : 487|8@0+ (0.2,-10) [-10|41] "m"  ADC
 SG_ DistHeight_Obj_06_FR : 479|8@0+ (0.2,-10) [-10|41] "m"  ADC
 SG_ ARC_OD_DistX_Obj_06_FR : 7|12@0+ (0.1,-152) [-152|257.5] "m"  ADC
 SG_ ARC_OD_Classification_Obj_06_FR : 98|3@0+ (1,0) [0|7] ""  ADC
 SG_ ARC_OD_AabsYStd_Obj_06_FR : 111|8@0+ (0.25,0) [0|63.75] "m/s^2"  ADC
 SG_ ARC_OD_ClassConf_Obj_06_FR : 119|7@0+ (1,0) [0|127] "%"  ADC
 SG_ ARC_OD_ProbOfExist_Obj_06_FR : 112|7@0+ (1,0) [0|127] "%"  ADC
 SG_ ARC_OD_VabsX_Obj_06_FR : 11|11@0+ (0.125,-128) [-128|127.875] "m/s"  ADC
 SG_ ARC_OD_DynProp_Obj_06_FR : 130|3@0+ (1,0) [0|7] ""  ADC
 SG_ ARC_OD_Length_Obj_06_FR : 136|7@0+ (0.2,0) [0|25.4] "m"  ADC
 SG_ ARC_OD_MaintenanceState_Obj_0053 : 145|2@0+ (1,0) [0|3] ""  ADC
 SG_ ARC_OD_Width_Obj_06_FR : 159|7@0+ (0.2,0) [0|25.4] "m"  ADC
 SG_ ARC_OD_RCS_Obj_06_FR : 152|9@0+ (0.2,-51.1) [-51.1|51.1] "dBsm"  ADC
 SG_ ARC_OD_Orientation_Obj_06_FR : 175|10@0+ (0.01,-5.11) [-5.11|5.12] "rad"  ADC
 SG_ ARC_OD_LifeCycle_Obj_06_FR : 207|16@0+ (1,0) [0|65535] ""  ADC
 SG_ ARC_OD_DistX_Obj_07_FR : 223|12@0+ (0.1,-152) [-152|257.5] "m"  ADC
 SG_ ARC_OD_VabsX_Obj_07_FR : 227|11@0+ (0.125,-128) [-128|127.875] "m/s"  ADC
 SG_ ARC_OD_AabsX_Obj_07_FR : 232|9@0+ (0.125,-31.875) [-31.875|32] "m/s^2"  ADC
 SG_ ARC_OD_AabsX_Obj_06_FR : 16|9@0+ (0.125,-31.875) [-31.875|32] "m/s^2"  ADC
 SG_ ARC_OD_DistY_Obj_07_FR : 255|12@0+ (0.0875,-179.113) [-179.113|179.2] "m"  ADC
 SG_ ARC_OD_VabsY_Obj_07_FR : 259|11@0+ (0.125,-128) [-128|127.875] "m/s"  ADC
 SG_ ARC_OD_AabsY_Obj_07_FR : 264|9@0+ (0.125,-31.875) [-31.875|32] "m/s^2"  ADC
 SG_ ARC_OD_DistXStd_Obj_07_FR : 287|8@0+ (0.05,0) [0|12.75] "m"  ADC
 SG_ ARC_OD_DistYStd_Obj_07_FR : 295|8@0+ (0.1,0) [0|25.5] "m"  ADC
 SG_ ARC_OD_VabsXStd_Obj_07_FR : 303|7@0+ (0.1,0) [0|12.7] "m/s"  ADC
 SG_ ARC_OD_VabsYStd_Obj_07_FR : 296|7@0+ (0.2,0) [0|25.4] "m/s"  ADC
 SG_ ARC_OD_AabsXStd_Obj_07_FR : 305|7@0+ (0.25,0) [0|31.75] "m/s^2"  ADC
 SG_ ARC_OD_Classification_Obj_07_FR : 314|3@0+ (1,0) [0|7] ""  ADC
 SG_ ARC_OD_AabsYStd_Obj_07_FR : 327|8@0+ (0.25,0) [0|63.75] "m/s^2"  ADC
 SG_ ARC_OD_ClassConf_Obj_07_FR : 335|7@0+ (1,0) [0|127] "%"  ADC
 SG_ ARC_OD_DistY_Obj_06_FR : 39|12@0+ (0.0875,-179.113) [-179.113|179.2] "m"  ADC
 SG_ ARC_OD_ProbOfExist_Obj_07_FR : 328|7@0+ (1,0) [0|127] "%"  ADC
 SG_ ARC_OD_DynProp_Obj_07_FR : 346|3@0+ (1,0) [0|7] ""  ADC
 SG_ ARC_OD_Length_Obj_07_FR : 352|7@0+ (0.2,0) [0|25.4] "m"  ADC
 SG_ ARC_OD_MaintenanceState_Obj_0054 : 361|2@0+ (1,0) [0|3] ""  ADC
 SG_ ARC_OD_Width_Obj_07_FR : 375|7@0+ (0.2,0) [0|25.4] "m"  ADC
 SG_ ARC_OD_RCS_Obj_07_FR : 368|9@0+ (0.2,-51.1) [-51.1|51.1] "dBsm"  ADC
 SG_ ARC_OD_Orientation_Obj_07_FR : 391|10@0+ (0.01,-5.11) [-5.11|5.12] "rad"  ADC
 SG_ ARC_OD_LifeCycle_Obj_07_FR : 423|16@0+ (1,0) [0|65535] ""  ADC
 SG_ ARC_OD_ObstacleProb_Obj_06_FR : 447|7@0+ (1,0) [0|127] "%"  ADC
 SG_ ARC_OD_ObstacleProb_Obj_07_FR : 455|7@0+ (1,0) [0|127] "%"  ADC
 SG_ ARC_OD_VabsY_Obj_06_FR : 43|11@0+ (0.125,-128) [-128|127.875] "m/s"  ADC
 SG_ ARC_OD_ID_06_FR : 463|8@0+ (1,0) [0|255] ""  ADC
 SG_ ARC_OD_ID_07_FR : 471|8@0+ (1,0) [0|255] ""  ADC
 SG_ ARC_OD_MsgCounter_Obj_06_07_FR : 491|4@0+ (1,0) [0|15] ""  ADC
 SG_ ARC_OD_CRC8_Obj_06_07_FR : 511|8@0+ (1,0) [0|256] ""  ADC
 SG_ ARC_OD_AabsY_Obj_06_FR : 48|9@0+ (0.125,-31.875) [-31.875|32] "m/s^2"  ADC
 SG_ ARC_OD_DistXStd_Obj_06_FR : 71|8@0+ (0.05,0) [0|12.75] "m"  ADC
 SG_ ARC_OD_DistYStd_Obj_06_FR : 79|8@0+ (0.1,0) [0|25.5] "m"  ADC
 SG_ ARC_OD_VabsXStd_Obj_06_FR : 87|7@0+ (0.1,0) [0|12.7] "m/s"  ADC
 SG_ ARC_OD_VabsYStd_Obj_06_FR : 80|7@0+ (0.2,0) [0|25.4] "m/s"  ADC
 SG_ ARC_OD_AabsXStd_Obj_06_FR : 89|7@0+ (0.25,0) [0|31.75] "m/s^2"  ADC

BO_ 1363 ARC_OD_04_05_FR: 64 ARC
 SG_ DistHeight_Obj_05_FR : 487|8@0+ (0.2,-10) [-10|41] "m"  ADC
 SG_ DistHeight_Obj_04_FR : 479|8@0+ (0.2,-10) [-10|41] "m"  ADC
 SG_ ARC_OD_DistX_Obj_04_FR : 7|12@0+ (0.1,-152) [-152|257.5] "m"  ADC
 SG_ ARC_OD_Classification_Obj_04_FR : 98|3@0+ (1,0) [0|7] ""  ADC
 SG_ ARC_OD_AabsYStd_Obj_04_FR : 111|8@0+ (0.25,0) [0|63.75] "m/s^2"  ADC
 SG_ ARC_OD_ClassConf_Obj_04_FR : 119|7@0+ (1,0) [0|127] "%"  ADC
 SG_ ARC_OD_ProbOfExist_Obj_04_FR : 112|7@0+ (1,0) [0|127] "%"  ADC
 SG_ ARC_OD_VabsX_Obj_04_FR : 11|11@0+ (0.125,-128) [-128|127.875] "m/s"  ADC
 SG_ ARC_OD_DynProp_Obj_04_FR : 130|3@0+ (1,0) [0|7] ""  ADC
 SG_ ARC_OD_Length_Obj_04_FR : 136|7@0+ (0.2,0) [0|25.4] "m"  ADC
 SG_ ARC_OD_MaintenanceState_Obj_0055 : 145|2@0+ (1,0) [0|3] ""  ADC
 SG_ ARC_OD_Width_Obj_04_FR : 159|7@0+ (0.2,0) [0|25.4] "m"  ADC
 SG_ ARC_OD_RCS_Obj_04_FR : 152|9@0+ (0.2,-51.1) [-51.1|51.1] "dBsm"  ADC
 SG_ ARC_OD_Orientation_Obj_04_FR : 175|10@0+ (0.01,-5.11) [-5.11|5.12] "rad"  ADC
 SG_ ARC_OD_LifeCycle_Obj_04_FR : 207|16@0+ (1,0) [0|65535] ""  ADC
 SG_ ARC_OD_DistX_Obj_05_FR : 223|12@0+ (0.1,-152) [-152|257.5] "m"  ADC
 SG_ ARC_OD_VabsX_Obj_05_FR : 227|11@0+ (0.125,-128) [-128|127.875] "m/s"  ADC
 SG_ ARC_OD_AabsX_Obj_05_FR : 232|9@0+ (0.125,-31.875) [-31.875|32] "m/s^2"  ADC
 SG_ ARC_OD_AabsX_Obj_04_FR : 16|9@0+ (0.125,-31.875) [-31.875|32] "m/s^2"  ADC
 SG_ ARC_OD_DistY_Obj_05_FR : 255|12@0+ (0.0875,-179.113) [-179.113|179.2] "m"  ADC
 SG_ ARC_OD_VabsY_Obj_05_FR : 259|11@0+ (0.125,-128) [-128|127.875] "m/s"  ADC
 SG_ ARC_OD_AabsY_Obj_05_FR : 264|9@0+ (0.125,-31.875) [-31.875|32] "m/s^2"  ADC
 SG_ ARC_OD_DistXStd_Obj_05_FR : 287|8@0+ (0.05,0) [0|12.75] "m"  ADC
 SG_ ARC_OD_DistYStd_Obj_05_FR : 295|8@0+ (0.1,0) [0|25.5] "m"  ADC
 SG_ ARC_OD_VabsXStd_Obj_05_FR : 303|7@0+ (0.1,0) [0|12.7] "m/s"  ADC
 SG_ ARC_OD_VabsYStd_Obj_05_FR : 296|7@0+ (0.2,0) [0|25.4] "m/s"  ADC
 SG_ ARC_OD_AabsXStd_Obj_05_FR : 305|7@0+ (0.25,0) [0|31.75] "m/s^2"  ADC
 SG_ ARC_OD_Classification_Obj_05_FR : 314|3@0+ (1,0) [0|7] ""  ADC
 SG_ ARC_OD_AabsYStd_Obj_05_FR : 327|8@0+ (0.25,0) [0|63.75] "m/s^2"  ADC
 SG_ ARC_OD_ClassConf_Obj_05_FR : 335|7@0+ (1,0) [0|127] "%"  ADC
 SG_ ARC_OD_DistY_Obj_04_FR : 39|12@0+ (0.0875,-179.113) [-179.113|179.2] "m"  ADC
 SG_ ARC_OD_ProbOfExist_Obj_05_FR : 328|7@0+ (1,0) [0|127] "%"  ADC
 SG_ ARC_OD_DynProp_Obj_05_FR : 346|3@0+ (1,0) [0|7] ""  ADC
 SG_ ARC_OD_Length_Obj_05_FR : 352|7@0+ (0.2,0) [0|25.4] "m"  ADC
 SG_ ARC_OD_MaintenanceState_Obj_0056 : 361|2@0+ (1,0) [0|3] ""  ADC
 SG_ ARC_OD_Width_Obj_05_FR : 375|7@0+ (0.2,0) [0|25.4] "m"  ADC
 SG_ ARC_OD_RCS_Obj_05_FR : 368|9@0+ (0.2,-51.1) [-51.1|51.1] "dBsm"  ADC
 SG_ ARC_OD_Orientation_Obj_05_FR : 391|10@0+ (0.01,-5.11) [-5.11|5.12] "rad"  ADC
 SG_ ARC_OD_LifeCycle_Obj_05_FR : 423|16@0+ (1,0) [0|65535] ""  ADC
 SG_ ARC_OD_ObstacleProb_Obj_04_FR : 447|7@0+ (1,0) [0|127] "%"  ADC
 SG_ ARC_OD_ObstacleProb_Obj_05_FR : 455|7@0+ (1,0) [0|127] "%"  ADC
 SG_ ARC_OD_VabsY_Obj_04_FR : 43|11@0+ (0.125,-128) [-128|127.875] "m/s"  ADC
 SG_ ARC_OD_ID_04_FR : 463|8@0+ (1,0) [0|255] ""  ADC
 SG_ ARC_OD_ID_05_FR : 471|8@0+ (1,0) [0|255] ""  ADC
 SG_ ARC_OD_MsgCounter_Obj_04_05_FR : 491|4@0+ (1,0) [0|15] ""  ADC
 SG_ ARC_OD_CRC8_Obj_04_05_FR : 511|8@0+ (1,0) [0|256] ""  ADC
 SG_ ARC_OD_AabsY_Obj_04_FR : 48|9@0+ (0.125,-31.875) [-31.875|32] "m/s^2"  ADC
 SG_ ARC_OD_DistXStd_Obj_04_FR : 71|8@0+ (0.05,0) [0|12.75] "m"  ADC
 SG_ ARC_OD_DistYStd_Obj_04_FR : 79|8@0+ (0.1,0) [0|25.5] "m"  ADC
 SG_ ARC_OD_VabsXStd_Obj_04_FR : 87|7@0+ (0.1,0) [0|12.7] "m/s"  ADC
 SG_ ARC_OD_VabsYStd_Obj_04_FR : 80|7@0+ (0.2,0) [0|25.4] "m/s"  ADC
 SG_ ARC_OD_AabsXStd_Obj_04_FR : 89|7@0+ (0.25,0) [0|31.75] "m/s^2"  ADC

BO_ 1362 ARC_OD_02_03_FR: 64 ARC
 SG_ DistHeight_Obj_03_FR : 487|8@0+ (0.2,-10) [-10|41] "m"  ADC
 SG_ DistHeight_Obj_02_FR : 479|8@0+ (0.2,-10) [-10|41] "m"  ADC
 SG_ ARC_OD_DistX_Obj_02_FR : 7|12@0+ (0.1,-152) [-152|257.5] "m"  ADC
 SG_ ARC_OD_Classification_Obj_02_FR : 98|3@0+ (1,0) [0|7] ""  ADC
 SG_ ARC_OD_AabsYStd_Obj_02_FR : 111|8@0+ (0.25,0) [0|63.75] "m/s^2"  ADC
 SG_ ARC_OD_ClassConf_Obj_02_FR : 119|7@0+ (1,0) [0|127] "%"  ADC
 SG_ ARC_OD_ProbOfExist_Obj_02_FR : 112|7@0+ (1,0) [0|127] "%"  ADC
 SG_ ARC_OD_VabsX_Obj_02_FR : 11|11@0+ (0.125,-128) [-128|127.875] "m/s"  ADC
 SG_ ARC_OD_DynProp_Obj_02_FR : 130|3@0+ (1,0) [0|7] ""  ADC
 SG_ ARC_OD_Length_Obj_02_FR : 136|7@0+ (0.2,0) [0|25.4] "m"  ADC
 SG_ ARC_OD_MaintenanceState_Obj_0057 : 145|2@0+ (1,0) [0|3] ""  ADC
 SG_ ARC_OD_Width_Obj_02_FR : 159|7@0+ (0.2,0) [0|25.4] "m"  ADC
 SG_ ARC_OD_RCS_Obj_02_FR : 152|9@0+ (0.2,-51.1) [-51.1|51.1] "dBsm"  ADC
 SG_ ARC_OD_Orientation_Obj_02_FR : 175|10@0+ (0.01,-5.11) [-5.11|5.12] "rad"  ADC
 SG_ ARC_OD_LifeCycle_Obj_02_FR : 207|16@0+ (1,0) [0|65535] ""  ADC
 SG_ ARC_OD_DistX_Obj_03_FR : 223|12@0+ (0.1,-152) [-152|257.5] "m"  ADC
 SG_ ARC_OD_VabsX_Obj_03_FR : 227|11@0+ (0.125,-128) [-128|127.875] "m/s"  ADC
 SG_ ARC_OD_AabsX_Obj_03_FR : 232|9@0+ (0.125,-31.875) [-31.875|32] "m/s^2"  ADC
 SG_ ARC_OD_AabsX_Obj_02_FR : 16|9@0+ (0.125,-31.875) [-31.875|32] "m/s^2"  ADC
 SG_ ARC_OD_DistY_Obj_03_FR : 255|12@0+ (0.0875,-179.113) [-179.113|179.2] "m"  ADC
 SG_ ARC_OD_VabsY_Obj_03_FR : 259|11@0+ (0.125,-128) [-128|127.875] "m/s"  ADC
 SG_ ARC_OD_AabsY_Obj_03_FR : 264|9@0+ (0.125,-31.875) [-31.875|32] "m/s^2"  ADC
 SG_ ARC_OD_DistXStd_Obj_03_FR : 287|8@0+ (0.05,0) [0|12.75] "m"  ADC
 SG_ ARC_OD_DistYStd_Obj_03_FR : 295|8@0+ (0.1,0) [0|25.5] "m"  ADC
 SG_ ARC_OD_VabsXStd_Obj_03_FR : 303|7@0+ (0.1,0) [0|12.7] "m/s"  ADC
 SG_ ARC_OD_VabsYStd_Obj_03_FR : 296|7@0+ (0.2,0) [0|25.4] "m/s"  ADC
 SG_ ARC_OD_AabsXStd_Obj_03_FR : 305|7@0+ (0.25,0) [0|31.75] "m/s^2"  ADC
 SG_ ARC_OD_Classification_Obj_03_FR : 314|3@0+ (1,0) [0|7] ""  ADC
 SG_ ARC_OD_AabsYStd_Obj_03_FR : 327|8@0+ (0.25,0) [0|63.75] "m/s^2"  ADC
 SG_ ARC_OD_ClassConf_Obj_03_FR : 335|7@0+ (1,0) [0|127] "%"  ADC
 SG_ ARC_OD_DistY_Obj_02_FR : 39|12@0+ (0.0875,-179.113) [-179.113|179.2] "m"  ADC
 SG_ ARC_OD_ProbOfExist_Obj_03_FR : 328|7@0+ (1,0) [0|127] "%"  ADC
 SG_ ARC_OD_DynProp_Obj_03_FR : 346|3@0+ (1,0) [0|7] ""  ADC
 SG_ ARC_OD_Length_Obj_03_FR : 352|7@0+ (0.2,0) [0|25.4] "m"  ADC
 SG_ ARC_OD_MaintenanceState_Obj_0058 : 361|2@0+ (1,0) [0|3] ""  ADC
 SG_ ARC_OD_Width_Obj_03_FR : 375|7@0+ (0.2,0) [0|25.4] "m"  ADC
 SG_ ARC_OD_RCS_Obj_03_FR : 368|9@0+ (0.2,-51.1) [-51.1|51.1] "dBsm"  ADC
 SG_ ARC_OD_Orientation_Obj_03_FR : 391|10@0+ (0.01,-5.11) [-5.11|5.12] "rad"  ADC
 SG_ ARC_OD_LifeCycle_Obj_03_FR : 423|16@0+ (1,0) [0|65535] ""  ADC
 SG_ ARC_OD_ObstacleProb_Obj_02_FR : 447|7@0+ (1,0) [0|127] "%"  ADC
 SG_ ARC_OD_ObstacleProb_Obj_03_FR : 455|7@0+ (1,0) [0|127] "%"  ADC
 SG_ ARC_OD_VabsY_Obj_02_FR : 43|11@0+ (0.125,-128) [-128|127.875] "m/s"  ADC
 SG_ ARC_OD_ID_02_FR : 463|8@0+ (1,0) [0|255] ""  ADC
 SG_ ARC_OD_ID_03_FR : 471|8@0+ (1,0) [0|255] ""  ADC
 SG_ ARC_OD_MsgCounter_Obj_02_03_FR : 491|4@0+ (1,0) [0|15] ""  ADC
 SG_ ARC_OD_CRC8_Obj_02_03_FR : 511|8@0+ (1,0) [0|255] ""  ADC
 SG_ ARC_OD_AabsY_Obj_02_FR : 48|9@0+ (0.125,-31.875) [-31.875|32] "m/s^2"  ADC
 SG_ ARC_OD_DistXStd_Obj_02_FR : 71|8@0+ (0.05,0) [0|12.75] "m"  ADC
 SG_ ARC_OD_DistYStd_Obj_02_FR : 79|8@0+ (0.1,0) [0|25.5] "m"  ADC
 SG_ ARC_OD_VabsXStd_Obj_02_FR : 87|7@0+ (0.1,0) [0|12.7] "m/s"  ADC
 SG_ ARC_OD_VabsYStd_Obj_02_FR : 80|7@0+ (0.2,0) [0|25.4] "m/s"  ADC
 SG_ ARC_OD_AabsXStd_Obj_02_FR : 89|7@0+ (0.25,0) [0|31.75] "m/s^2"  ADC

BO_ 1361 ARC_OD_00_01_FR: 64 ARC
 SG_ DistHeight_Obj_01_FR : 487|8@0+ (0.2,-10) [-10|41] "m"  ADC
 SG_ DistHeight_Obj_00_FR : 479|8@0+ (0.2,-10) [-10|41] "m"  ADC
 SG_ ARC_OD_DistX_Obj_00_FR : 7|12@0+ (0.1,-152) [-152|257.5] "m"  ADC
 SG_ ARC_OD_Classification_Obj_00_FR : 98|3@0+ (1,0) [0|7] ""  ADC
 SG_ ARC_OD_AabsYStd_Obj_00_FR : 111|8@0+ (0.25,0) [0|63.75] "m/s^2"  ADC
 SG_ ARC_OD_ClassConf_Obj_00_FR : 119|7@0+ (1,0) [0|127] "%"  ADC
 SG_ ARC_OD_ProbOfExist_Obj_00_FR : 112|7@0+ (1,0) [0|127] "%"  ADC
 SG_ ARC_OD_VabsX_Obj_00_FR : 11|11@0+ (0.125,-128) [-128|127.875] "m/s"  ADC
 SG_ ARC_OD_DynProp_Obj_00_FR : 130|3@0+ (1,0) [0|7] ""  ADC
 SG_ ARC_OD_Length_Obj_00_FR : 136|7@0+ (0.2,0) [0|25.4] "m"  ADC
 SG_ ARC_OD_MaintenanceState_Obj_0059 : 145|2@0+ (1,0) [0|3] ""  ADC
 SG_ ARC_OD_Width_Obj_00_FR : 159|7@0+ (0.2,0) [0|25.4] "m"  ADC
 SG_ ARC_OD_RCS_Obj_00_FR : 152|9@0+ (0.2,-51.1) [-51.1|51.1] "dBsm"  ADC
 SG_ ARC_OD_Orientation_Obj_00_FR : 175|10@0+ (0.01,-5.11) [-5.11|5.12] "rad"  ADC
 SG_ ARC_OD_LifeCycle_Obj_00_FR : 207|16@0+ (1,0) [0|65535] ""  ADC
 SG_ ARC_OD_DistX_Obj_01_FR : 223|12@0+ (0.1,-152) [-152|257.5] "m"  ADC
 SG_ ARC_OD_VabsX_Obj_01_FR : 227|11@0+ (0.125,-128) [-128|127.875] "m/s"  ADC
 SG_ ARC_OD_AabsX_Obj_01_FR : 232|9@0+ (0.125,-31.875) [-31.875|32] "m/s^2"  ADC
 SG_ ARC_OD_AabsX_Obj_00_FR : 16|9@0+ (0.125,-31.875) [-31.875|32] "m/s^2"  ADC
 SG_ ARC_OD_DistY_Obj_01_FR : 255|12@0+ (0.0875,-179.113) [-179.113|179.2] "m"  ADC
 SG_ ARC_OD_VabsY_Obj_01_FR : 259|11@0+ (0.125,-128) [-128|127.875] "m/s"  ADC
 SG_ ARC_OD_AabsY_Obj_01_FR : 264|9@0+ (0.125,-31.875) [-31.875|32] "m/s^2"  ADC
 SG_ ARC_OD_DistXStd_Obj_01_FR : 287|8@0+ (0.05,0) [0|12.75] "m"  ADC
 SG_ ARC_OD_DistYStd_Obj_01_FR : 295|8@0+ (0.1,0) [0|25.5] "m"  ADC
 SG_ ARC_OD_VabsXStd_Obj_01_FR : 303|7@0+ (0.1,0) [0|12.7] "m/s"  ADC
 SG_ ARC_OD_VabsYStd_Obj_01_FR : 296|7@0+ (0.2,0) [0|25.4] "m/s"  ADC
 SG_ ARC_OD_AabsXStd_Obj_01_FR : 305|7@0+ (0.25,0) [0|31.75] "m/s^2"  ADC
 SG_ ARC_OD_Classification_Obj_01_FR : 314|3@0+ (1,0) [0|7] ""  ADC
 SG_ ARC_OD_AabsYStd_Obj_01_FR : 327|8@0+ (0.25,0) [0|63.75] "m/s^2"  ADC
 SG_ ARC_OD_ClassConf_Obj_01_FR : 335|7@0+ (1,0) [0|127] "%"  ADC
 SG_ ARC_OD_DistY_Obj_00_FR : 39|12@0+ (0.0875,-179.113) [-179.113|179.2] "m"  ADC
 SG_ ARC_OD_ProbOfExist_Obj_01_FR : 328|7@0+ (1,0) [0|127] "%"  ADC
 SG_ ARC_OD_DynProp_Obj_01_FR : 346|3@0+ (1,0) [0|7] ""  ADC
 SG_ ARC_OD_Length_Obj_01_FR : 352|7@0+ (0.2,0) [0|25.4] "m"  ADC
 SG_ ARC_OD_MaintenanceState_Obj_0060 : 361|2@0+ (1,0) [0|3] ""  ADC
 SG_ ARC_OD_Width_Obj_01_FR : 375|7@0+ (0.2,0) [0|25.4] "m"  ADC
 SG_ ARC_OD_RCS_Obj_01_FR : 368|9@0+ (0.2,-51.1) [-51.1|51.1] "dBsm"  ADC
 SG_ ARC_OD_Orientation_Obj_01_FR : 391|10@0+ (0.01,-5.11) [-5.11|5.12] "rad"  ADC
 SG_ ARC_OD_LifeCycle_Obj_01_FR : 423|16@0+ (1,0) [0|65535] ""  ADC
 SG_ ARC_OD_ObstacleProb_Obj_00_FR : 447|7@0+ (1,0) [0|127] "%"  ADC
 SG_ ARC_OD_ObstacleProb_Obj_01_FR : 455|7@0+ (1,0) [0|127] "%"  ADC
 SG_ ARC_OD_VabsY_Obj_00_FR : 43|11@0+ (0.125,-128) [-128|127.875] "m/s"  ADC
 SG_ ARC_OD_ID_00_FR : 463|8@0+ (1,0) [0|255] ""  ADC
 SG_ ARC_OD_ID_01_FR : 471|8@0+ (1,0) [0|255] ""  ADC
 SG_ ARC_OD_MsgCounter_Obj_00_01_FR : 491|4@0+ (1,0) [0|15] ""  ADC
 SG_ ARC_OD_CRC8_Obj_00_01_FR : 511|8@0+ (1,0) [0|255] ""  ADC
 SG_ ARC_OD_AabsY_Obj_00_FR : 48|9@0+ (0.125,-31.875) [-31.875|32] "m/s^2"  ADC
 SG_ ARC_OD_DistXStd_Obj_00_FR : 71|8@0+ (0.05,0) [0|12.75] "m"  ADC
 SG_ ARC_OD_DistYStd_Obj_00_FR : 79|8@0+ (0.1,0) [0|25.5] "m"  ADC
 SG_ ARC_OD_VabsXStd_Obj_00_FR : 87|7@0+ (0.1,0) [0|12.7] "m/s"  ADC
 SG_ ARC_OD_VabsYStd_Obj_00_FR : 80|7@0+ (0.2,0) [0|25.4] "m/s"  ADC
 SG_ ARC_OD_AabsXStd_Obj_00_FR : 89|7@0+ (0.25,0) [0|31.75] "m/s^2"  ADC

BO_ 1134 ARC_OD_58_59_RR: 64 ARC
 SG_ DistHeight_Obj_59_RR : 487|8@0+ (0.2,-10) [-10|41] "m" Vector__XXX
 SG_ DistHeight_Obj_58_RR : 479|8@0+ (0.2,-10) [-10|41] "m" Vector__XXX
 SG_ ARC_OD_DistX_Obj_58_RR : 7|12@0+ (0.1,-152) [-152|257.5] "m"  ADC
 SG_ ARC_OD_Classification_Obj_58_RR : 98|3@0+ (1,0) [0|7] ""  ADC
 SG_ ARC_OD_AabsYStd_Obj_58_RR : 111|8@0+ (0.25,0) [0|63.75] "m/s^2"  ADC
 SG_ ARC_OD_ClassConf_Obj_58_RR : 119|7@0+ (1,0) [0|127] "%"  ADC
 SG_ ARC_OD_ProbOfExist_Obj_58_RR : 112|7@0+ (1,0) [0|127] "%"  ADC
 SG_ ARC_OD_VabsX_Obj_58_RR : 11|11@0+ (0.125,-128) [-128|127.875] "m/s"  ADC
 SG_ ARC_OD_DynProp_Obj_58_RR : 130|3@0+ (1,0) [0|7] ""  ADC
 SG_ ARC_OD_Length_Obj_58_RR : 136|7@0+ (0.2,0) [0|25.4] "m"  ADC
 SG_ ARC_OD_MaintenanceState_Obj_58_R : 145|2@0+ (1,0) [0|3] ""  ADC
 SG_ ARC_OD_Width_Obj_58_RR : 159|7@0+ (0.2,0) [0|25.4] "m"  ADC
 SG_ ARC_OD_RCS_Obj_58_RR : 152|9@0+ (0.2,-51.1) [-51.1|51.1] "dBsm"  ADC
 SG_ ARC_OD_Orientation_Obj_58_RR : 175|10@0+ (0.01,-5.11) [-5.11|5.12] "rad"  ADC
 SG_ ARC_OD_LifeCycle_Obj_58_RR : 207|16@0+ (1,0) [0|65535] ""  ADC
 SG_ ARC_OD_DistX_Obj_59_RR : 223|12@0+ (0.1,-152) [-152|257.5] "m"  ADC
 SG_ ARC_OD_VabsX_Obj_59_RR : 227|11@0+ (0.125,-128) [-128|127.875] "m/s"  ADC
 SG_ ARC_OD_AabsX_Obj_59_RR : 232|9@0+ (0.125,-31.875) [-31.875|32] "m/s^2"  ADC
 SG_ ARC_OD_AabsX_Obj_58_RR : 16|9@0+ (0.125,-31.875) [-31.875|32] "m/s^2"  ADC
 SG_ ARC_OD_DistY_Obj_59_RR : 255|12@0+ (0.0875,-179.113) [-179.113|179.2] "m"  ADC
 SG_ ARC_OD_VabsY_Obj_59_RR : 259|11@0+ (0.125,-128) [-128|127.875] "m/s"  ADC
 SG_ ARC_OD_AabsY_Obj_59_RR : 264|9@0+ (0.125,-31.875) [-31.875|32] "m/s^2"  ADC
 SG_ ARC_OD_DistXStd_Obj_59_RR : 287|8@0+ (0.05,0) [0|12.75] "m"  ADC
 SG_ ARC_OD_DistYStd_Obj_59_RR : 295|8@0+ (0.1,0) [0|25.5] "m"  ADC
 SG_ ARC_OD_VabsXStd_Obj_59_RR : 303|7@0+ (0.1,0) [0|12.7] "m/s"  ADC
 SG_ ARC_OD_VabsYStd_Obj_59_RR : 296|7@0+ (0.2,0) [0|25.4] "m/s"  ADC
 SG_ ARC_OD_AabsXStd_Obj_59_RR : 305|7@0+ (0.25,0) [0|31.75] "m/s^2"  ADC
 SG_ ARC_OD_Classification_Obj_59_RR : 314|3@0+ (1,0) [0|7] ""  ADC
 SG_ ARC_OD_AabsYStd_Obj_59_RR : 327|8@0+ (0.25,0) [0|63.75] "m/s^2"  ADC
 SG_ ARC_OD_ClassConf_Obj_59_RR : 335|7@0+ (1,0) [0|127] "%"  ADC
 SG_ ARC_OD_DistY_Obj_58_RR : 39|12@0+ (0.0875,-179.113) [-179.113|179.2] "m"  ADC
 SG_ ARC_OD_ProbOfExist_Obj_59_RR : 328|7@0+ (1,0) [0|127] "%"  ADC
 SG_ ARC_OD_DynProp_Obj_59_RR : 346|3@0+ (1,0) [0|7] ""  ADC
 SG_ ARC_OD_Length_Obj_59_RR : 352|7@0+ (0.2,0) [0|25.4] "m"  ADC
 SG_ ARC_OD_MaintenanceState_Obj_59_R : 361|2@0+ (1,0) [0|3] ""  ADC
 SG_ ARC_OD_Width_Obj_59_RR : 375|7@0+ (0.2,0) [0|25.4] "m"  ADC
 SG_ ARC_OD_RCS_Obj_59_RR : 368|9@0+ (0.2,-51.1) [-51.1|51.1] "dBsm"  ADC
 SG_ ARC_OD_Orientation_Obj_59_RR : 391|10@0+ (0.01,-5.11) [-5.11|5.12] "rad"  ADC
 SG_ ARC_OD_LifeCycle_Obj_59_RR : 423|16@0+ (1,0) [0|65535] ""  ADC
 SG_ ARC_OD_ObstacleProb_Obj_58_RR : 447|7@0+ (1,0) [0|127] "%"  ADC
 SG_ ARC_OD_ObstacleProb_Obj_59_RR : 455|7@0+ (1,0) [0|127] "%"  ADC
 SG_ ARC_OD_VabsY_Obj_58_RR : 43|11@0+ (0.125,-128) [-128|127.875] "m/s"  ADC
 SG_ ARC_OD_ID_58_RR : 463|8@0+ (1,0) [0|255] ""  ADC
 SG_ ARC_OD_ID_59_RR : 471|8@0+ (1,0) [0|255] ""  ADC
 SG_ ARC_OD_MsgCounter_Obj_58_59_RR : 491|4@0+ (1,0) [0|15] ""  ADC
 SG_ ARC_OD_CRC8_Obj_58_59_RR : 511|8@0+ (1,0) [0|256] ""  ADC
 SG_ ARC_OD_AabsY_Obj_58_RR : 48|9@0+ (0.125,-31.875) [-31.875|32] "m/s^2"  ADC
 SG_ ARC_OD_DistXStd_Obj_58_RR : 71|8@0+ (0.05,0) [0|12.75] "m"  ADC
 SG_ ARC_OD_DistYStd_Obj_58_RR : 79|8@0+ (0.1,0) [0|25.5] "m"  ADC
 SG_ ARC_OD_VabsXStd_Obj_58_RR : 87|7@0+ (0.1,0) [0|12.7] "m/s"  ADC
 SG_ ARC_OD_VabsYStd_Obj_58_RR : 80|7@0+ (0.2,0) [0|25.4] "m/s"  ADC
 SG_ ARC_OD_AabsXStd_Obj_58_RR : 89|7@0+ (0.25,0) [0|31.75] "m/s^2"  ADC

CM_ SG_ 1380 ARC_OD_DistX_Obj_38_FR "Longitudinal distance of object_38
00????????";
CM_ SG_ 1380 ARC_OD_Classification_Obj_38_FR "Classification of object_38
00??????";
CM_ SG_ 1380 ARC_OD_AabsYStd_Obj_38_FR "Lateral absolution acceleration standard deviation of object_38
00????????????????";
CM_ SG_ 1380 ARC_OD_ClassConf_Obj_38_FR "Classification confidence of object_38
00?????????";
CM_ SG_ 1380 ARC_OD_ProbOfExist_Obj_38_FR "Existence probability of object_38
00????????";
CM_ SG_ 1380 ARC_OD_VabsX_Obj_38_FR "Longitudinal absolution velocity over ground of object_38
00????????????";
CM_ SG_ 1380 ARC_OD_DynProp_Obj_38_FR "Dynamic property of object_38
00????????";
CM_ SG_ 1380 ARC_OD_Length_Obj_38_FR "Length of object_38
00??????";
CM_ SG_ 1380 ARC_OD_MaintenanceState_Obj_0021 "Maintenance state of object_38
00????????";
CM_ SG_ 1380 ARC_OD_Width_Obj_38_FR "Width of object_38
00??????";
CM_ SG_ 1380 ARC_OD_RCS_Obj_38_FR "RCS of object_38
00?????????";
CM_ SG_ 1380 ARC_OD_Orientation_Obj_38_FR "Orientation of object_38
00???????";
CM_ SG_ 1380 ARC_OD_LifeCycle_Obj_38_FR "Life cycle of object_38
00????????";
CM_ SG_ 1380 ARC_OD_AabsX_Obj_38_FR "Longitudinal absolution acceleration over ground of object_38
00?????????????";
CM_ SG_ 1380 ARC_OD_DistY_Obj_38_FR "Lateral distance of object_38
00????????";
CM_ SG_ 1380 ARC_OD_ObstacleProb_Obj_38_FR "Obstacle probability of object_38
00?????????";
CM_ SG_ 1380 ARC_OD_VabsY_Obj_38_FR "Lateral absolution velocity over ground of object_38
00????????????";
CM_ SG_ 1380 ARC_OD_AabsY_Obj_38_FR "Lateral absolution acceleration over ground of object_38
00?????????????";
CM_ SG_ 1380 ARC_OD_DistXStd_Obj_38_FR "Longitudinal distance standard deviation of object_38
00???????????";
CM_ SG_ 1380 ARC_OD_DistYStd_Obj_38_FR "Lateral distance standard deviation of object_38
00???????????";
CM_ SG_ 1380 ARC_OD_VabsXStd_Obj_38_FR "Longitudinal absolution velocity standard deviation of object_38
00???????????????";
CM_ SG_ 1380 ARC_OD_VabsYStd_Obj_38_FR "Lateral absolution velocity standard deviation of object_38
00???????????????";
CM_ SG_ 1380 ARC_OD_AabsXStd_Obj_38_FR "Longitudinal absolution acceleration standard deviation of object_38
00????????????????";
CM_ SG_ 1379 ARC_OD_DistX_Obj_36_FR "Longitudinal distance of object_36
00????????";
CM_ SG_ 1379 ARC_OD_Classification_Obj_36_FR "Classification of object_36
00??????";
CM_ SG_ 1379 ARC_OD_AabsYStd_Obj_36_FR "Lateral absolution acceleration standard deviation of object_36
00????????????????";
CM_ SG_ 1379 ARC_OD_ClassConf_Obj_36_FR "Classification confidence of object_36
00?????????";
CM_ SG_ 1379 ARC_OD_ProbOfExist_Obj_36_FR "Existence probability of object_36
00????????";
CM_ SG_ 1379 ARC_OD_VabsX_Obj_36_FR "Longitudinal absolution velocity over ground of object_36
00????????????";
CM_ SG_ 1379 ARC_OD_DynProp_Obj_36_FR "Dynamic property of object_36
00????????";
CM_ SG_ 1379 ARC_OD_Length_Obj_36_FR "Length of object_36
00??????";
CM_ SG_ 1379 ARC_OD_MaintenanceState_Obj_0023 "Maintenance state of object_36
00????????";
CM_ SG_ 1379 ARC_OD_Width_Obj_36_FR "Width of object_36
00??????";
CM_ SG_ 1379 ARC_OD_RCS_Obj_36_FR "RCS of object_36
00?????????";
CM_ SG_ 1379 ARC_OD_Orientation_Obj_36_FR "Orientation of object_36
00???????";
CM_ SG_ 1379 ARC_OD_LifeCycle_Obj_36_FR "Life cycle of object_36
00????????";
CM_ SG_ 1379 ARC_OD_AabsX_Obj_36_FR "Longitudinal absolution acceleration over ground of object_36
00?????????????";
CM_ SG_ 1379 ARC_OD_DistY_Obj_36_FR "Lateral distance of object_36
00????????";
CM_ SG_ 1379 ARC_OD_ObstacleProb_Obj_36_FR "Obstacle probability of object_36
00?????????";
CM_ SG_ 1379 ARC_OD_VabsY_Obj_36_FR "Lateral absolution velocity over ground of object_36
00????????????";
CM_ SG_ 1379 ARC_OD_AabsY_Obj_36_FR "Lateral absolution acceleration over ground of object_36
00?????????????";
CM_ SG_ 1379 ARC_OD_DistXStd_Obj_36_FR "Longitudinal distance standard deviation of object_36
00???????????";
CM_ SG_ 1379 ARC_OD_DistYStd_Obj_36_FR "Lateral distance standard deviation of object_36
00???????????";
CM_ SG_ 1379 ARC_OD_VabsXStd_Obj_36_FR "Longitudinal absolution velocity standard deviation of object_36
00???????????????";
CM_ SG_ 1379 ARC_OD_VabsYStd_Obj_36_FR "Lateral absolution velocity standard deviation of object_36
00???????????????";
CM_ SG_ 1379 ARC_OD_AabsXStd_Obj_36_FR "Longitudinal absolution acceleration standard deviation of object_36
00????????????????";
CM_ SG_ 1378 ARC_OD_DistX_Obj_34_FR "Longitudinal distance of object_34
00????????";
CM_ SG_ 1378 ARC_OD_Classification_Obj_34_FR "Classification of object_34
00??????";
CM_ SG_ 1378 ARC_OD_AabsYStd_Obj_34_FR "Lateral absolution acceleration standard deviation of object_34
00????????????????";
CM_ SG_ 1378 ARC_OD_ClassConf_Obj_34_FR "Classification confidence of object_34
00?????????";
CM_ SG_ 1378 ARC_OD_ProbOfExist_Obj_34_FR "Existence probability of object_34
00????????";
CM_ SG_ 1378 ARC_OD_VabsX_Obj_34_FR "Longitudinal absolution velocity over ground of object_34
00????????????";
CM_ SG_ 1378 ARC_OD_DynProp_Obj_34_FR "Dynamic property of object_34
00????????";
CM_ SG_ 1378 ARC_OD_Length_Obj_34_FR "Length of object_34
00??????";
CM_ SG_ 1378 ARC_OD_MaintenanceState_Obj_0025 "Maintenance state of object_34
00????????";
CM_ SG_ 1378 ARC_OD_Width_Obj_34_FR "Width of object_34
00??????";
CM_ SG_ 1378 ARC_OD_RCS_Obj_34_FR "RCS of object_34
00?????????";
CM_ SG_ 1378 ARC_OD_Orientation_Obj_34_FR "Orientation of object_34
00???????";
CM_ SG_ 1378 ARC_OD_LifeCycle_Obj_34_FR "Life cycle of object_34
00????????";
CM_ SG_ 1378 ARC_OD_AabsX_Obj_34_FR "Longitudinal absolution acceleration over ground of object_34
00?????????????";
CM_ SG_ 1378 ARC_OD_DistY_Obj_34_FR "Lateral distance of object_34
00????????";
CM_ SG_ 1378 ARC_OD_ObstacleProb_Obj_34_FR "Obstacle probability of object_34
00?????????";
CM_ SG_ 1378 ARC_OD_VabsY_Obj_34_FR "Lateral absolution velocity over ground of object_34
00????????????";
CM_ SG_ 1378 ARC_OD_AabsY_Obj_34_FR "Lateral absolution acceleration over ground of object_34
00?????????????";
CM_ SG_ 1378 ARC_OD_DistXStd_Obj_34_FR "Longitudinal distance standard deviation of object_34
00???????????";
CM_ SG_ 1378 ARC_OD_DistYStd_Obj_34_FR "Lateral distance standard deviation of object_34
00???????????";
CM_ SG_ 1378 ARC_OD_VabsXStd_Obj_34_FR "Longitudinal absolution velocity standard deviation of object_34
00???????????????";
CM_ SG_ 1378 ARC_OD_VabsYStd_Obj_34_FR "Lateral absolution velocity standard deviation of object_34
00???????????????";
CM_ SG_ 1378 ARC_OD_AabsXStd_Obj_34_FR "Longitudinal absolution acceleration standard deviation of object_34
00????????????????";
CM_ SG_ 1377 ARC_OD_DistX_Obj_32_FR "Longitudinal distance of object_32
00????????";
CM_ SG_ 1377 ARC_OD_Classification_Obj_32_FR "Classification of object_32
00??????";
CM_ SG_ 1377 ARC_OD_AabsYStd_Obj_32_FR "Lateral absolution acceleration standard deviation of object_32
00????????????????";
CM_ SG_ 1377 ARC_OD_ClassConf_Obj_32_FR "Classification confidence of object_32
00?????????";
CM_ SG_ 1377 ARC_OD_ProbOfExist_Obj_32_FR "Existence probability of object_32
00????????";
CM_ SG_ 1377 ARC_OD_VabsX_Obj_32_FR "Longitudinal absolution velocity over ground of object_32
00????????????";
CM_ SG_ 1377 ARC_OD_DynProp_Obj_32_FR "Dynamic property of object_32
00????????";
CM_ SG_ 1377 ARC_OD_Length_Obj_32_FR "Length of object_32
00??????";
CM_ SG_ 1377 ARC_OD_MaintenanceState_Obj_0027 "Maintenance state of object_32
00????????";
CM_ SG_ 1377 ARC_OD_Width_Obj_32_FR "Width of object_32
00??????";
CM_ SG_ 1377 ARC_OD_RCS_Obj_32_FR "RCS of object_32
00?????????";
CM_ SG_ 1377 ARC_OD_Orientation_Obj_32_FR "Orientation of object_32
00???????";
CM_ SG_ 1377 ARC_OD_LifeCycle_Obj_32_FR "Life cycle of object_32
00????????";
CM_ SG_ 1377 ARC_OD_AabsX_Obj_32_FR "Longitudinal absolution acceleration over ground of object_32
00?????????????";
CM_ SG_ 1377 ARC_OD_DistY_Obj_32_FR "Lateral distance of object_32
00????????";
CM_ SG_ 1377 ARC_OD_ObstacleProb_Obj_32_FR "Obstacle probability of object_32
00?????????";
CM_ SG_ 1377 ARC_OD_VabsY_Obj_32_FR "Lateral absolution velocity over ground of object_32
00????????????";
CM_ SG_ 1377 ARC_OD_AabsY_Obj_32_FR "Lateral absolution acceleration over ground of object_32
00?????????????";
CM_ SG_ 1377 ARC_OD_DistXStd_Obj_32_FR "Longitudinal distance standard deviation of object_32
00???????????";
CM_ SG_ 1377 ARC_OD_DistYStd_Obj_32_FR "Lateral distance standard deviation of object_32
00???????????";
CM_ SG_ 1377 ARC_OD_VabsXStd_Obj_32_FR "Longitudinal absolution velocity standard deviation of object_32
00???????????????";
CM_ SG_ 1377 ARC_OD_VabsYStd_Obj_32_FR "Lateral absolution velocity standard deviation of object_32
00???????????????";
CM_ SG_ 1377 ARC_OD_AabsXStd_Obj_32_FR "Longitudinal absolution acceleration standard deviation of object_32
00????????????????";
CM_ SG_ 1376 ARC_OD_DistX_Obj_30_FR "Longitudinal distance of object_30
00????????";
CM_ SG_ 1376 ARC_OD_Classification_Obj_30_FR "Classification of object_30
00??????";
CM_ SG_ 1376 ARC_OD_AabsYStd_Obj_30_FR "Lateral absolution acceleration standard deviation of object_30
00????????????????";
CM_ SG_ 1376 ARC_OD_ClassConf_Obj_30_FR "Classification confidence of object_30
00?????????";
CM_ SG_ 1376 ARC_OD_ProbOfExist_Obj_30_FR "Existence probability of object_30
00????????";
CM_ SG_ 1376 ARC_OD_VabsX_Obj_30_FR "Longitudinal absolution velocity over ground of object_30
00????????????";
CM_ SG_ 1376 ARC_OD_DynProp_Obj_30_FR "Dynamic property of object_30
00????????";
CM_ SG_ 1376 ARC_OD_Length_Obj_30_FR "Length of object_30
00??????";
CM_ SG_ 1376 ARC_OD_MaintenanceState_Obj_0029 "Maintenance state of object_30
00????????";
CM_ SG_ 1376 ARC_OD_Width_Obj_30_FR "Width of object_30
00??????";
CM_ SG_ 1376 ARC_OD_RCS_Obj_30_FR "RCS of object_30
00?????????";
CM_ SG_ 1376 ARC_OD_Orientation_Obj_30_FR "Orientation of object_30
00???????";
CM_ SG_ 1376 ARC_OD_LifeCycle_Obj_30_FR "Life cycle of object_30
00????????";
CM_ SG_ 1376 ARC_OD_AabsX_Obj_30_FR "Longitudinal absolution acceleration over ground of object_30
00?????????????";
CM_ SG_ 1376 ARC_OD_DistY_Obj_30_FR "Lateral distance of object_30
00????????";
CM_ SG_ 1376 ARC_OD_ObstacleProb_Obj_30_FR "Obstacle probability of object_30
00?????????";
CM_ SG_ 1376 ARC_OD_VabsY_Obj_30_FR "Lateral absolution velocity over ground of object_30
00????????????";
CM_ SG_ 1376 ARC_OD_AabsY_Obj_30_FR "Lateral absolution acceleration over ground of object_30
00?????????????";
CM_ SG_ 1376 ARC_OD_DistXStd_Obj_30_FR "Longitudinal distance standard deviation of object_30
00???????????";
CM_ SG_ 1376 ARC_OD_DistYStd_Obj_30_FR "Lateral distance standard deviation of object_30
00???????????";
CM_ SG_ 1376 ARC_OD_VabsXStd_Obj_30_FR "Longitudinal absolution velocity standard deviation of object_30
00???????????????";
CM_ SG_ 1376 ARC_OD_VabsYStd_Obj_30_FR "Lateral absolution velocity standard deviation of object_30
00???????????????";
CM_ SG_ 1376 ARC_OD_AabsXStd_Obj_30_FR "Longitudinal absolution acceleration standard deviation of object_30
00????????????????";
CM_ SG_ 1375 ARC_OD_DistX_Obj_28_FR "Longitudinal distance of object_28
00????????";
CM_ SG_ 1375 ARC_OD_Classification_Obj_28_FR "Classification of object_28
00??????";
CM_ SG_ 1375 ARC_OD_AabsYStd_Obj_28_FR "Lateral absolution acceleration standard deviation of object_28
00????????????????";
CM_ SG_ 1375 ARC_OD_ClassConf_Obj_28_FR "Classification confidence of object_28
00?????????";
CM_ SG_ 1375 ARC_OD_ProbOfExist_Obj_28_FR "Existence probability of object_28
00????????";
CM_ SG_ 1375 ARC_OD_VabsX_Obj_28_FR "Longitudinal absolution velocity over ground of object_28
00????????????";
CM_ SG_ 1375 ARC_OD_DynProp_Obj_28_FR "Dynamic property of object_28
00????????";
CM_ SG_ 1375 ARC_OD_Length_Obj_28_FR "Length of object_28
00??????";
CM_ SG_ 1375 ARC_OD_MaintenanceState_Obj_0031 "Maintenance state of object_28
00????????";
CM_ SG_ 1375 ARC_OD_Width_Obj_28_FR "Width of object_28
00??????";
CM_ SG_ 1375 ARC_OD_RCS_Obj_28_FR "RCS of object_28
00?????????";
CM_ SG_ 1375 ARC_OD_Orientation_Obj_28_FR "Orientation of object_28
00???????";
CM_ SG_ 1375 ARC_OD_LifeCycle_Obj_28_FR "Life cycle of object_28
00????????";
CM_ SG_ 1375 ARC_OD_AabsX_Obj_28_FR "Longitudinal absolution acceleration over ground of object_28
00?????????????";
CM_ SG_ 1375 ARC_OD_DistY_Obj_28_FR "Lateral distance of object_28
00????????";
CM_ SG_ 1375 ARC_OD_ObstacleProb_Obj_28_FR "Obstacle probability of object_28
00?????????";
CM_ SG_ 1375 ARC_OD_VabsY_Obj_28_FR "Lateral absolution velocity over ground of object_28
00????????????";
CM_ SG_ 1375 ARC_OD_AabsY_Obj_28_FR "Lateral absolution acceleration over ground of object_28
00?????????????";
CM_ SG_ 1375 ARC_OD_DistXStd_Obj_28_FR "Longitudinal distance standard deviation of object_28
00???????????";
CM_ SG_ 1375 ARC_OD_DistYStd_Obj_28_FR "Lateral distance standard deviation of object_28
00???????????";
CM_ SG_ 1375 ARC_OD_VabsXStd_Obj_28_FR "Longitudinal absolution velocity standard deviation of object_28
00???????????????";
CM_ SG_ 1375 ARC_OD_VabsYStd_Obj_28_FR "Lateral absolution velocity standard deviation of object_28
00???????????????";
CM_ SG_ 1375 ARC_OD_AabsXStd_Obj_28_FR "Longitudinal absolution acceleration standard deviation of object_28
00????????????????";
CM_ SG_ 1374 ARC_OD_DistX_Obj_26_FR "Longitudinal distance of object_26
00????????";
CM_ SG_ 1374 ARC_OD_Classification_Obj_26_FR "Classification of object_26
00??????";
CM_ SG_ 1374 ARC_OD_AabsYStd_Obj_26_FR "Lateral absolution acceleration standard deviation of object_26
00????????????????";
CM_ SG_ 1374 ARC_OD_ClassConf_Obj_26_FR "Classification confidence of object_26
00?????????";
CM_ SG_ 1374 ARC_OD_ProbOfExist_Obj_26_FR "Existence probability of object_26
00????????";
CM_ SG_ 1374 ARC_OD_VabsX_Obj_26_FR "Longitudinal absolution velocity over ground of object_26
00????????????";
CM_ SG_ 1374 ARC_OD_DynProp_Obj_26_FR "Dynamic property of object_26
00????????";
CM_ SG_ 1374 ARC_OD_Length_Obj_26_FR "Length of object_26
00??????";
CM_ SG_ 1374 ARC_OD_MaintenanceState_Obj_0033 "Maintenance state of object_26
00????????";
CM_ SG_ 1374 ARC_OD_Width_Obj_26_FR "Width of object_26
00??????";
CM_ SG_ 1374 ARC_OD_RCS_Obj_26_FR "RCS of object_26
00?????????";
CM_ SG_ 1374 ARC_OD_Orientation_Obj_26_FR "Orientation of object_26
00???????";
CM_ SG_ 1374 ARC_OD_LifeCycle_Obj_26_FR "Life cycle of object_26
00????????";
CM_ SG_ 1374 ARC_OD_AabsX_Obj_26_FR "Longitudinal absolution acceleration over ground of object_26
00?????????????";
CM_ SG_ 1374 ARC_OD_DistY_Obj_26_FR "Lateral distance of object_26
00????????";
CM_ SG_ 1374 ARC_OD_ObstacleProb_Obj_26_FR "Obstacle probability of object_26
00?????????";
CM_ SG_ 1374 ARC_OD_VabsY_Obj_26_FR "Lateral absolution velocity over ground of object_26
00????????????";
CM_ SG_ 1374 ARC_OD_AabsY_Obj_26_FR "Lateral absolution acceleration over ground of object_26
00?????????????";
CM_ SG_ 1374 ARC_OD_DistXStd_Obj_26_FR "Longitudinal distance standard deviation of object_26
00???????????";
CM_ SG_ 1374 ARC_OD_DistYStd_Obj_26_FR "Lateral distance standard deviation of object_26
00???????????";
CM_ SG_ 1374 ARC_OD_VabsXStd_Obj_26_FR "Longitudinal absolution velocity standard deviation of object_26
00???????????????";
CM_ SG_ 1374 ARC_OD_VabsYStd_Obj_26_FR "Lateral absolution velocity standard deviation of object_26
00???????????????";
CM_ SG_ 1374 ARC_OD_AabsXStd_Obj_26_FR "Longitudinal absolution acceleration standard deviation of object_26
00????????????????";
CM_ SG_ 1373 ARC_OD_DistX_Obj_24_FR "Longitudinal distance of object_24
00????????";
CM_ SG_ 1373 ARC_OD_Classification_Obj_24_FR "Classification of object_24
00??????";
CM_ SG_ 1373 ARC_OD_AabsYStd_Obj_24_FR "Lateral absolution acceleration standard deviation of object_24
00????????????????";
CM_ SG_ 1373 ARC_OD_ClassConf_Obj_24_FR "Classification confidence of object_24
00?????????";
CM_ SG_ 1373 ARC_OD_ProbOfExist_Obj_24_FR "Existence probability of object_24
00????????";
CM_ SG_ 1373 ARC_OD_VabsX_Obj_24_FR "Longitudinal absolution velocity over ground of object_24
00????????????";
CM_ SG_ 1373 ARC_OD_DynProp_Obj_24_FR "Dynamic property of object_24
00????????";
CM_ SG_ 1373 ARC_OD_Length_Obj_24_FR "Length of object_24
00??????";
CM_ SG_ 1373 ARC_OD_MaintenanceState_Obj_0035 "Maintenance state of object_24
00????????";
CM_ SG_ 1373 ARC_OD_Width_Obj_24_FR "Width of object_24
00??????";
CM_ SG_ 1373 ARC_OD_RCS_Obj_24_FR "RCS of object_24
00?????????";
CM_ SG_ 1373 ARC_OD_Orientation_Obj_24_FR "Orientation of object_24
00???????";
CM_ SG_ 1373 ARC_OD_LifeCycle_Obj_24_FR "Life cycle of object_24
00????????";
CM_ SG_ 1373 ARC_OD_AabsX_Obj_24_FR "Longitudinal absolution acceleration over ground of object_24
00?????????????";
CM_ SG_ 1373 ARC_OD_DistY_Obj_24_FR "Lateral distance of object_24
00????????";
CM_ SG_ 1373 ARC_OD_ObstacleProb_Obj_24_FR "Obstacle probability of object_24
00?????????";
CM_ SG_ 1373 ARC_OD_VabsY_Obj_24_FR "Lateral absolution velocity over ground of object_24
00????????????";
CM_ SG_ 1373 ARC_OD_AabsY_Obj_24_FR "Lateral absolution acceleration over ground of object_24
00?????????????";
CM_ SG_ 1373 ARC_OD_DistXStd_Obj_24_FR "Longitudinal distance standard deviation of object_24
00???????????";
CM_ SG_ 1373 ARC_OD_DistYStd_Obj_24_FR "Lateral distance standard deviation of object_24
00???????????";
CM_ SG_ 1373 ARC_OD_VabsXStd_Obj_24_FR "Longitudinal absolution velocity standard deviation of object_24
00???????????????";
CM_ SG_ 1373 ARC_OD_VabsYStd_Obj_24_FR "Lateral absolution velocity standard deviation of object_24
00???????????????";
CM_ SG_ 1373 ARC_OD_AabsXStd_Obj_24_FR "Longitudinal absolution acceleration standard deviation of object_24
00????????????????";
CM_ SG_ 1372 ARC_OD_DistX_Obj_22_FR "Longitudinal distance of object_22
00????????";
CM_ SG_ 1372 ARC_OD_Classification_Obj_22_FR "Classification of object_22
00??????";
CM_ SG_ 1372 ARC_OD_AabsYStd_Obj_22_FR "Lateral absolution acceleration standard deviation of object_22
00????????????????";
CM_ SG_ 1372 ARC_OD_ClassConf_Obj_22_FR "Classification confidence of object_22
00?????????";
CM_ SG_ 1372 ARC_OD_ProbOfExist_Obj_22_FR "Existence probability of object_22
00????????";
CM_ SG_ 1372 ARC_OD_VabsX_Obj_22_FR "Longitudinal absolution velocity over ground of object_22
00????????????";
CM_ SG_ 1372 ARC_OD_DynProp_Obj_22_FR "Dynamic property of object_22
00????????";
CM_ SG_ 1372 ARC_OD_Length_Obj_22_FR "Length of object_22
00??????";
CM_ SG_ 1372 ARC_OD_MaintenanceState_Obj_0037 "Maintenance state of object_22
00????????";
CM_ SG_ 1372 ARC_OD_Width_Obj_22_FR "Width of object_22
00??????";
CM_ SG_ 1372 ARC_OD_RCS_Obj_22_FR "RCS of object_22
00?????????";
CM_ SG_ 1372 ARC_OD_Orientation_Obj_22_FR "Orientation of object_22
00???????";
CM_ SG_ 1372 ARC_OD_LifeCycle_Obj_22_FR "Life cycle of object_22
00????????";
CM_ SG_ 1372 ARC_OD_AabsX_Obj_22_FR "Longitudinal absolution acceleration over ground of object_22
00?????????????";
CM_ SG_ 1372 ARC_OD_DistY_Obj_22_FR "Lateral distance of object_22
00????????";
CM_ SG_ 1372 ARC_OD_ObstacleProb_Obj_22_FR "Obstacle probability of object_22
00?????????";
CM_ SG_ 1372 ARC_OD_VabsY_Obj_22_FR "Lateral absolution velocity over ground of object_22
00????????????";
CM_ SG_ 1372 ARC_OD_AabsY_Obj_22_FR "Lateral absolution acceleration over ground of object_22
00?????????????";
CM_ SG_ 1372 ARC_OD_DistXStd_Obj_22_FR "Longitudinal distance standard deviation of object_22
00???????????";
CM_ SG_ 1372 ARC_OD_DistYStd_Obj_22_FR "Lateral distance standard deviation of object_22
00???????????";
CM_ SG_ 1372 ARC_OD_VabsXStd_Obj_22_FR "Longitudinal absolution velocity standard deviation of object_22
00???????????????";
CM_ SG_ 1372 ARC_OD_VabsYStd_Obj_22_FR "Lateral absolution velocity standard deviation of object_22
00???????????????";
CM_ SG_ 1372 ARC_OD_AabsXStd_Obj_22_FR "Longitudinal absolution acceleration standard deviation of object_22
00????????????????";
CM_ SG_ 1371 ARC_OD_DistX_Obj_20_FR "Longitudinal distance of object_20
00????????";
CM_ SG_ 1371 ARC_OD_Classification_Obj_20_FR "Classification of object_20
00??????";
CM_ SG_ 1371 ARC_OD_AabsYStd_Obj_20_FR "Lateral absolution acceleration standard deviation of object_20
00????????????????";
CM_ SG_ 1371 ARC_OD_ClassConf_Obj_20_FR "Classification confidence of object_20
00?????????";
CM_ SG_ 1371 ARC_OD_ProbOfExist_Obj_20_FR "Existence probability of object_20
00????????";
CM_ SG_ 1371 ARC_OD_VabsX_Obj_20_FR "Longitudinal absolution velocity over ground of object_20
00????????????";
CM_ SG_ 1371 ARC_OD_DynProp_Obj_20_FR "Dynamic property of object_20
00????????";
CM_ SG_ 1371 ARC_OD_Length_Obj_20_FR "Length of object_20
00??????";
CM_ SG_ 1371 ARC_OD_MaintenanceState_Obj_0039 "Maintenance state of object_20
00????????";
CM_ SG_ 1371 ARC_OD_Width_Obj_20_FR "Width of object_20
00??????";
CM_ SG_ 1371 ARC_OD_RCS_Obj_20_FR "RCS of object_20
00?????????";
CM_ SG_ 1371 ARC_OD_Orientation_Obj_20_FR "Orientation of object_20
00???????";
CM_ SG_ 1371 ARC_OD_LifeCycle_Obj_20_FR "Life cycle of object_20
00????????";
CM_ SG_ 1371 ARC_OD_AabsX_Obj_20_FR "Longitudinal absolution acceleration over ground of object_20
00?????????????";
CM_ SG_ 1371 ARC_OD_DistY_Obj_20_FR "Lateral distance of object_20
00????????";
CM_ SG_ 1371 ARC_OD_ObstacleProb_Obj_20_FR "Obstacle probability of object_20
00?????????";
CM_ SG_ 1371 ARC_OD_VabsY_Obj_20_FR "Lateral absolution velocity over ground of object_20
00????????????";
CM_ SG_ 1371 ARC_OD_AabsY_Obj_20_FR "Lateral absolution acceleration over ground of object_20
00?????????????";
CM_ SG_ 1371 ARC_OD_DistXStd_Obj_20_FR "Longitudinal distance standard deviation of object_20
00???????????";
CM_ SG_ 1371 ARC_OD_DistYStd_Obj_20_FR "Lateral distance standard deviation of object_20
00???????????";
CM_ SG_ 1371 ARC_OD_VabsXStd_Obj_20_FR "Longitudinal absolution velocity standard deviation of object_20
00???????????????";
CM_ SG_ 1371 ARC_OD_VabsYStd_Obj_20_FR "Lateral absolution velocity standard deviation of object_20
00???????????????";
CM_ SG_ 1371 ARC_OD_AabsXStd_Obj_20_FR "Longitudinal absolution acceleration standard deviation of object_20
00????????????????";
CM_ SG_ 1370 ARC_OD_DistX_Obj_18_FR "Longitudinal distance of object_18
00????????";
CM_ SG_ 1370 ARC_OD_Classification_Obj_18_FR "Classification of object_18
00??????";
CM_ SG_ 1370 ARC_OD_AabsYStd_Obj_18_FR "Lateral absolution acceleration standard deviation of object_18
00????????????????";
CM_ SG_ 1370 ARC_OD_ClassConf_Obj_18_FR "Classification confidence of object_18
00?????????";
CM_ SG_ 1370 ARC_OD_ProbOfExist_Obj_18_FR "Existence probability of object_18
00????????";
CM_ SG_ 1370 ARC_OD_VabsX_Obj_18_FR "Longitudinal absolution velocity over ground of object_18
00????????????";
CM_ SG_ 1370 ARC_OD_DynProp_Obj_18_FR "Dynamic property of object_18
00????????";
CM_ SG_ 1370 ARC_OD_Length_Obj_18_FR "Length of object_18
00??????";
CM_ SG_ 1370 ARC_OD_MaintenanceState_Obj_0041 "Maintenance state of object_18
00????????";
CM_ SG_ 1370 ARC_OD_Width_Obj_18_FR "Width of object_18
00??????";
CM_ SG_ 1370 ARC_OD_RCS_Obj_18_FR "RCS of object_18
00?????????";
CM_ SG_ 1370 ARC_OD_Orientation_Obj_18_FR "Orientation of object_18
00???????";
CM_ SG_ 1370 ARC_OD_LifeCycle_Obj_18_FR "Life cycle of object_18
00????????";
CM_ SG_ 1370 ARC_OD_AabsX_Obj_18_FR "Longitudinal absolution acceleration over ground of object_18
00?????????????";
CM_ SG_ 1370 ARC_OD_DistY_Obj_18_FR "Lateral distance of object_18
00????????";
CM_ SG_ 1370 ARC_OD_ObstacleProb_Obj_18_FR "Obstacle probability of object_18
00?????????";
CM_ SG_ 1370 ARC_OD_VabsY_Obj_18_FR "Lateral absolution velocity over ground of object_18
00????????????";
CM_ SG_ 1370 ARC_OD_AabsY_Obj_18_FR "Lateral absolution acceleration over ground of object_18
00?????????????";
CM_ SG_ 1370 ARC_OD_DistXStd_Obj_18_FR "Longitudinal distance standard deviation of object_18
00???????????";
CM_ SG_ 1370 ARC_OD_DistYStd_Obj_18_FR "Lateral distance standard deviation of object_18
00???????????";
CM_ SG_ 1370 ARC_OD_VabsXStd_Obj_18_FR "Longitudinal absolution velocity standard deviation of object_18
00???????????????";
CM_ SG_ 1370 ARC_OD_VabsYStd_Obj_18_FR "Lateral absolution velocity standard deviation of object_18
00???????????????";
CM_ SG_ 1370 ARC_OD_AabsXStd_Obj_18_FR "Longitudinal absolution acceleration standard deviation of object_18
00????????????????";
CM_ SG_ 1369 ARC_OD_DistX_Obj_16_FR "Longitudinal distance of object_16
00????????";
CM_ SG_ 1369 ARC_OD_Classification_Obj_16_FR "Classification of object_16
00??????";
CM_ SG_ 1369 ARC_OD_AabsYStd_Obj_16_FR "Lateral absolution acceleration standard deviation of object_16
00????????????????";
CM_ SG_ 1369 ARC_OD_ClassConf_Obj_16_FR "Classification confidence of object_16
00?????????";
CM_ SG_ 1369 ARC_OD_ProbOfExist_Obj_16_FR "Existence probability of object_16
00????????";
CM_ SG_ 1369 ARC_OD_VabsX_Obj_16_FR "Longitudinal absolution velocity over ground of object_16
00????????????";
CM_ SG_ 1369 ARC_OD_DynProp_Obj_16_FR "Dynamic property of object_16
00????????";
CM_ SG_ 1369 ARC_OD_Length_Obj_16_FR "Length of object_16
00??????";
CM_ SG_ 1369 ARC_OD_MaintenanceState_Obj_0043 "Maintenance state of object_16
00????????";
CM_ SG_ 1369 ARC_OD_Width_Obj_16_FR "Width of object_16
00??????";
CM_ SG_ 1369 ARC_OD_RCS_Obj_16_FR "RCS of object_16
00?????????";
CM_ SG_ 1369 ARC_OD_Orientation_Obj_16_FR "Orientation of object_16
00???????";
CM_ SG_ 1369 ARC_OD_LifeCycle_Obj_16_FR "Life cycle of object_16
00????????";
CM_ SG_ 1369 ARC_OD_AabsX_Obj_16_FR "Longitudinal absolution acceleration over ground of object_16
00?????????????";
CM_ SG_ 1369 ARC_OD_DistY_Obj_16_FR "Lateral distance of object_16
00????????";
CM_ SG_ 1369 ARC_OD_ObstacleProb_Obj_16_FR "Obstacle probability of object_16
00?????????";
CM_ SG_ 1369 ARC_OD_VabsY_Obj_16_FR "Lateral absolution velocity over ground of object_16
00????????????";
CM_ SG_ 1369 ARC_OD_AabsY_Obj_16_FR "Lateral absolution acceleration over ground of object_16
00?????????????";
CM_ SG_ 1369 ARC_OD_DistXStd_Obj_16_FR "Longitudinal distance standard deviation of object_16
00???????????";
CM_ SG_ 1369 ARC_OD_DistYStd_Obj_16_FR "Lateral distance standard deviation of object_16
00???????????";
CM_ SG_ 1369 ARC_OD_VabsXStd_Obj_16_FR "Longitudinal absolution velocity standard deviation of object_16
00???????????????";
CM_ SG_ 1369 ARC_OD_VabsYStd_Obj_16_FR "Lateral absolution velocity standard deviation of object_16
00???????????????";
CM_ SG_ 1369 ARC_OD_AabsXStd_Obj_16_FR "Longitudinal absolution acceleration standard deviation of object_16
00????????????????";
CM_ SG_ 1368 ARC_OD_DistX_Obj_14_FR "Longitudinal distance of object_14
00????????";
CM_ SG_ 1368 ARC_OD_Classification_Obj_14_FR "Classification of object_14
00??????";
CM_ SG_ 1368 ARC_OD_AabsYStd_Obj_14_FR "Lateral absolution acceleration standard deviation of object_14
00????????????????";
CM_ SG_ 1368 ARC_OD_ClassConf_Obj_14_FR "Classification confidence of object_14
00?????????";
CM_ SG_ 1368 ARC_OD_ProbOfExist_Obj_14_FR "Existence probability of object_14
00????????";
CM_ SG_ 1368 ARC_OD_VabsX_Obj_14_FR "Longitudinal absolution velocity over ground of object_14
00????????????";
CM_ SG_ 1368 ARC_OD_DynProp_Obj_14_FR "Dynamic property of object_14
00????????";
CM_ SG_ 1368 ARC_OD_Length_Obj_14_FR "Length of object_14
00??????";
CM_ SG_ 1368 ARC_OD_MaintenanceState_Obj_0045 "Maintenance state of object_14
00????????";
CM_ SG_ 1368 ARC_OD_Width_Obj_14_FR "Width of object_14
00??????";
CM_ SG_ 1368 ARC_OD_RCS_Obj_14_FR "RCS of object_14
00?????????";
CM_ SG_ 1368 ARC_OD_Orientation_Obj_14_FR "Orientation of object_14
00???????";
CM_ SG_ 1368 ARC_OD_LifeCycle_Obj_14_FR "Life cycle of object_14
00????????";
CM_ SG_ 1368 ARC_OD_AabsX_Obj_14_FR "Longitudinal absolution acceleration over ground of object_14
00?????????????";
CM_ SG_ 1368 ARC_OD_DistY_Obj_14_FR "Lateral distance of object_14
00????????";
CM_ SG_ 1368 ARC_OD_ObstacleProb_Obj_14_FR "Obstacle probability of object_14
00?????????";
CM_ SG_ 1368 ARC_OD_VabsY_Obj_14_FR "Lateral absolution velocity over ground of object_14
00????????????";
CM_ SG_ 1368 ARC_OD_AabsY_Obj_14_FR "Lateral absolution acceleration over ground of object_14
00?????????????";
CM_ SG_ 1368 ARC_OD_DistXStd_Obj_14_FR "Longitudinal distance standard deviation of object_14
00???????????";
CM_ SG_ 1368 ARC_OD_DistYStd_Obj_14_FR "Lateral distance standard deviation of object_14
00???????????";
CM_ SG_ 1368 ARC_OD_VabsXStd_Obj_14_FR "Longitudinal absolution velocity standard deviation of object_14
00???????????????";
CM_ SG_ 1368 ARC_OD_VabsYStd_Obj_14_FR "Lateral absolution velocity standard deviation of object_14
00???????????????";
CM_ SG_ 1368 ARC_OD_AabsXStd_Obj_14_FR "Longitudinal absolution acceleration standard deviation of object_14
00????????????????";
CM_ SG_ 1367 ARC_OD_DistX_Obj_12_FR "Longitudinal distance of object_12
00????????";
CM_ SG_ 1367 ARC_OD_Classification_Obj_12_FR "Classification of object_12
00??????";
CM_ SG_ 1367 ARC_OD_AabsYStd_Obj_12_FR "Lateral absolution acceleration standard deviation of object_12
00????????????????";
CM_ SG_ 1367 ARC_OD_ClassConf_Obj_12_FR "Classification confidence of object_12
00?????????";
CM_ SG_ 1367 ARC_OD_ProbOfExist_Obj_12_FR "Existence probability of object_12
00????????";
CM_ SG_ 1367 ARC_OD_VabsX_Obj_12_FR "Longitudinal absolution velocity over ground of object_12
00????????????";
CM_ SG_ 1367 ARC_OD_DynProp_Obj_12_FR "Dynamic property of object_12
00????????";
CM_ SG_ 1367 ARC_OD_Length_Obj_12_FR "Length of object_12
00??????";
CM_ SG_ 1367 ARC_OD_MaintenanceState_Obj_0047 "Maintenance state of object_12
00????????";
CM_ SG_ 1367 ARC_OD_Width_Obj_12_FR "Width of object_12
00??????";
CM_ SG_ 1367 ARC_OD_RCS_Obj_12_FR "RCS of object_12
00?????????";
CM_ SG_ 1367 ARC_OD_Orientation_Obj_12_FR "Orientation of object_12
00???????";
CM_ SG_ 1367 ARC_OD_LifeCycle_Obj_12_FR "Life cycle of object_12
00????????";
CM_ SG_ 1367 ARC_OD_AabsX_Obj_12_FR "Longitudinal absolution acceleration over ground of object_12
00?????????????";
CM_ SG_ 1367 ARC_OD_DistY_Obj_12_FR "Lateral distance of object_12
00????????";
CM_ SG_ 1367 ARC_OD_ObstacleProb_Obj_12_FR "Obstacle probability of object_12
00?????????";
CM_ SG_ 1367 ARC_OD_VabsY_Obj_12_FR "Lateral absolution velocity over ground of object_12
00????????????";
CM_ SG_ 1367 ARC_OD_AabsY_Obj_12_FR "Lateral absolution acceleration over ground of object_12
00?????????????";
CM_ SG_ 1367 ARC_OD_DistXStd_Obj_12_FR "Longitudinal distance standard deviation of object_12
00???????????";
CM_ SG_ 1367 ARC_OD_DistYStd_Obj_12_FR "Lateral distance standard deviation of object_12
00???????????";
CM_ SG_ 1367 ARC_OD_VabsXStd_Obj_12_FR "Longitudinal absolution velocity standard deviation of object_12
00???????????????";
CM_ SG_ 1367 ARC_OD_VabsYStd_Obj_12_FR "Lateral absolution velocity standard deviation of object_12
00???????????????";
CM_ SG_ 1367 ARC_OD_AabsXStd_Obj_12_FR "Longitudinal absolution acceleration standard deviation of object_12
00????????????????";
CM_ SG_ 1366 ARC_OD_DistX_Obj_10_FR "Longitudinal distance of object_10
00????????";
CM_ SG_ 1366 ARC_OD_Classification_Obj_10_FR "Classification of object_10
00??????";
CM_ SG_ 1366 ARC_OD_AabsYStd_Obj_10_FR "Lateral absolution acceleration standard deviation of object_10
00????????????????";
CM_ SG_ 1366 ARC_OD_ClassConf_Obj_10_FR "Classification confidence of object_10
00?????????";
CM_ SG_ 1366 ARC_OD_ProbOfExist_Obj_10_FR "Existence probability of object_10
00????????";
CM_ SG_ 1366 ARC_OD_VabsX_Obj_10_FR "Longitudinal absolution velocity over ground of object_10
00????????????";
CM_ SG_ 1366 ARC_OD_DynProp_Obj_10_FR "Dynamic property of object_10
00????????";
CM_ SG_ 1366 ARC_OD_Length_Obj_10_FR "Length of object_10
00??????";
CM_ SG_ 1366 ARC_OD_MaintenanceState_Obj_0049 "Maintenance state of object_10
00????????";
CM_ SG_ 1366 ARC_OD_Width_Obj_10_FR "Width of object_10
00??????";
CM_ SG_ 1366 ARC_OD_RCS_Obj_10_FR "RCS of object_10
00?????????";
CM_ SG_ 1366 ARC_OD_Orientation_Obj_10_FR "Orientation of object_10
00???????";
CM_ SG_ 1366 ARC_OD_LifeCycle_Obj_10_FR "Life cycle of object_10
00????????";
CM_ SG_ 1366 ARC_OD_AabsX_Obj_10_FR "Longitudinal absolution acceleration over ground of object_10
00?????????????";
CM_ SG_ 1366 ARC_OD_DistY_Obj_10_FR "Lateral distance of object_10
00????????";
CM_ SG_ 1366 ARC_OD_ObstacleProb_Obj_10_FR "Obstacle probability of object_10
00?????????";
CM_ SG_ 1366 ARC_OD_VabsY_Obj_10_FR "Lateral absolution velocity over ground of object_10
00????????????";
CM_ SG_ 1366 ARC_OD_AabsY_Obj_10_FR "Lateral absolution acceleration over ground of object_10
00?????????????";
CM_ SG_ 1366 ARC_OD_DistXStd_Obj_10_FR "Longitudinal distance standard deviation of object_10
00???????????";
CM_ SG_ 1366 ARC_OD_DistYStd_Obj_10_FR "Lateral distance standard deviation of object_10
00???????????";
CM_ SG_ 1366 ARC_OD_VabsXStd_Obj_10_FR "Longitudinal absolution velocity standard deviation of object_10
00???????????????";
CM_ SG_ 1366 ARC_OD_VabsYStd_Obj_10_FR "Lateral absolution velocity standard deviation of object_10
00???????????????";
CM_ SG_ 1366 ARC_OD_AabsXStd_Obj_10_FR "Longitudinal absolution acceleration standard deviation of object_10
00????????????????";
CM_ SG_ 1365 ARC_OD_DistX_Obj_08_FR "Longitudinal distance of object_08
00????????";
CM_ SG_ 1365 ARC_OD_Classification_Obj_08_FR "Classification of object_08
00??????";
CM_ SG_ 1365 ARC_OD_AabsYStd_Obj_08_FR "Lateral absolution acceleration standard deviation of object_08
00????????????????";
CM_ SG_ 1365 ARC_OD_ClassConf_Obj_08_FR "Classification confidence of object_08
00?????????";
CM_ SG_ 1365 ARC_OD_ProbOfExist_Obj_08_FR "Existence probability of object_08
00????????";
CM_ SG_ 1365 ARC_OD_VabsX_Obj_08_FR "Longitudinal absolution velocity over ground of object_08
00????????????";
CM_ SG_ 1365 ARC_OD_DynProp_Obj_08_FR "Dynamic property of object_08
00????????";
CM_ SG_ 1365 ARC_OD_Length_Obj_08_FR "Length of object_08
00??????";
CM_ SG_ 1365 ARC_OD_MaintenanceState_Obj_0051 "Maintenance state of object_08
00????????";
CM_ SG_ 1365 ARC_OD_Width_Obj_08_FR "Width of object_08
00??????";
CM_ SG_ 1365 ARC_OD_RCS_Obj_08_FR "RCS of object_08
00?????????";
CM_ SG_ 1365 ARC_OD_Orientation_Obj_08_FR "Orientation of object_08
00???????";
CM_ SG_ 1365 ARC_OD_LifeCycle_Obj_08_FR "Life cycle of object_08
00????????";
CM_ SG_ 1365 ARC_OD_AabsX_Obj_08_FR "Longitudinal absolution acceleration over ground of object_08
00?????????????";
CM_ SG_ 1365 ARC_OD_DistY_Obj_08_FR "Lateral distance of object_08
00????????";
CM_ SG_ 1365 ARC_OD_ObstacleProb_Obj_08_FR "Obstacle probability of object_08
00?????????";
CM_ SG_ 1365 ARC_OD_VabsY_Obj_08_FR "Lateral absolution velocity over ground of object_08
00????????????";
CM_ SG_ 1365 ARC_OD_AabsY_Obj_08_FR "Lateral absolution acceleration over ground of object_08
00?????????????";
CM_ SG_ 1365 ARC_OD_DistXStd_Obj_08_FR "Longitudinal distance standard deviation of object_08
00???????????";
CM_ SG_ 1365 ARC_OD_DistYStd_Obj_08_FR "Lateral distance standard deviation of object_08
00???????????";
CM_ SG_ 1365 ARC_OD_VabsXStd_Obj_08_FR "Longitudinal absolution velocity standard deviation of object_08
00???????????????";
CM_ SG_ 1365 ARC_OD_VabsYStd_Obj_08_FR "Lateral absolution velocity standard deviation of object_08
00???????????????";
CM_ SG_ 1365 ARC_OD_AabsXStd_Obj_08_FR "Longitudinal absolution acceleration standard deviation of object_08
00????????????????";
CM_ SG_ 1364 ARC_OD_DistX_Obj_06_FR "Longitudinal distance of object_06
00????????";
CM_ SG_ 1364 ARC_OD_Classification_Obj_06_FR "Classification of object_06
00??????";
CM_ SG_ 1364 ARC_OD_AabsYStd_Obj_06_FR "Lateral absolution acceleration standard deviation of object_06
00????????????????";
CM_ SG_ 1364 ARC_OD_ClassConf_Obj_06_FR "Classification confidence of object_06
00?????????";
CM_ SG_ 1364 ARC_OD_ProbOfExist_Obj_06_FR "Existence probability of object_06
00????????";
CM_ SG_ 1364 ARC_OD_VabsX_Obj_06_FR "Longitudinal absolution velocity over ground of object_06
00????????????";
CM_ SG_ 1364 ARC_OD_DynProp_Obj_06_FR "Dynamic property of object_06
00????????";
CM_ SG_ 1364 ARC_OD_Length_Obj_06_FR "Length of object_06
00??????";
CM_ SG_ 1364 ARC_OD_MaintenanceState_Obj_0053 "Maintenance state of object_06
00????????";
CM_ SG_ 1364 ARC_OD_Width_Obj_06_FR "Width of object_06
00??????";
CM_ SG_ 1364 ARC_OD_RCS_Obj_06_FR "RCS of object_06
00?????????";
CM_ SG_ 1364 ARC_OD_Orientation_Obj_06_FR "Orientation of object_06
00???????";
CM_ SG_ 1364 ARC_OD_LifeCycle_Obj_06_FR "Life cycle of object_06
00????????";
CM_ SG_ 1364 ARC_OD_AabsX_Obj_06_FR "Longitudinal absolution acceleration over ground of object_06
00?????????????";
CM_ SG_ 1364 ARC_OD_DistY_Obj_06_FR "Lateral distance of object_06
00????????";
CM_ SG_ 1364 ARC_OD_ObstacleProb_Obj_06_FR "Obstacle probability of object_06
00?????????";
CM_ SG_ 1364 ARC_OD_VabsY_Obj_06_FR "Lateral absolution velocity over ground of object_06
00????????????";
CM_ SG_ 1364 ARC_OD_AabsY_Obj_06_FR "Lateral absolution acceleration over ground of object_06
00?????????????";
CM_ SG_ 1364 ARC_OD_DistXStd_Obj_06_FR "Longitudinal distance standard deviation of object_06
00???????????";
CM_ SG_ 1364 ARC_OD_DistYStd_Obj_06_FR "Lateral distance standard deviation of object_06
00???????????";
CM_ SG_ 1364 ARC_OD_VabsXStd_Obj_06_FR "Longitudinal absolution velocity standard deviation of object_06
00???????????????";
CM_ SG_ 1364 ARC_OD_VabsYStd_Obj_06_FR "Lateral absolution velocity standard deviation of object_06
00???????????????";
CM_ SG_ 1364 ARC_OD_AabsXStd_Obj_06_FR "Longitudinal absolution acceleration standard deviation of object_06
00????????????????";
CM_ SG_ 1363 ARC_OD_DistX_Obj_04_FR "Longitudinal distance of object_04
00????????";
CM_ SG_ 1363 ARC_OD_Classification_Obj_04_FR "Classification of object_04
00??????";
CM_ SG_ 1363 ARC_OD_AabsYStd_Obj_04_FR "Lateral absolution acceleration standard deviation of object_04
00????????????????";
CM_ SG_ 1363 ARC_OD_ClassConf_Obj_04_FR "Classification confidence of object_04
00?????????";
CM_ SG_ 1363 ARC_OD_ProbOfExist_Obj_04_FR "Existence probability of object_04
00????????";
CM_ SG_ 1363 ARC_OD_VabsX_Obj_04_FR "Longitudinal absolution velocity over ground of object_04
00????????????";
CM_ SG_ 1363 ARC_OD_DynProp_Obj_04_FR "Dynamic property of object_04
00????????";
CM_ SG_ 1363 ARC_OD_Length_Obj_04_FR "Length of object_04
00??????";
CM_ SG_ 1363 ARC_OD_MaintenanceState_Obj_0055 "Maintenance state of object_04
00????????";
CM_ SG_ 1363 ARC_OD_Width_Obj_04_FR "Width of object_04
00??????";
CM_ SG_ 1363 ARC_OD_RCS_Obj_04_FR "RCS of object_04
00?????????";
CM_ SG_ 1363 ARC_OD_Orientation_Obj_04_FR "Orientation of object_04
00???????";
CM_ SG_ 1363 ARC_OD_LifeCycle_Obj_04_FR "Life cycle of object_04
00????????";
CM_ SG_ 1363 ARC_OD_AabsX_Obj_04_FR "Longitudinal absolution acceleration over ground of object_04
00?????????????";
CM_ SG_ 1363 ARC_OD_DistY_Obj_04_FR "Lateral distance of object_04
00????????";
CM_ SG_ 1363 ARC_OD_ObstacleProb_Obj_04_FR "Obstacle probability of object_04
00?????????";
CM_ SG_ 1363 ARC_OD_VabsY_Obj_04_FR "Lateral absolution velocity over ground of object_04
00????????????";
CM_ SG_ 1363 ARC_OD_AabsY_Obj_04_FR "Lateral absolution acceleration over ground of object_04
00?????????????";
CM_ SG_ 1363 ARC_OD_DistXStd_Obj_04_FR "Longitudinal distance standard deviation of object_04
00???????????";
CM_ SG_ 1363 ARC_OD_DistYStd_Obj_04_FR "Lateral distance standard deviation of object_04
00???????????";
CM_ SG_ 1363 ARC_OD_VabsXStd_Obj_04_FR "Longitudinal absolution velocity standard deviation of object_04
00???????????????";
CM_ SG_ 1363 ARC_OD_VabsYStd_Obj_04_FR "Lateral absolution velocity standard deviation of object_04
00???????????????";
CM_ SG_ 1363 ARC_OD_AabsXStd_Obj_04_FR "Longitudinal absolution acceleration standard deviation of object_04
00????????????????";
CM_ SG_ 1362 ARC_OD_DistX_Obj_02_FR "111";
CM_ SG_ 1362 ARC_OD_Classification_Obj_02_FR "Classification of object_02
00??????";
CM_ SG_ 1362 ARC_OD_AabsYStd_Obj_02_FR "Lateral absolution acceleration standard deviation of object_02
00????????????????";
CM_ SG_ 1362 ARC_OD_ClassConf_Obj_02_FR "Classification confidence of object_02
00?????????";
CM_ SG_ 1362 ARC_OD_ProbOfExist_Obj_02_FR "Existence probability of object_02
00????????";
CM_ SG_ 1362 ARC_OD_VabsX_Obj_02_FR "Longitudinal absolution velocity over ground of object_02
00????????????";
CM_ SG_ 1362 ARC_OD_DynProp_Obj_02_FR "Dynamic property of object_02
00????????";
CM_ SG_ 1362 ARC_OD_Length_Obj_02_FR "Length of object_02
00??????";
CM_ SG_ 1362 ARC_OD_MaintenanceState_Obj_0057 "Maintenance state of object_02
00????????";
CM_ SG_ 1362 ARC_OD_Width_Obj_02_FR "Width of object_02
00??????";
CM_ SG_ 1362 ARC_OD_RCS_Obj_02_FR "RCS of object_02
00?????????";
CM_ SG_ 1362 ARC_OD_Orientation_Obj_02_FR "Orientation of object_02
00???????";
CM_ SG_ 1362 ARC_OD_LifeCycle_Obj_02_FR "Life cycle of object_02
00????????";
CM_ SG_ 1362 ARC_OD_AabsX_Obj_02_FR "Longitudinal absolution acceleration over ground of object_02
00?????????????";
CM_ SG_ 1362 ARC_OD_DistY_Obj_02_FR "Lateral distance of object_02
00????????";
CM_ SG_ 1362 ARC_OD_ObstacleProb_Obj_02_FR "Obstacle probability of object_02
00?????????";
CM_ SG_ 1362 ARC_OD_VabsY_Obj_02_FR "Lateral absolution velocity over ground of object_02
00????????????";
CM_ SG_ 1362 ARC_OD_AabsY_Obj_02_FR "Lateral absolution acceleration over ground of object_02
00?????????????";
CM_ SG_ 1362 ARC_OD_DistXStd_Obj_02_FR "Longitudinal distance standard deviation of object_02
00???????????";
CM_ SG_ 1362 ARC_OD_DistYStd_Obj_02_FR "Lateral distance standard deviation of object_02
00???????????";
CM_ SG_ 1362 ARC_OD_VabsXStd_Obj_02_FR "Longitudinal absolution velocity standard deviation of object_02
00???????????????";
CM_ SG_ 1362 ARC_OD_VabsYStd_Obj_02_FR "Lateral absolution velocity standard deviation of object_02
00???????????????";
CM_ SG_ 1362 ARC_OD_AabsXStd_Obj_02_FR "Longitudinal absolution acceleration standard deviation of object_02
00????????????????";
CM_ SG_ 1361 ARC_OD_DistX_Obj_00_FR "Longitudinal distance of object_00
00????????";
CM_ SG_ 1361 ARC_OD_Classification_Obj_00_FR "Classification of object_00
";
CM_ SG_ 1361 ARC_OD_AabsYStd_Obj_00_FR "Lateral absolution acceleration standard deviation of object_00
00????????????????";
CM_ SG_ 1361 ARC_OD_ClassConf_Obj_00_FR "Classification confidence of object_00
00?????????";
CM_ SG_ 1361 ARC_OD_ProbOfExist_Obj_00_FR "Existence probability of object_00
00????????";
CM_ SG_ 1361 ARC_OD_VabsX_Obj_00_FR "Longitudinal absolution velocity over ground of object_00
00????????????";
CM_ SG_ 1361 ARC_OD_DynProp_Obj_00_FR "Dynamic property of object_00
00????????";
CM_ SG_ 1361 ARC_OD_Length_Obj_00_FR "Length of object_00
00??????";
CM_ SG_ 1361 ARC_OD_MaintenanceState_Obj_0059 "Maintenance state of object_00
00????????";
CM_ SG_ 1361 ARC_OD_Width_Obj_00_FR "Width of object_00
00??????";
CM_ SG_ 1361 ARC_OD_RCS_Obj_00_FR "RCS of object_00
00?????????";
CM_ SG_ 1361 ARC_OD_Orientation_Obj_00_FR "Orientation of object_00
00???????";
CM_ SG_ 1361 ARC_OD_LifeCycle_Obj_00_FR "Life cycle of object_00
00????????";
CM_ SG_ 1361 ARC_OD_AabsX_Obj_00_FR "Longitudinal absolution acceleration over ground of object_00
00?????????????";
CM_ SG_ 1361 ARC_OD_DistY_Obj_00_FR "Lateral distance of object_00
00????????";
CM_ SG_ 1361 ARC_OD_ObstacleProb_Obj_00_FR "Obstacle probability of object_00
00?????????";
CM_ SG_ 1361 ARC_OD_VabsY_Obj_00_FR "Lateral absolution velocity over ground of object_00
00????????????";
CM_ SG_ 1361 ARC_OD_AabsY_Obj_00_FR "Lateral absolution acceleration over ground of object_00
00?????????????";
CM_ SG_ 1361 ARC_OD_DistXStd_Obj_00_FR "Longitudinal distance standard deviation of object_00
00???????????";
CM_ SG_ 1361 ARC_OD_DistYStd_Obj_00_FR "Lateral distance standard deviation of object_00
00???????????";
CM_ SG_ 1361 ARC_OD_VabsXStd_Obj_00_FR "Longitudinal absolution velocity standard deviation of object_00
00???????????????";
CM_ SG_ 1361 ARC_OD_VabsYStd_Obj_00_FR "Lateral absolution velocity standard deviation of object_00
00???????????????";
CM_ SG_ 1361 ARC_OD_AabsXStd_Obj_00_FR "Longitudinal absolution acceleration standard deviation of object_00
00????????????????";
CM_ SG_ 1134 ARC_OD_DistX_Obj_58_RR "Longitudinal distance of object_58
00????????";
CM_ SG_ 1134 ARC_OD_Classification_Obj_58_RR "Classification of object_58
00??????";
CM_ SG_ 1134 ARC_OD_AabsYStd_Obj_58_RR "Lateral absolution acceleration standard deviation of object_58
00????????????????";
CM_ SG_ 1134 ARC_OD_ClassConf_Obj_58_RR "Classification confidence of object_58
00?????????";
CM_ SG_ 1134 ARC_OD_ProbOfExist_Obj_58_RR "Existence probability of object_58
00????????";
CM_ SG_ 1134 ARC_OD_VabsX_Obj_58_RR "Longitudinal absolution velocity over ground of object_58
00????????????";
CM_ SG_ 1134 ARC_OD_DynProp_Obj_58_RR "Dynamic property of object_58
00????????";
CM_ SG_ 1134 ARC_OD_Length_Obj_58_RR "Length of object_58
00??????";
CM_ SG_ 1134 ARC_OD_MaintenanceState_Obj_58_R "Maintenance state of object_58
00????????";
CM_ SG_ 1134 ARC_OD_Width_Obj_58_RR "Width of object_58
00??????";
CM_ SG_ 1134 ARC_OD_RCS_Obj_58_RR "RCS of object_58
00?????????";
CM_ SG_ 1134 ARC_OD_Orientation_Obj_58_RR "Orientation of object_58
00???????";
CM_ SG_ 1134 ARC_OD_LifeCycle_Obj_58_RR "Life cycle of object_58
00????????";
CM_ SG_ 1134 ARC_OD_AabsX_Obj_58_RR "Longitudinal absolution acceleration over ground of object_58
00?????????????";
CM_ SG_ 1134 ARC_OD_DistY_Obj_58_RR "Lateral distance of object_58
00????????";
CM_ SG_ 1134 ARC_OD_ObstacleProb_Obj_58_RR "Obstacle probability of object_58
00?????????";
CM_ SG_ 1134 ARC_OD_VabsY_Obj_58_RR "Lateral absolution velocity over ground of object_58
00????????????";
CM_ SG_ 1134 ARC_OD_AabsY_Obj_58_RR "Lateral absolution acceleration over ground of object_58
00?????????????";
CM_ SG_ 1134 ARC_OD_DistXStd_Obj_58_RR "Longitudinal distance standard deviation of object_58
00???????????";
CM_ SG_ 1134 ARC_OD_DistYStd_Obj_58_RR "Lateral distance standard deviation of object_58
00???????????";
CM_ SG_ 1134 ARC_OD_VabsXStd_Obj_58_RR "Longitudinal absolution velocity standard deviation of object_58
00???????????????";
CM_ SG_ 1134 ARC_OD_VabsYStd_Obj_58_RR "Lateral absolution velocity standard deviation of object_58
00???????????????";
CM_ SG_ 1134 ARC_OD_AabsXStd_Obj_58_RR "Longitudinal absolution acceleration standard deviation of object_58
00????????????????";
BA_DEF_ BO_  "GenMsgCycleTime" INT 0 0;
BA_DEF_ BO_  "GenMsgSendType" ENUM  "Cyclic","NotUsed","Event","NotUsed","NotUsed","NotUsed","NotUsed","IfActive","NoMsgSendType","NotUsed";
BA_DEF_ BO_  "GenMsgStartDelayTime" INT 0 0;
BA_DEF_ BO_  "VFrameFormat" ENUM  "StandardCAN","ExtendedCAN","reserved","reserved","reserved","reserved","reserved","reserved","reserved","reserved","reserved","reserved","reserved","reserved","StandardCAN_FD","ExtendedCAN_FD";
BA_DEF_ SG_  "GenSigInactiveValue" INT 0 0;
BA_DEF_ SG_  "GenSigSendType" ENUM  "Cyclic","OnWrite","OnWriteWithRepetition","OnChange","OnChangeWithRepetition","IfActive","IfActiveWithRepetition","NoSigSendType","NotUsed","NotUsed","NotUsed","NotUsed","NotUsed";
BA_DEF_ SG_  "GenSigStartValue" INT 0 0;
BA_DEF_ SG_  "SystemSignalLongSymbol" STRING ;
BA_DEF_DEF_  "GenMsgCycleTime" 0;
BA_DEF_DEF_  "GenMsgSendType" "Cyclic";
BA_DEF_DEF_  "GenMsgStartDelayTime" 0;
BA_DEF_DEF_  "VFrameFormat" "ExtendedCAN_FD";
BA_DEF_DEF_  "GenSigInactiveValue" 0;
BA_DEF_DEF_  "GenSigSendType" "Cyclic";
BA_DEF_DEF_  "GenSigStartValue" 0;
BA_DEF_DEF_  "SystemSignalLongSymbol" "";
BA_ "GenMsgCycleTime" BO_ 1380 50;
BA_ "VFrameFormat" BO_ 1380 14;
BA_ "GenMsgCycleTime" BO_ 1379 50;
BA_ "VFrameFormat" BO_ 1379 14;
BA_ "GenMsgCycleTime" BO_ 1378 50;
BA_ "VFrameFormat" BO_ 1378 14;
BA_ "GenMsgCycleTime" BO_ 1377 50;
BA_ "VFrameFormat" BO_ 1377 14;
BA_ "GenMsgCycleTime" BO_ 1376 50;
BA_ "VFrameFormat" BO_ 1376 14;
BA_ "GenMsgCycleTime" BO_ 1375 50;
BA_ "VFrameFormat" BO_ 1375 14;
BA_ "GenMsgCycleTime" BO_ 1374 50;
BA_ "VFrameFormat" BO_ 1374 14;
BA_ "GenMsgCycleTime" BO_ 1373 50;
BA_ "VFrameFormat" BO_ 1373 14;
BA_ "GenMsgCycleTime" BO_ 1372 50;
BA_ "VFrameFormat" BO_ 1372 14;
BA_ "GenMsgCycleTime" BO_ 1371 50;
BA_ "VFrameFormat" BO_ 1371 14;
BA_ "GenMsgCycleTime" BO_ 1370 50;
BA_ "VFrameFormat" BO_ 1370 14;
BA_ "GenMsgCycleTime" BO_ 1369 50;
BA_ "VFrameFormat" BO_ 1369 14;
BA_ "GenMsgCycleTime" BO_ 1368 50;
BA_ "VFrameFormat" BO_ 1368 14;
BA_ "GenMsgCycleTime" BO_ 1367 50;
BA_ "VFrameFormat" BO_ 1367 14;
BA_ "GenMsgCycleTime" BO_ 1366 50;
BA_ "VFrameFormat" BO_ 1366 14;
BA_ "GenMsgCycleTime" BO_ 1365 50;
BA_ "VFrameFormat" BO_ 1365 14;
BA_ "GenMsgCycleTime" BO_ 1364 50;
BA_ "VFrameFormat" BO_ 1364 14;
BA_ "GenMsgCycleTime" BO_ 1363 50;
BA_ "VFrameFormat" BO_ 1363 14;
BA_ "GenMsgCycleTime" BO_ 1362 50;
BA_ "VFrameFormat" BO_ 1362 14;
BA_ "GenMsgCycleTime" BO_ 1361 50;
BA_ "VFrameFormat" BO_ 1361 14;
BA_ "GenMsgCycleTime" BO_ 1134 50;
BA_ "VFrameFormat" BO_ 1134 14;
BA_ "SystemSignalLongSymbol" SG_ 1380 ARC_OD_MaintenanceState_Obj_0021 "ARC_OD_MaintenanceState_Obj_38_FR";
BA_ "SystemSignalLongSymbol" SG_ 1380 ARC_OD_MaintenanceState_Obj_0022 "ARC_OD_MaintenanceState_Obj_39_FR";
BA_ "SystemSignalLongSymbol" SG_ 1379 ARC_OD_MaintenanceState_Obj_0023 "ARC_OD_MaintenanceState_Obj_36_FR";
BA_ "SystemSignalLongSymbol" SG_ 1379 ARC_OD_MaintenanceState_Obj_0024 "ARC_OD_MaintenanceState_Obj_37_FR";
BA_ "SystemSignalLongSymbol" SG_ 1378 ARC_OD_MaintenanceState_Obj_0025 "ARC_OD_MaintenanceState_Obj_34_FR";
BA_ "SystemSignalLongSymbol" SG_ 1378 ARC_OD_MaintenanceState_Obj_0026 "ARC_OD_MaintenanceState_Obj_35_FR";
BA_ "SystemSignalLongSymbol" SG_ 1377 ARC_OD_MaintenanceState_Obj_0027 "ARC_OD_MaintenanceState_Obj_32_FR";
BA_ "SystemSignalLongSymbol" SG_ 1377 ARC_OD_MaintenanceState_Obj_0028 "ARC_OD_MaintenanceState_Obj_33_FR";
BA_ "SystemSignalLongSymbol" SG_ 1376 ARC_OD_MaintenanceState_Obj_0029 "ARC_OD_MaintenanceState_Obj_30_FR";
BA_ "SystemSignalLongSymbol" SG_ 1376 ARC_OD_MaintenanceState_Obj_0030 "ARC_OD_MaintenanceState_Obj_31_FR";
BA_ "SystemSignalLongSymbol" SG_ 1375 ARC_OD_MaintenanceState_Obj_0031 "ARC_OD_MaintenanceState_Obj_28_FR";
BA_ "SystemSignalLongSymbol" SG_ 1375 ARC_OD_MaintenanceState_Obj_0032 "ARC_OD_MaintenanceState_Obj_29_FR";
BA_ "SystemSignalLongSymbol" SG_ 1374 ARC_OD_MaintenanceState_Obj_0033 "ARC_OD_MaintenanceState_Obj_26_FR";
BA_ "SystemSignalLongSymbol" SG_ 1374 ARC_OD_MaintenanceState_Obj_0034 "ARC_OD_MaintenanceState_Obj_27_FR";
BA_ "SystemSignalLongSymbol" SG_ 1373 ARC_OD_MaintenanceState_Obj_0035 "ARC_OD_MaintenanceState_Obj_24_FR";
BA_ "SystemSignalLongSymbol" SG_ 1373 ARC_OD_MaintenanceState_Obj_0036 "ARC_OD_MaintenanceState_Obj_25_FR";
BA_ "SystemSignalLongSymbol" SG_ 1372 ARC_OD_MaintenanceState_Obj_0037 "ARC_OD_MaintenanceState_Obj_22_FR";
BA_ "SystemSignalLongSymbol" SG_ 1372 ARC_OD_MaintenanceState_Obj_0038 "ARC_OD_MaintenanceState_Obj_23_FR";
BA_ "SystemSignalLongSymbol" SG_ 1371 ARC_OD_MaintenanceState_Obj_0039 "ARC_OD_MaintenanceState_Obj_20_FR";
BA_ "SystemSignalLongSymbol" SG_ 1371 ARC_OD_MaintenanceState_Obj_0040 "ARC_OD_MaintenanceState_Obj_21_FR";
BA_ "SystemSignalLongSymbol" SG_ 1370 ARC_OD_MaintenanceState_Obj_0041 "ARC_OD_MaintenanceState_Obj_18_FR";
BA_ "SystemSignalLongSymbol" SG_ 1370 ARC_OD_MaintenanceState_Obj_0042 "ARC_OD_MaintenanceState_Obj_19_FR";
BA_ "SystemSignalLongSymbol" SG_ 1369 ARC_OD_MaintenanceState_Obj_0043 "ARC_OD_MaintenanceState_Obj_16_FR";
BA_ "SystemSignalLongSymbol" SG_ 1369 ARC_OD_MaintenanceState_Obj_0044 "ARC_OD_MaintenanceState_Obj_17_FR";
BA_ "SystemSignalLongSymbol" SG_ 1368 ARC_OD_MaintenanceState_Obj_0045 "ARC_OD_MaintenanceState_Obj_14_FR";
BA_ "SystemSignalLongSymbol" SG_ 1368 ARC_OD_MaintenanceState_Obj_0046 "ARC_OD_MaintenanceState_Obj_15_FR";
BA_ "SystemSignalLongSymbol" SG_ 1367 ARC_OD_MaintenanceState_Obj_0047 "ARC_OD_MaintenanceState_Obj_12_FR";
BA_ "SystemSignalLongSymbol" SG_ 1367 ARC_OD_MaintenanceState_Obj_0048 "ARC_OD_MaintenanceState_Obj_13_FR";
BA_ "SystemSignalLongSymbol" SG_ 1366 ARC_OD_MaintenanceState_Obj_0049 "ARC_OD_MaintenanceState_Obj_10_FR";
BA_ "SystemSignalLongSymbol" SG_ 1366 ARC_OD_MaintenanceState_Obj_0050 "ARC_OD_MaintenanceState_Obj_11_FR";
BA_ "SystemSignalLongSymbol" SG_ 1365 ARC_OD_MaintenanceState_Obj_0051 "ARC_OD_MaintenanceState_Obj_08_FR";
BA_ "SystemSignalLongSymbol" SG_ 1365 ARC_OD_MaintenanceState_Obj_0052 "ARC_OD_MaintenanceState_Obj_09_FR";
BA_ "SystemSignalLongSymbol" SG_ 1364 ARC_OD_MaintenanceState_Obj_0053 "ARC_OD_MaintenanceState_Obj_06_FR";
BA_ "SystemSignalLongSymbol" SG_ 1364 ARC_OD_MaintenanceState_Obj_0054 "ARC_OD_MaintenanceState_Obj_07_FR";
BA_ "SystemSignalLongSymbol" SG_ 1363 ARC_OD_MaintenanceState_Obj_0055 "ARC_OD_MaintenanceState_Obj_04_FR";
BA_ "SystemSignalLongSymbol" SG_ 1363 ARC_OD_MaintenanceState_Obj_0056 "ARC_OD_MaintenanceState_Obj_05_FR";
BA_ "SystemSignalLongSymbol" SG_ 1362 ARC_OD_MaintenanceState_Obj_0057 "ARC_OD_MaintenanceState_Obj_02_FR";
BA_ "SystemSignalLongSymbol" SG_ 1362 ARC_OD_MaintenanceState_Obj_0058 "ARC_OD_MaintenanceState_Obj_03_FR";
BA_ "SystemSignalLongSymbol" SG_ 1361 ARC_OD_MaintenanceState_Obj_0059 "ARC_OD_MaintenanceState_Obj_00_FR";
BA_ "SystemSignalLongSymbol" SG_ 1361 ARC_OD_MaintenanceState_Obj_0060 "ARC_OD_MaintenanceState_Obj_01_FR";
BA_ "SystemSignalLongSymbol" SG_ 1134 ARC_OD_MaintenanceState_Obj_58_R "ARC_OD_MaintenanceState_Obj_58_RR";
BA_ "SystemSignalLongSymbol" SG_ 1134 ARC_OD_MaintenanceState_Obj_59_R "ARC_OD_MaintenanceState_Obj_59_RR";
VAL_ 1380 ARC_OD_Classification_Obj_38_FR 0 "Unknow" 1 "Person" 2 "Bimo" 3 "Car" 4 "Truck" 5 "Barrier" 6 "Reserved" 7 "Reserved" ;
VAL_ 1380 ARC_OD_DynProp_Obj_38_FR 0 "MOVING" 1 "STATIONARY" 2 "ONCOMING" 3 "CROSSING_LEFT2RIGHT" 4 "CROSSING_RIGHT2LEFT" 5 "UNKNOWN" 6 "STOPPED" 7 "RESERVED" ;
VAL_ 1380 ARC_OD_MaintenanceState_Obj_0021 0 "INVALID" 1 "NEW" 2 "MEASURED" 3 "PREDICTED" ;
VAL_ 1380 ARC_OD_Classification_Obj_39_FR 0 "Unknow" 1 "Person" 2 "Bimo" 3 "Car" 4 "Truck" 5 "Barrier" 6 "Reserved" 7 "Reserved" ;
VAL_ 1380 ARC_OD_DynProp_Obj_39_FR 0 "STATIONAR" 1 "MOVIN" 2 "ONCOMING" 3 "STOPPE" 4 "CROSSING_LEFT2RIGH" 5 "CROSSING_RIGHT2LEF" 6 "RESERVE" 7 "RESERVED" ;
VAL_ 1380 ARC_OD_MaintenanceState_Obj_0022 0 "INVALID" 1 "NEW" 2 "MEASURED" 3 "PREDICTED" ;
VAL_ 1379 ARC_OD_Classification_Obj_36_FR 0 "Unknow" 1 "Person" 2 "Bimo" 3 "Car" 4 "Truck" 5 "Barrier" 6 "Reserved" 7 "Reserved" ;
VAL_ 1379 ARC_OD_DynProp_Obj_36_FR 0 "MOVING" 1 "STATIONARY" 2 "ONCOMING" 3 "CROSSING_LEFT2RIGHT" 4 "CROSSING_RIGHT2LEFT" 5 "UNKNOWN" 6 "STOPPED" 7 "RESERVED" ;
VAL_ 1379 ARC_OD_MaintenanceState_Obj_0023 0 "INVALID" 1 "NEW" 2 "MEASURED" 3 "PREDICTED" ;
VAL_ 1379 ARC_OD_Classification_Obj_37_FR 0 "Unknow" 1 "Person" 2 "Bimo" 3 "Car" 4 "Truck" 5 "Barrier" 6 "Reserved" 7 "Reserved" ;
VAL_ 1379 ARC_OD_DynProp_Obj_37_FR 0 "STATIONAR" 1 "MOVIN" 2 "ONCOMING" 3 "STOPPE" 4 "CROSSING_LEFT2RIGH" 5 "CROSSING_RIGHT2LEF" 6 "RESERVE" 7 "RESERVED" ;
VAL_ 1379 ARC_OD_MaintenanceState_Obj_0024 0 "INVALID" 1 "NEW" 2 "MEASURED" 3 "PREDICTED" ;
VAL_ 1378 ARC_OD_Classification_Obj_34_FR 0 "Unknow" 1 "Person" 2 "Bimo" 3 "Car" 4 "Truck" 5 "Barrier" 6 "Reserved" 7 "Reserved" ;
VAL_ 1378 ARC_OD_DynProp_Obj_34_FR 0 "MOVING" 1 "STATIONARY" 2 "ONCOMING" 3 "CROSSING_LEFT2RIGHT" 4 "CROSSING_RIGHT2LEFT" 5 "UNKNOWN" 6 "STOPPED" 7 "RESERVED" ;
VAL_ 1378 ARC_OD_MaintenanceState_Obj_0025 0 "INVALID" 1 "NEW" 2 "MEASURED" 3 "PREDICTED" ;
VAL_ 1378 ARC_OD_Classification_Obj_35_FR 0 "Unknow" 1 "Person" 2 "Bimo" 3 "Car" 4 "Truck" 5 "Barrier" 6 "Reserved" 7 "Reserved" ;
VAL_ 1378 ARC_OD_DynProp_Obj_35_FR 0 "STATIONAR" 1 "MOVIN" 2 "ONCOMING" 3 "STOPPE" 4 "CROSSING_LEFT2RIGH" 5 "CROSSING_RIGHT2LEF" 6 "RESERVE" 7 "RESERVED" ;
VAL_ 1378 ARC_OD_MaintenanceState_Obj_0026 0 "INVALID" 1 "NEW" 2 "MEASURED" 3 "PREDICTED" ;
VAL_ 1377 ARC_OD_Classification_Obj_32_FR 0 "Unknow" 1 "Person" 2 "Bimo" 3 "Car" 4 "Truck" 5 "Barrier" 6 "Reserved" 7 "Reserved" ;
VAL_ 1377 ARC_OD_DynProp_Obj_32_FR 0 "MOVING" 1 "STATIONARY" 2 "ONCOMING" 3 "CROSSING_LEFT2RIGHT" 4 "CROSSING_RIGHT2LEFT" 5 "UNKNOWN" 6 "STOPPED" 7 "RESERVED" ;
VAL_ 1377 ARC_OD_MaintenanceState_Obj_0027 0 "INVALID" 1 "NEW" 2 "MEASURED" 3 "PREDICTED" ;
VAL_ 1377 ARC_OD_Classification_Obj_33_FR 0 "Unknow" 1 "Person" 2 "Bimo" 3 "Car" 4 "Truck" 5 "Barrier" 6 "Reserved" 7 "Reserved" ;
VAL_ 1377 ARC_OD_DynProp_Obj_33_FR 0 "STATIONAR" 1 "MOVIN" 2 "ONCOMING" 3 "STOPPE" 4 "CROSSING_LEFT2RIGH" 5 "CROSSING_RIGHT2LEF" 6 "RESERVE" 7 "RESERVED" ;
VAL_ 1377 ARC_OD_MaintenanceState_Obj_0028 0 "INVALID" 1 "NEW" 2 "MEASURED" 3 "PREDICTED" ;
VAL_ 1376 ARC_OD_Classification_Obj_30_FR 0 "Unknow" 1 "Person" 2 "Bimo" 3 "Car" 4 "Truck" 5 "Barrier" 6 "Reserved" 7 "Reserved" ;
VAL_ 1376 ARC_OD_DynProp_Obj_30_FR 0 "MOVING" 1 "STATIONARY" 2 "ONCOMING" 3 "CROSSING_LEFT2RIGHT" 4 "CROSSING_RIGHT2LEFT" 5 "UNKNOWN" 6 "STOPPED" 7 "RESERVED" ;
VAL_ 1376 ARC_OD_MaintenanceState_Obj_0029 0 "INVALID" 1 "NEW" 2 "MEASURED" 3 "PREDICTED" ;
VAL_ 1376 ARC_OD_Classification_Obj_31_FR 0 "Unknow" 1 "Person" 2 "Bimo" 3 "Car" 4 "Truck" 5 "Barrier" 6 "Reserved" 7 "Reserved" ;
VAL_ 1376 ARC_OD_DynProp_Obj_31_FR 0 "STATIONAR" 1 "MOVIN" 2 "ONCOMING" 3 "STOPPE" 4 "CROSSING_LEFT2RIGH" 5 "CROSSING_RIGHT2LEF" 6 "RESERVE" 7 "RESERVED" ;
VAL_ 1376 ARC_OD_MaintenanceState_Obj_0030 0 "INVALID" 1 "NEW" 2 "MEASURED" 3 "PREDICTED" ;
VAL_ 1375 ARC_OD_Classification_Obj_28_FR 0 "Unknow" 1 "Person" 2 "Bimo" 3 "Car" 4 "Truck" 5 "Barrier" 6 "Reserved" 7 "Reserved" ;
VAL_ 1375 ARC_OD_DynProp_Obj_28_FR 0 "MOVING" 1 "STATIONARY" 2 "ONCOMING" 3 "CROSSING_LEFT2RIGHT" 4 "CROSSING_RIGHT2LEFT" 5 "UNKNOWN" 6 "STOPPED" 7 "RESERVED" ;
VAL_ 1375 ARC_OD_MaintenanceState_Obj_0031 0 "INVALID" 1 "NEW" 2 "MEASURED" 3 "PREDICTED" ;
VAL_ 1375 ARC_OD_Classification_Obj_29_FR 0 "Unknow" 1 "Person" 2 "Bimo" 3 "Car" 4 "Truck" 5 "Barrier" 6 "Reserved" 7 "Reserved" ;
VAL_ 1375 ARC_OD_DynProp_Obj_29_FR 0 "STATIONAR" 1 "MOVIN" 2 "ONCOMING" 3 "STOPPE" 4 "CROSSING_LEFT2RIGH" 5 "CROSSING_RIGHT2LEF" 6 "RESERVE" 7 "RESERVED" ;
VAL_ 1375 ARC_OD_MaintenanceState_Obj_0032 0 "INVALID" 1 "NEW" 2 "MEASURED" 3 "PREDICTED" ;
VAL_ 1374 ARC_OD_Classification_Obj_26_FR 0 "Unknow" 1 "Person" 2 "Bimo" 3 "Car" 4 "Truck" 5 "Barrier" 6 "Reserved" 7 "Reserved" ;
VAL_ 1374 ARC_OD_DynProp_Obj_26_FR 0 "MOVING" 1 "STATIONARY" 2 "ONCOMING" 3 "CROSSING_LEFT2RIGHT" 4 "CROSSING_RIGHT2LEFT" 5 "UNKNOWN" 6 "STOPPED" 7 "RESERVED" ;
VAL_ 1374 ARC_OD_MaintenanceState_Obj_0033 0 "INVALID" 1 "NEW" 2 "MEASURED" 3 "PREDICTED" ;
VAL_ 1374 ARC_OD_Classification_Obj_27_FR 0 "Unknow" 1 "Person" 2 "Bimo" 3 "Car" 4 "Truck" 5 "Barrier" 6 "Reserved" 7 "Reserved" ;
VAL_ 1374 ARC_OD_DynProp_Obj_27_FR 0 "STATIONAR" 1 "MOVIN" 2 "ONCOMING" 3 "STOPPE" 4 "CROSSING_LEFT2RIGH" 5 "CROSSING_RIGHT2LEF" 6 "RESERVE" 7 "RESERVED" ;
VAL_ 1374 ARC_OD_MaintenanceState_Obj_0034 0 "INVALID" 1 "NEW" 2 "MEASURED" 3 "PREDICTED" ;
VAL_ 1373 ARC_OD_Classification_Obj_24_FR 0 "Unknow" 1 "Person" 2 "Bimo" 3 "Car" 4 "Truck" 5 "Barrier" 6 "Reserved" 7 "Reserved" ;
VAL_ 1373 ARC_OD_DynProp_Obj_24_FR 0 "MOVING" 1 "STATIONARY" 2 "ONCOMING" 3 "CROSSING_LEFT2RIGHT" 4 "CROSSING_RIGHT2LEFT" 5 "UNKNOWN" 6 "STOPPED" 7 "RESERVED" ;
VAL_ 1373 ARC_OD_MaintenanceState_Obj_0035 0 "INVALID" 1 "NEW" 2 "MEASURED" 3 "PREDICTED" ;
VAL_ 1373 ARC_OD_Classification_Obj_25_FR 0 "Unknow" 1 "Person" 2 "Bimo" 3 "Car" 4 "Truck" 5 "Barrier" 6 "Reserved" 7 "Reserved" ;
VAL_ 1373 ARC_OD_DynProp_Obj_25_FR 0 "STATIONAR" 1 "MOVIN" 2 "ONCOMING" 3 "STOPPE" 4 "CROSSING_LEFT2RIGH" 5 "CROSSING_RIGHT2LEF" 6 "RESERVE" 7 "RESERVED" ;
VAL_ 1373 ARC_OD_MaintenanceState_Obj_0036 0 "INVALID" 1 "NEW" 2 "MEASURED" 3 "PREDICTED" ;
VAL_ 1372 ARC_OD_Classification_Obj_22_FR 0 "Unknow" 1 "Person" 2 "Bimo" 3 "Car" 4 "Truck" 5 "Barrier" 6 "Reserved" 7 "Reserved" ;
VAL_ 1372 ARC_OD_DynProp_Obj_22_FR 0 "MOVING" 1 "STATIONARY" 2 "ONCOMING" 3 "CROSSING_LEFT2RIGHT" 4 "CROSSING_RIGHT2LEFT" 5 "UNKNOWN" 6 "STOPPED" 7 "RESERVED" ;
VAL_ 1372 ARC_OD_MaintenanceState_Obj_0037 0 "INVALID" 1 "NEW" 2 "MEASURED" 3 "PREDICTED" ;
VAL_ 1372 ARC_OD_Classification_Obj_23_FR 0 "Unknow" 1 "Person" 2 "Bimo" 3 "Car" 4 "Truck" 5 "Barrier" 6 "Reserved" 7 "Reserved" ;
VAL_ 1372 ARC_OD_DynProp_Obj_23_FR 0 "STATIONAR" 1 "MOVIN" 2 "ONCOMING" 3 "STOPPE" 4 "CROSSING_LEFT2RIGH" 5 "CROSSING_RIGHT2LEF" 6 "RESERVE" 7 "RESERVED" ;
VAL_ 1372 ARC_OD_MaintenanceState_Obj_0038 0 "INVALID" 1 "NEW" 2 "MEASURED" 3 "PREDICTED" ;
VAL_ 1371 ARC_OD_Classification_Obj_20_FR 0 "Unknow" 1 "Person" 2 "Bimo" 3 "Car" 4 "Truck" 5 "Barrier" 6 "Reserved" 7 "Reserved" ;
VAL_ 1371 ARC_OD_DynProp_Obj_20_FR 0 "MOVING" 1 "STATIONARY" 2 "ONCOMING" 3 "CROSSING_LEFT2RIGHT" 4 "CROSSING_RIGHT2LEFT" 5 "UNKNOWN" 6 "STOPPED" 7 "RESERVED" ;
VAL_ 1371 ARC_OD_MaintenanceState_Obj_0039 0 "INVALID" 1 "NEW" 2 "MEASURED" 3 "PREDICTED" ;
VAL_ 1371 ARC_OD_Classification_Obj_21_FR 0 "Unknow" 1 "Person" 2 "Bimo" 3 "Car" 4 "Truck" 5 "Barrier" 6 "Reserved" 7 "Reserved" ;
VAL_ 1371 ARC_OD_DynProp_Obj_21_FR 0 "STATIONAR" 1 "MOVIN" 2 "ONCOMING" 3 "STOPPE" 4 "CROSSING_LEFT2RIGH" 5 "CROSSING_RIGHT2LEF" 6 "RESERVE" 7 "RESERVED" ;
VAL_ 1371 ARC_OD_MaintenanceState_Obj_0040 0 "INVALID" 1 "NEW" 2 "MEASURED" 3 "PREDICTED" ;
VAL_ 1370 ARC_OD_Classification_Obj_18_FR 0 "Unknow" 1 "Person" 2 "Bimo" 3 "Car" 4 "Truck" 5 "Barrier" 6 "Reserved" 7 "Reserved" ;
VAL_ 1370 ARC_OD_DynProp_Obj_18_FR 0 "MOVING" 1 "STATIONARY" 2 "ONCOMING" 3 "CROSSING_LEFT2RIGHT" 4 "CROSSING_RIGHT2LEFT" 5 "UNKNOWN" 6 "STOPPED" 7 "RESERVED" ;
VAL_ 1370 ARC_OD_MaintenanceState_Obj_0041 0 "INVALID" 1 "NEW" 2 "MEASURED" 3 "PREDICTED" ;
VAL_ 1370 ARC_OD_Classification_Obj_19_FR 0 "Unknow" 1 "Person" 2 "Bimo" 3 "Car" 4 "Truck" 5 "Barrier" 6 "Reserved" 7 "Reserved" ;
VAL_ 1370 ARC_OD_DynProp_Obj_19_FR 0 "STATIONAR" 1 "MOVIN" 2 "ONCOMING" 3 "STOPPE" 4 "CROSSING_LEFT2RIGH" 5 "CROSSING_RIGHT2LEF" 6 "RESERVE" 7 "RESERVED" ;
VAL_ 1370 ARC_OD_MaintenanceState_Obj_0042 0 "INVALID" 1 "NEW" 2 "MEASURED" 3 "PREDICTED" ;
VAL_ 1369 ARC_OD_Classification_Obj_16_FR 0 "Unknow" 1 "Person" 2 "Bimo" 3 "Car" 4 "Truck" 5 "Barrier" 6 "Reserved" 7 "Reserved" ;
VAL_ 1369 ARC_OD_DynProp_Obj_16_FR 0 "MOVING" 1 "STATIONARY" 2 "ONCOMING" 3 "CROSSING_LEFT2RIGHT" 4 "CROSSING_RIGHT2LEFT" 5 "UNKNOWN" 6 "STOPPED" 7 "RESERVED" ;
VAL_ 1369 ARC_OD_MaintenanceState_Obj_0043 0 "INVALID" 1 "NEW" 2 "MEASURED" 3 "PREDICTED" ;
VAL_ 1369 ARC_OD_Classification_Obj_17_FR 0 "Unknow" 1 "Person" 2 "Bimo" 3 "Car" 4 "Truck" 5 "Barrier" 6 "Reserved" 7 "Reserved" ;
VAL_ 1369 ARC_OD_DynProp_Obj_17_FR 0 "STATIONAR" 1 "MOVIN" 2 "ONCOMING" 3 "STOPPE" 4 "CROSSING_LEFT2RIGH" 5 "CROSSING_RIGHT2LEF" 6 "RESERVE" 7 "RESERVED" ;
VAL_ 1369 ARC_OD_MaintenanceState_Obj_0044 0 "INVALID" 1 "NEW" 2 "MEASURED" 3 "PREDICTED" ;
VAL_ 1368 ARC_OD_Classification_Obj_14_FR 0 "Unknow" 1 "Person" 2 "Bimo" 3 "Car" 4 "Truck" 5 "Barrier" 6 "Reserved" 7 "Reserved" ;
VAL_ 1368 ARC_OD_DynProp_Obj_14_FR 0 "MOVING" 1 "STATIONARY" 2 "ONCOMING" 3 "CROSSING_LEFT2RIGHT" 4 "CROSSING_RIGHT2LEFT" 5 "UNKNOWN" 6 "STOPPED" 7 "RESERVED" ;
VAL_ 1368 ARC_OD_MaintenanceState_Obj_0045 0 "INVALID" 1 "NEW" 2 "MEASURED" 3 "PREDICTED" ;
VAL_ 1368 ARC_OD_Classification_Obj_15_FR 0 "Unknow" 1 "Person" 2 "Bimo" 3 "Car" 4 "Truck" 5 "Barrier" 6 "Reserved" 7 "Reserved" ;
VAL_ 1368 ARC_OD_DynProp_Obj_15_FR 0 "STATIONAR" 1 "MOVIN" 2 "ONCOMING" 3 "STOPPE" 4 "CROSSING_LEFT2RIGH" 5 "CROSSING_RIGHT2LEF" 6 "RESERVE" 7 "RESERVED" ;
VAL_ 1368 ARC_OD_MaintenanceState_Obj_0046 0 "INVALID" 1 "NEW" 2 "MEASURED" 3 "PREDICTED" ;
VAL_ 1367 ARC_OD_Classification_Obj_12_FR 0 "Unknow" 1 "Person" 2 "Bimo" 3 "Car" 4 "Truck" 5 "Barrier" 6 "Reserved" 7 "Reserved" ;
VAL_ 1367 ARC_OD_DynProp_Obj_12_FR 0 "MOVING" 1 "STATIONARY" 2 "ONCOMING" 3 "CROSSING_LEFT2RIGHT" 4 "CROSSING_RIGHT2LEFT" 5 "UNKNOWN" 6 "STOPPED" 7 "RESERVED" ;
VAL_ 1367 ARC_OD_MaintenanceState_Obj_0047 0 "INVALID" 1 "NEW" 2 "MEASURED" 3 "PREDICTED" ;
VAL_ 1367 ARC_OD_Classification_Obj_13_FR 0 "Unknow" 1 "Person" 2 "Bimo" 3 "Car" 4 "Truck" 5 "Barrier" 6 "Reserved" 7 "Reserved" ;
VAL_ 1367 ARC_OD_DynProp_Obj_13_FR 0 "STATIONAR" 1 "MOVIN" 2 "ONCOMING" 3 "STOPPE" 4 "CROSSING_LEFT2RIGH" 5 "CROSSING_RIGHT2LEF" 6 "RESERVE" 7 "RESERVED" ;
VAL_ 1367 ARC_OD_MaintenanceState_Obj_0048 0 "INVALID" 1 "NEW" 2 "MEASURED" 3 "PREDICTED" ;
VAL_ 1366 ARC_OD_Classification_Obj_10_FR 0 "Unknow" 1 "Person" 2 "Bimo" 3 "Car" 4 "Truck" 5 "Barrier" 6 "Reserved" 7 "Reserved" ;
VAL_ 1366 ARC_OD_DynProp_Obj_10_FR 0 "MOVING" 1 "STATIONARY" 2 "ONCOMING" 3 "CROSSING_LEFT2RIGHT" 4 "CROSSING_RIGHT2LEFT" 5 "UNKNOWN" 6 "STOPPED" 7 "RESERVED" ;
VAL_ 1366 ARC_OD_MaintenanceState_Obj_0049 0 "INVALID" 1 "NEW" 2 "MEASURED" 3 "PREDICTED" ;
VAL_ 1366 ARC_OD_Classification_Obj_11_FR 0 "Unknow" 1 "Person" 2 "Bimo" 3 "Car" 4 "Truck" 5 "Barrier" 6 "Reserved" 7 "Reserved" ;
VAL_ 1366 ARC_OD_DynProp_Obj_11_FR 0 "STATIONAR" 1 "MOVIN" 2 "ONCOMING" 3 "STOPPE" 4 "CROSSING_LEFT2RIGH" 5 "CROSSING_RIGHT2LEF" 6 "RESERVE" 7 "RESERVED" ;
VAL_ 1366 ARC_OD_MaintenanceState_Obj_0050 0 "INVALID" 1 "NEW" 2 "MEASURED" 3 "PREDICTED" ;
VAL_ 1365 ARC_OD_Classification_Obj_08_FR 0 "Unknow" 1 "Person" 2 "Bimo" 3 "Car" 4 "Truck" 5 "Barrier" 6 "Reserved" 7 "Reserved" ;
VAL_ 1365 ARC_OD_DynProp_Obj_08_FR 0 "MOVING" 1 "STATIONARY" 2 "ONCOMING" 3 "CROSSING_LEFT2RIGHT" 4 "CROSSING_RIGHT2LEFT" 5 "UNKNOWN" 6 "STOPPED" 7 "RESERVED" ;
VAL_ 1365 ARC_OD_MaintenanceState_Obj_0051 0 "INVALID" 1 "NEW" 2 "MEASURED" 3 "PREDICTED" ;
VAL_ 1365 ARC_OD_Classification_Obj_09_FR 0 "Unknow" 1 "Person" 2 "Bimo" 3 "Car" 4 "Truck" 5 "Barrier" 6 "Reserved" 7 "Reserved" ;
VAL_ 1365 ARC_OD_DynProp_Obj_09_FR 0 "STATIONAR" 1 "MOVIN" 2 "ONCOMING" 3 "STOPPE" 4 "CROSSING_LEFT2RIGH" 5 "CROSSING_RIGHT2LEF" 6 "RESERVE" 7 "RESERVED" ;
VAL_ 1365 ARC_OD_MaintenanceState_Obj_0052 0 "INVALID" 1 "NEW" 2 "MEASURED" 3 "PREDICTED" ;
VAL_ 1364 ARC_OD_Classification_Obj_06_FR 0 "Unknow" 1 "Person" 2 "Bimo" 3 "Car" 4 "Truck" 5 "Barrier" 6 "Reserved" 7 "Reserved" ;
VAL_ 1364 ARC_OD_DynProp_Obj_06_FR 0 "MOVING" 1 "STATIONARY" 2 "ONCOMING" 3 "CROSSING_LEFT2RIGHT" 4 "CROSSING_RIGHT2LEFT" 5 "UNKNOWN" 6 "STOPPED" 7 "RESERVED" ;
VAL_ 1364 ARC_OD_MaintenanceState_Obj_0053 0 "INVALID" 1 "NEW" 2 "MEASURED" 3 "PREDICTED" ;
VAL_ 1364 ARC_OD_Classification_Obj_07_FR 0 "Unknow" 1 "Person" 2 "Bimo" 3 "Car" 4 "Truck" 5 "Barrier" 6 "Reserved" 7 "Reserved" ;
VAL_ 1364 ARC_OD_DynProp_Obj_07_FR 0 "STATIONAR" 1 "MOVIN" 2 "ONCOMING" 3 "STOPPE" 4 "CROSSING_LEFT2RIGH" 5 "CROSSING_RIGHT2LEF" 6 "RESERVE" 7 "RESERVED" ;
VAL_ 1364 ARC_OD_MaintenanceState_Obj_0054 0 "INVALID" 1 "NEW" 2 "MEASURED" 3 "PREDICTED" ;
VAL_ 1363 ARC_OD_Classification_Obj_04_FR 0 "Unknow" 1 "Person" 2 "Bimo" 3 "Car" 4 "Truck" 5 "Barrier" 6 "Reserved" 7 "Reserved" ;
VAL_ 1363 ARC_OD_DynProp_Obj_04_FR 0 "MOVING" 1 "STATIONARY" 2 "ONCOMING" 3 "CROSSING_LEFT2RIGHT" 4 "CROSSING_RIGHT2LEFT" 5 "UNKNOWN" 6 "STOPPED" 7 "RESERVED" ;
VAL_ 1363 ARC_OD_MaintenanceState_Obj_0055 0 "INVALID" 1 "NEW" 2 "MEASURED" 3 "PREDICTED" ;
VAL_ 1363 ARC_OD_Classification_Obj_05_FR 0 "Unknow" 1 "Person" 2 "Bimo" 3 "Car" 4 "Truck" 5 "Barrier" 6 "Reserved" 7 "Reserved" ;
VAL_ 1363 ARC_OD_DynProp_Obj_05_FR 0 "STATIONAR" 1 "MOVIN" 2 "ONCOMING" 3 "STOPPE" 4 "CROSSING_LEFT2RIGH" 5 "CROSSING_RIGHT2LEF" 6 "RESERVE" 7 "RESERVED" ;
VAL_ 1363 ARC_OD_MaintenanceState_Obj_0056 0 "INVALID" 1 "NEW" 2 "MEASURED" 3 "PREDICTED" ;
VAL_ 1362 ARC_OD_Classification_Obj_02_FR 0 "Unknow" 1 "Person" 2 "Bimo" 3 "Car" 4 "Truck" 5 "Barrier" 6 "Reserved" 7 "Reserved" ;
VAL_ 1362 ARC_OD_DynProp_Obj_02_FR 0 "MOVING" 1 "STATIONARY" 2 "ONCOMING" 3 "CROSSING_LEFT2RIGHT" 4 "CROSSING_RIGHT2LEFT" 5 "UNKNOWN" 6 "STOPPED" 7 "RESERVED" ;
VAL_ 1362 ARC_OD_MaintenanceState_Obj_0057 0 "INVALID" 1 "NEW" 2 "MEASURED" 3 "PREDICTED" ;
VAL_ 1362 ARC_OD_Classification_Obj_03_FR 0 "Unknow" 1 "Person" 2 "Bimo" 3 "Car" 4 "Truck" 5 "Barrier" 6 "Reserved" 7 "Reserved" ;
VAL_ 1362 ARC_OD_DynProp_Obj_03_FR 0 "STATIONAR" 1 "MOVIN" 2 "ONCOMING" 3 "STOPPE" 4 "CROSSING_LEFT2RIGH" 5 "CROSSING_RIGHT2LEF" 6 "RESERVE" 7 "RESERVED" ;
VAL_ 1362 ARC_OD_MaintenanceState_Obj_0058 0 "INVALID" 1 "NEW" 2 "MEASURED" 3 "PREDICTED" ;
VAL_ 1361 ARC_OD_Classification_Obj_00_FR 0 "Unknow" 1 "Person" 2 "Bimo" 3 "Car" 4 "Truck" 5 "Barrier" 6 "Reserved" 7 "Reserved" ;
VAL_ 1361 ARC_OD_DynProp_Obj_00_FR 0 "MOVING" 1 "STATIONARY" 2 "ONCOMING" 3 "CROSSING_LEFT2RIGHT" 4 "CROSSING_RIGHT2LEFT" 5 "UNKNOWN" 6 "STOPPED" 7 "RESERVED" ;
VAL_ 1361 ARC_OD_MaintenanceState_Obj_0059 0 "INVALID" 1 "NEW" 2 "MEASURED" 3 "PREDICTED" ;
VAL_ 1361 ARC_OD_Classification_Obj_01_FR 0 "Unknow" 1 "Person" 2 "Bimo" 3 "Car" 4 "Truck" 5 "Barrier" 6 "Reserved" 7 "Reserved" ;
VAL_ 1361 ARC_OD_DynProp_Obj_01_FR 0 "STATIONAR" 1 "MOVIN" 2 "ONCOMING" 3 "STOPPE" 4 "CROSSING_LEFT2RIGH" 5 "CROSSING_RIGHT2LEF" 6 "RESERVE" 7 "RESERVED" ;
VAL_ 1361 ARC_OD_MaintenanceState_Obj_0060 0 "INVALID" 1 "NEW" 2 "MEASURED" 3 "PREDICTED" ;
VAL_ 1134 ARC_OD_Classification_Obj_58_RR 0 "POINT" 1 "CAR" 2 "TRUCK" 3 "PEDESTRIAN" 4 "MOTORCYCLE" 5 "BICYCLE" 6 "WIDE" 7 "UNCLASSIFIED" ;
VAL_ 1134 ARC_OD_DynProp_Obj_58_RR 0 "MOVING" 1 "STATIONARY" 2 "ONCOMING" 3 "CROSSING_LEFT2RIGHT" 4 "CROSSING_RIGHT2LEFT" 5 "UNKNOWN" 6 "STOPPED" 7 "RESERVED" ;
VAL_ 1134 ARC_OD_MaintenanceState_Obj_58_R 0 "INVALID" 1 "NEW" 2 "MEASURED" 3 "PREDICTED" ;
VAL_ 1134 ARC_OD_Classification_Obj_59_RR 0 "POINT" 1 "CAR" 2 "TRUCK" 3 "PEDESTRIAN" 4 "MOTORCYCLE" 5 "BICYCLE" 6 "WIDE" 7 "UNCLASSIFIED" ;
VAL_ 1134 ARC_OD_DynProp_Obj_59_RR 0 "STATIONAR" 1 "MOVIN" 2 "ONCOMING" 3 "STOPPE" 4 "CROSSING_LEFT2RIGH" 5 "CROSSING_RIGHT2LEF" 6 "RESERVE" 7 "RESERVED" ;
VAL_ 1134 ARC_OD_MaintenanceState_Obj_59_R 0 "INVALID" 1 "NEW" 2 "MEASURED" 3 "PREDICTED" ;
SIG_GROUP_ 1380 Signal_Group_ARC_OD_38_39 1 : DistHeight_Obj_39_FR DistHeight_Obj_38_FR ARC_OD_DistX_Obj_38_FR ARC_OD_Classification_Obj_38_FR ARC_OD_AabsYStd_Obj_38_FR ARC_OD_ClassConf_Obj_38_FR ARC_OD_ProbOfExist_Obj_38_FR ARC_OD_VabsX_Obj_38_FR ARC_OD_DynProp_Obj_38_FR ARC_OD_Length_Obj_38_FR ARC_OD_MaintenanceState_Obj_0021 ARC_OD_Width_Obj_38_FR ARC_OD_RCS_Obj_38_FR ARC_OD_Orientation_Obj_38_FR ARC_OD_LifeCycle_Obj_38_FR ARC_OD_DistX_Obj_39_FR ARC_OD_VabsX_Obj_39_FR ARC_OD_AabsX_Obj_39_FR ARC_OD_AabsX_Obj_38_FR ARC_OD_DistY_Obj_39_FR ARC_OD_VabsY_Obj_39_FR ARC_OD_AabsY_Obj_39_FR ARC_OD_DistXStd_Obj_39_FR ARC_OD_DistYStd_Obj_39_FR ARC_OD_VabsXStd_Obj_39_FR ARC_OD_VabsYStd_Obj_39_FR ARC_OD_AabsXStd_Obj_39_FR ARC_OD_Classification_Obj_39_FR ARC_OD_AabsYStd_Obj_39_FR ARC_OD_ClassConf_Obj_39_FR ARC_OD_DistY_Obj_38_FR ARC_OD_ProbOfExist_Obj_39_FR ARC_OD_DynProp_Obj_39_FR ARC_OD_Length_Obj_39_FR ARC_OD_MaintenanceState_Obj_0022 ARC_OD_Width_Obj_39_FR ARC_OD_RCS_Obj_39_FR ARC_OD_Orientation_Obj_39_FR ARC_OD_LifeCycle_Obj_39_FR ARC_OD_ObstacleProb_Obj_38_FR ARC_OD_ObstacleProb_Obj_39_FR ARC_OD_VabsY_Obj_38_FR ARC_OD_ID_38_FR ARC_OD_ID_39_FR ARC_OD_MsgCounter_Obj_38_39_FR ARC_OD_CRC8_Obj_38_39_FR ARC_OD_AabsY_Obj_38_FR ARC_OD_DistXStd_Obj_38_FR ARC_OD_DistYStd_Obj_38_FR ARC_OD_VabsXStd_Obj_38_FR ARC_OD_VabsYStd_Obj_38_FR ARC_OD_AabsXStd_Obj_38_FR;
SIG_GROUP_ 1379 Signal_Group_ARC_OD_36_37 1 : DistHeight_Obj_37_FR DistHeight_Obj_36_FR ARC_OD_DistX_Obj_36_FR ARC_OD_Classification_Obj_36_FR ARC_OD_AabsYStd_Obj_36_FR ARC_OD_ClassConf_Obj_36_FR ARC_OD_ProbOfExist_Obj_36_FR ARC_OD_VabsX_Obj_36_FR ARC_OD_DynProp_Obj_36_FR ARC_OD_Length_Obj_36_FR ARC_OD_MaintenanceState_Obj_0023 ARC_OD_Width_Obj_36_FR ARC_OD_RCS_Obj_36_FR ARC_OD_Orientation_Obj_36_FR ARC_OD_LifeCycle_Obj_36_FR ARC_OD_DistX_Obj_37_FR ARC_OD_VabsX_Obj_37_FR ARC_OD_AabsX_Obj_37_FR ARC_OD_AabsX_Obj_36_FR ARC_OD_DistY_Obj_37_FR ARC_OD_VabsY_Obj_37_FR ARC_OD_AabsY_Obj_37_FR ARC_OD_DistXStd_Obj_37_FR ARC_OD_DistYStd_Obj_37_FR ARC_OD_VabsXStd_Obj_37_FR ARC_OD_VabsYStd_Obj_37_FR ARC_OD_AabsXStd_Obj_37_FR ARC_OD_Classification_Obj_37_FR ARC_OD_AabsYStd_Obj_37_FR ARC_OD_ClassConf_Obj_37_FR ARC_OD_DistY_Obj_36_FR ARC_OD_ProbOfExist_Obj_37_FR ARC_OD_DynProp_Obj_37_FR ARC_OD_Length_Obj_37_FR ARC_OD_MaintenanceState_Obj_0024 ARC_OD_Width_Obj_37_FR ARC_OD_RCS_Obj_37_FR ARC_OD_Orientation_Obj_37_FR ARC_OD_LifeCycle_Obj_37_FR ARC_OD_ObstacleProb_Obj_36_FR ARC_OD_ObstacleProb_Obj_37_FR ARC_OD_VabsY_Obj_36_FR ARC_OD_ID_36_FR ARC_OD_ID_37_FR ARC_OD_MsgCounter_Obj_36_37_FR ARC_OD_CRC8_Obj_36_37_FR ARC_OD_AabsY_Obj_36_FR ARC_OD_DistXStd_Obj_36_FR ARC_OD_DistYStd_Obj_36_FR ARC_OD_VabsXStd_Obj_36_FR ARC_OD_VabsYStd_Obj_36_FR ARC_OD_AabsXStd_Obj_36_FR;
SIG_GROUP_ 1378 Signal_Group_ARC_OD_34_35 1 : DistHeight_Obj_35_FR DistHeight_Obj_34_FR ARC_OD_DistX_Obj_34_FR ARC_OD_Classification_Obj_34_FR ARC_OD_AabsYStd_Obj_34_FR ARC_OD_ClassConf_Obj_34_FR ARC_OD_ProbOfExist_Obj_34_FR ARC_OD_VabsX_Obj_34_FR ARC_OD_DynProp_Obj_34_FR ARC_OD_Length_Obj_34_FR ARC_OD_MaintenanceState_Obj_0025 ARC_OD_Width_Obj_34_FR ARC_OD_RCS_Obj_34_FR ARC_OD_Orientation_Obj_34_FR ARC_OD_LifeCycle_Obj_34_FR ARC_OD_DistX_Obj_35_FR ARC_OD_VabsX_Obj_35_FR ARC_OD_AabsX_Obj_35_FR ARC_OD_AabsX_Obj_34_FR ARC_OD_DistY_Obj_35_FR ARC_OD_VabsY_Obj_35_FR ARC_OD_AabsY_Obj_35_FR ARC_OD_DistXStd_Obj_35_FR ARC_OD_DistYStd_Obj_35_FR ARC_OD_VabsXStd_Obj_35_FR ARC_OD_VabsYStd_Obj_35_FR ARC_OD_AabsXStd_Obj_35_FR ARC_OD_Classification_Obj_35_FR ARC_OD_AabsYStd_Obj_35_FR ARC_OD_ClassConf_Obj_35_FR ARC_OD_DistY_Obj_34_FR ARC_OD_ProbOfExist_Obj_35_FR ARC_OD_DynProp_Obj_35_FR ARC_OD_Length_Obj_35_FR ARC_OD_MaintenanceState_Obj_0026 ARC_OD_Width_Obj_35_FR ARC_OD_RCS_Obj_35_FR ARC_OD_Orientation_Obj_35_FR ARC_OD_LifeCycle_Obj_35_FR ARC_OD_ObstacleProb_Obj_34_FR ARC_OD_ObstacleProb_Obj_35_FR ARC_OD_VabsY_Obj_34_FR ARC_OD_ID_34_FR ARC_OD_ID_35_FR ARC_OD_MsgCounter_Obj_34_35_FR ARC_OD_CRC8_Obj_34_35_FR ARC_OD_AabsY_Obj_34_FR ARC_OD_DistXStd_Obj_34_FR ARC_OD_DistYStd_Obj_34_FR ARC_OD_VabsXStd_Obj_34_FR ARC_OD_VabsYStd_Obj_34_FR ARC_OD_AabsXStd_Obj_34_FR;
SIG_GROUP_ 1377 Signal_Group_ARC_OD_32_33 1 : DistHeight_Obj_33_FR DistHeight_Obj_32_FR ARC_OD_DistX_Obj_32_FR ARC_OD_Classification_Obj_32_FR ARC_OD_AabsYStd_Obj_32_FR ARC_OD_ClassConf_Obj_32_FR ARC_OD_ProbOfExist_Obj_32_FR ARC_OD_VabsX_Obj_32_FR ARC_OD_DynProp_Obj_32_FR ARC_OD_Length_Obj_32_FR ARC_OD_MaintenanceState_Obj_0027 ARC_OD_Width_Obj_32_FR ARC_OD_RCS_Obj_32_FR ARC_OD_Orientation_Obj_32_FR ARC_OD_LifeCycle_Obj_32_FR ARC_OD_DistX_Obj_33_FR ARC_OD_VabsX_Obj_33_FR ARC_OD_AabsX_Obj_33_FR ARC_OD_AabsX_Obj_32_FR ARC_OD_DistY_Obj_33_FR ARC_OD_VabsY_Obj_33_FR ARC_OD_AabsY_Obj_33_FR ARC_OD_DistXStd_Obj_33_FR ARC_OD_DistYStd_Obj_33_FR ARC_OD_VabsXStd_Obj_33_FR ARC_OD_VabsYStd_Obj_33_FR ARC_OD_AabsXStd_Obj_33_FR ARC_OD_Classification_Obj_33_FR ARC_OD_AabsYStd_Obj_33_FR ARC_OD_ClassConf_Obj_33_FR ARC_OD_DistY_Obj_32_FR ARC_OD_ProbOfExist_Obj_33_FR ARC_OD_DynProp_Obj_33_FR ARC_OD_Length_Obj_33_FR ARC_OD_MaintenanceState_Obj_0028 ARC_OD_Width_Obj_33_FR ARC_OD_RCS_Obj_33_FR ARC_OD_Orientation_Obj_33_FR ARC_OD_LifeCycle_Obj_33_FR ARC_OD_ObstacleProb_Obj_32_FR ARC_OD_ObstacleProb_Obj_33_FR ARC_OD_VabsY_Obj_32_FR ARC_OD_ID_32_FR ARC_OD_ID_33_FR ARC_OD_MsgCounter_Obj_32_33_FR ARC_OD_CRC8_Obj_32_33_FR ARC_OD_AabsY_Obj_32_FR ARC_OD_DistXStd_Obj_32_FR ARC_OD_DistYStd_Obj_32_FR ARC_OD_VabsXStd_Obj_32_FR ARC_OD_VabsYStd_Obj_32_FR ARC_OD_AabsXStd_Obj_32_FR;
SIG_GROUP_ 1376 Signal_Group_ARC_OD_30_31 1 : DistHeight_Obj_31_FR DistHeight_Obj_30_FR ARC_OD_DistX_Obj_30_FR ARC_OD_Classification_Obj_30_FR ARC_OD_AabsYStd_Obj_30_FR ARC_OD_ClassConf_Obj_30_FR ARC_OD_ProbOfExist_Obj_30_FR ARC_OD_VabsX_Obj_30_FR ARC_OD_DynProp_Obj_30_FR ARC_OD_Length_Obj_30_FR ARC_OD_MaintenanceState_Obj_0029 ARC_OD_Width_Obj_30_FR ARC_OD_RCS_Obj_30_FR ARC_OD_Orientation_Obj_30_FR ARC_OD_LifeCycle_Obj_30_FR ARC_OD_DistX_Obj_31_FR ARC_OD_VabsX_Obj_31_FR ARC_OD_AabsX_Obj_31_FR ARC_OD_AabsX_Obj_30_FR ARC_OD_DistY_Obj_31_FR ARC_OD_VabsY_Obj_31_FR ARC_OD_AabsY_Obj_31_FR ARC_OD_DistXStd_Obj_31_FR ARC_OD_DistYStd_Obj_31_FR ARC_OD_VabsXStd_Obj_31_FR ARC_OD_VabsYStd_Obj_31_FR ARC_OD_AabsXStd_Obj_31_FR ARC_OD_Classification_Obj_31_FR ARC_OD_AabsYStd_Obj_31_FR ARC_OD_ClassConf_Obj_31_FR ARC_OD_DistY_Obj_30_FR ARC_OD_ProbOfExist_Obj_31_FR ARC_OD_DynProp_Obj_31_FR ARC_OD_Length_Obj_31_FR ARC_OD_MaintenanceState_Obj_0030 ARC_OD_Width_Obj_31_FR ARC_OD_RCS_Obj_31_FR ARC_OD_Orientation_Obj_31_FR ARC_OD_LifeCycle_Obj_31_FR ARC_OD_ObstacleProb_Obj_30_FR ARC_OD_ObstacleProb_Obj_31_FR ARC_OD_VabsY_Obj_30_FR ARC_OD_ID_30_FR ARC_OD_ID_31_FR ARC_OD_MsgCounter_Obj_30_31_FR ARC_OD_CRC8_Obj_30_31_FR ARC_OD_AabsY_Obj_30_FR ARC_OD_DistXStd_Obj_30_FR ARC_OD_DistYStd_Obj_30_FR ARC_OD_VabsXStd_Obj_30_FR ARC_OD_VabsYStd_Obj_30_FR ARC_OD_AabsXStd_Obj_30_FR;
SIG_GROUP_ 1375 Signal_Group_ARC_OD_28_29 1 : DistHeight_Obj_29_FR DistHeight_Obj_28_FR ARC_OD_DistX_Obj_28_FR ARC_OD_Classification_Obj_28_FR ARC_OD_AabsYStd_Obj_28_FR ARC_OD_ClassConf_Obj_28_FR ARC_OD_ProbOfExist_Obj_28_FR ARC_OD_VabsX_Obj_28_FR ARC_OD_DynProp_Obj_28_FR ARC_OD_Length_Obj_28_FR ARC_OD_MaintenanceState_Obj_0031 ARC_OD_Width_Obj_28_FR ARC_OD_RCS_Obj_28_FR ARC_OD_Orientation_Obj_28_FR ARC_OD_LifeCycle_Obj_28_FR ARC_OD_DistX_Obj_29_FR ARC_OD_VabsX_Obj_29_FR ARC_OD_AabsX_Obj_29_FR ARC_OD_AabsX_Obj_28_FR ARC_OD_DistY_Obj_29_FR ARC_OD_VabsY_Obj_29_FR ARC_OD_AabsY_Obj_29_FR ARC_OD_DistXStd_Obj_29_FR ARC_OD_DistYStd_Obj_29_FR ARC_OD_VabsXStd_Obj_29_FR ARC_OD_VabsYStd_Obj_29_FR ARC_OD_AabsXStd_Obj_29_FR ARC_OD_Classification_Obj_29_FR ARC_OD_AabsYStd_Obj_29_FR ARC_OD_ClassConf_Obj_29_FR ARC_OD_DistY_Obj_28_FR ARC_OD_ProbOfExist_Obj_29_FR ARC_OD_DynProp_Obj_29_FR ARC_OD_Length_Obj_29_FR ARC_OD_MaintenanceState_Obj_0032 ARC_OD_Width_Obj_29_FR ARC_OD_RCS_Obj_29_FR ARC_OD_Orientation_Obj_29_FR ARC_OD_LifeCycle_Obj_29_FR ARC_OD_ObstacleProb_Obj_28_FR ARC_OD_ObstacleProb_Obj_29_FR ARC_OD_VabsY_Obj_28_FR ARC_OD_ID_28_FR ARC_OD_ID_29_FR ARC_OD_MsgCounter_Obj_28_29_FR ARC_OD_CRC8_Obj_28_29_FR ARC_OD_AabsY_Obj_28_FR ARC_OD_DistXStd_Obj_28_FR ARC_OD_DistYStd_Obj_28_FR ARC_OD_VabsXStd_Obj_28_FR ARC_OD_VabsYStd_Obj_28_FR ARC_OD_AabsXStd_Obj_28_FR;
SIG_GROUP_ 1374 Signal_Group_ARC_OD_26_27 1 : DistHeight_Obj_27_FR DistHeight_Obj_26_FR ARC_OD_DistX_Obj_26_FR ARC_OD_Classification_Obj_26_FR ARC_OD_AabsYStd_Obj_26_FR ARC_OD_ClassConf_Obj_26_FR ARC_OD_ProbOfExist_Obj_26_FR ARC_OD_VabsX_Obj_26_FR ARC_OD_DynProp_Obj_26_FR ARC_OD_Length_Obj_26_FR ARC_OD_MaintenanceState_Obj_0033 ARC_OD_Width_Obj_26_FR ARC_OD_RCS_Obj_26_FR ARC_OD_Orientation_Obj_26_FR ARC_OD_LifeCycle_Obj_26_FR ARC_OD_DistX_Obj_27_FR ARC_OD_VabsX_Obj_27_FR ARC_OD_AabsX_Obj_27_FR ARC_OD_AabsX_Obj_26_FR ARC_OD_DistY_Obj_27_FR ARC_OD_VabsY_Obj_27_FR ARC_OD_AabsY_Obj_27_FR ARC_OD_DistXStd_Obj_27_FR ARC_OD_DistYStd_Obj_27_FR ARC_OD_VabsXStd_Obj_27_FR ARC_OD_VabsYStd_Obj_27_FR ARC_OD_AabsXStd_Obj_27_FR ARC_OD_Classification_Obj_27_FR ARC_OD_AabsYStd_Obj_27_FR ARC_OD_ClassConf_Obj_27_FR ARC_OD_DistY_Obj_26_FR ARC_OD_ProbOfExist_Obj_27_FR ARC_OD_DynProp_Obj_27_FR ARC_OD_Length_Obj_27_FR ARC_OD_MaintenanceState_Obj_0034 ARC_OD_Width_Obj_27_FR ARC_OD_RCS_Obj_27_FR ARC_OD_Orientation_Obj_27_FR ARC_OD_LifeCycle_Obj_27_FR ARC_OD_ObstacleProb_Obj_26_FR ARC_OD_ObstacleProb_Obj_27_FR ARC_OD_VabsY_Obj_26_FR ARC_OD_ID_26_FR ARC_OD_ID_27_FR ARC_OD_MsgCounter_Obj_26_27_FR ARC_OD_CRC8_Obj_26_27_FR ARC_OD_AabsY_Obj_26_FR ARC_OD_DistXStd_Obj_26_FR ARC_OD_DistYStd_Obj_26_FR ARC_OD_VabsXStd_Obj_26_FR ARC_OD_VabsYStd_Obj_26_FR ARC_OD_AabsXStd_Obj_26_FR;
SIG_GROUP_ 1373 Signal_Group_ARC_OD_24_25 1 : DistHeight_Obj_25_FR DistHeight_Obj_24_FR ARC_OD_DistX_Obj_24_FR ARC_OD_Classification_Obj_24_FR ARC_OD_AabsYStd_Obj_24_FR ARC_OD_ClassConf_Obj_24_FR ARC_OD_ProbOfExist_Obj_24_FR ARC_OD_VabsX_Obj_24_FR ARC_OD_DynProp_Obj_24_FR ARC_OD_Length_Obj_24_FR ARC_OD_MaintenanceState_Obj_0035 ARC_OD_Width_Obj_24_FR ARC_OD_RCS_Obj_24_FR ARC_OD_Orientation_Obj_24_FR ARC_OD_LifeCycle_Obj_24_FR ARC_OD_DistX_Obj_25_FR ARC_OD_VabsX_Obj_25_FR ARC_OD_AabsX_Obj_25_FR ARC_OD_AabsX_Obj_24_FR ARC_OD_DistY_Obj_25_FR ARC_OD_VabsY_Obj_25_FR ARC_OD_AabsY_Obj_25_FR ARC_OD_DistXStd_Obj_25_FR ARC_OD_DistYStd_Obj_25_FR ARC_OD_VabsXStd_Obj_25_FR ARC_OD_VabsYStd_Obj_25_FR ARC_OD_AabsXStd_Obj_25_FR ARC_OD_Classification_Obj_25_FR ARC_OD_AabsYStd_Obj_25_FR ARC_OD_ClassConf_Obj_25_FR ARC_OD_DistY_Obj_24_FR ARC_OD_ProbOfExist_Obj_25_FR ARC_OD_DynProp_Obj_25_FR ARC_OD_Length_Obj_25_FR ARC_OD_MaintenanceState_Obj_0036 ARC_OD_Width_Obj_25_FR ARC_OD_RCS_Obj_25_FR ARC_OD_Orientation_Obj_25_FR ARC_OD_LifeCycle_Obj_25_FR ARC_OD_ObstacleProb_Obj_24_FR ARC_OD_ObstacleProb_Obj_25_FR ARC_OD_VabsY_Obj_24_FR ARC_OD_ID_24_FR ARC_OD_ID_25_FR ARC_OD_MsgCounter_Obj_24_25_FR ARC_OD_CRC8_Obj_24_25_FR ARC_OD_AabsY_Obj_24_FR ARC_OD_DistXStd_Obj_24_FR ARC_OD_DistYStd_Obj_24_FR ARC_OD_VabsXStd_Obj_24_FR ARC_OD_VabsYStd_Obj_24_FR ARC_OD_AabsXStd_Obj_24_FR;
SIG_GROUP_ 1372 Signal_Group_ARC_OD_22_23 1 : DistHeight_Obj_23_FR DistHeight_Obj_22_FR ARC_OD_DistX_Obj_22_FR ARC_OD_Classification_Obj_22_FR ARC_OD_AabsYStd_Obj_22_FR ARC_OD_ClassConf_Obj_22_FR ARC_OD_ProbOfExist_Obj_22_FR ARC_OD_VabsX_Obj_22_FR ARC_OD_DynProp_Obj_22_FR ARC_OD_Length_Obj_22_FR ARC_OD_MaintenanceState_Obj_0037 ARC_OD_Width_Obj_22_FR ARC_OD_RCS_Obj_22_FR ARC_OD_Orientation_Obj_22_FR ARC_OD_LifeCycle_Obj_22_FR ARC_OD_DistX_Obj_23_FR ARC_OD_VabsX_Obj_23_FR ARC_OD_AabsX_Obj_23_FR ARC_OD_AabsX_Obj_22_FR ARC_OD_DistY_Obj_23_FR ARC_OD_VabsY_Obj_23_FR ARC_OD_AabsY_Obj_23_FR ARC_OD_DistXStd_Obj_23_FR ARC_OD_DistYStd_Obj_23_FR ARC_OD_VabsXStd_Obj_23_FR ARC_OD_VabsYStd_Obj_23_FR ARC_OD_AabsXStd_Obj_23_FR ARC_OD_Classification_Obj_23_FR ARC_OD_AabsYStd_Obj_23_FR ARC_OD_ClassConf_Obj_23_FR ARC_OD_DistY_Obj_22_FR ARC_OD_ProbOfExist_Obj_23_FR ARC_OD_DynProp_Obj_23_FR ARC_OD_Length_Obj_23_FR ARC_OD_MaintenanceState_Obj_0038 ARC_OD_Width_Obj_23_FR ARC_OD_RCS_Obj_23_FR ARC_OD_Orientation_Obj_23_FR ARC_OD_LifeCycle_Obj_23_FR ARC_OD_ObstacleProb_Obj_22_FR ARC_OD_ObstacleProb_Obj_23_FR ARC_OD_VabsY_Obj_22_FR ARC_OD_ID_22_FR ARC_OD_ID_23_FR ARC_OD_MsgCounter_Obj_22_23_FR ARC_OD_CRC8_Obj_22_23_FR ARC_OD_AabsY_Obj_22_FR ARC_OD_DistXStd_Obj_22_FR ARC_OD_DistYStd_Obj_22_FR ARC_OD_VabsXStd_Obj_22_FR ARC_OD_VabsYStd_Obj_22_FR ARC_OD_AabsXStd_Obj_22_FR;
SIG_GROUP_ 1371 Signal_Group_ARC_OD_20_21 1 : DistHeight_Obj_21_FR DistHeight_Obj_20_FR ARC_OD_DistX_Obj_20_FR ARC_OD_Classification_Obj_20_FR ARC_OD_AabsYStd_Obj_20_FR ARC_OD_ClassConf_Obj_20_FR ARC_OD_ProbOfExist_Obj_20_FR ARC_OD_VabsX_Obj_20_FR ARC_OD_DynProp_Obj_20_FR ARC_OD_Length_Obj_20_FR ARC_OD_MaintenanceState_Obj_0039 ARC_OD_Width_Obj_20_FR ARC_OD_RCS_Obj_20_FR ARC_OD_Orientation_Obj_20_FR ARC_OD_LifeCycle_Obj_20_FR ARC_OD_DistX_Obj_21_FR ARC_OD_VabsX_Obj_21_FR ARC_OD_AabsX_Obj_21_FR ARC_OD_AabsX_Obj_20_FR ARC_OD_DistY_Obj_21_FR ARC_OD_VabsY_Obj_21_FR ARC_OD_AabsY_Obj_21_FR ARC_OD_DistXStd_Obj_21_FR ARC_OD_DistYStd_Obj_21_FR ARC_OD_VabsXStd_Obj_21_FR ARC_OD_VabsYStd_Obj_21_FR ARC_OD_AabsXStd_Obj_21_FR ARC_OD_Classification_Obj_21_FR ARC_OD_AabsYStd_Obj_21_FR ARC_OD_ClassConf_Obj_21_FR ARC_OD_DistY_Obj_20_FR ARC_OD_ProbOfExist_Obj_21_FR ARC_OD_DynProp_Obj_21_FR ARC_OD_Length_Obj_21_FR ARC_OD_MaintenanceState_Obj_0040 ARC_OD_Width_Obj_21_FR ARC_OD_RCS_Obj_21_FR ARC_OD_Orientation_Obj_21_FR ARC_OD_LifeCycle_Obj_21_FR ARC_OD_ObstacleProb_Obj_20_FR ARC_OD_ObstacleProb_Obj_21_FR ARC_OD_VabsY_Obj_20_FR ARC_OD_ID_20_FR ARC_OD_ID_21_FR ARC_OD_MsgCounter_Obj_20_21_FR ARC_OD_CRC8_Obj_20_21_FR ARC_OD_AabsY_Obj_20_FR ARC_OD_DistXStd_Obj_20_FR ARC_OD_DistYStd_Obj_20_FR ARC_OD_VabsXStd_Obj_20_FR ARC_OD_VabsYStd_Obj_20_FR ARC_OD_AabsXStd_Obj_20_FR;
SIG_GROUP_ 1370 Signal_Group_ARC_OD_18_19 1 : DistHeight_Obj_19_FR DistHeight_Obj_18_FR ARC_OD_DistX_Obj_18_FR ARC_OD_Classification_Obj_18_FR ARC_OD_AabsYStd_Obj_18_FR ARC_OD_ClassConf_Obj_18_FR ARC_OD_ProbOfExist_Obj_18_FR ARC_OD_VabsX_Obj_18_FR ARC_OD_DynProp_Obj_18_FR ARC_OD_Length_Obj_18_FR ARC_OD_MaintenanceState_Obj_0041 ARC_OD_Width_Obj_18_FR ARC_OD_RCS_Obj_18_FR ARC_OD_Orientation_Obj_18_FR ARC_OD_LifeCycle_Obj_18_FR ARC_OD_DistX_Obj_19_FR ARC_OD_VabsX_Obj_19_FR ARC_OD_AabsX_Obj_19_FR ARC_OD_AabsX_Obj_18_FR ARC_OD_DistY_Obj_19_FR ARC_OD_VabsY_Obj_19_FR ARC_OD_AabsY_Obj_19_FR ARC_OD_DistXStd_Obj_19_FR ARC_OD_DistYStd_Obj_19_FR ARC_OD_VabsXStd_Obj_19_FR ARC_OD_VabsYStd_Obj_19_FR ARC_OD_AabsXStd_Obj_19_FR ARC_OD_Classification_Obj_19_FR ARC_OD_AabsYStd_Obj_19_FR ARC_OD_ClassConf_Obj_19_FR ARC_OD_DistY_Obj_18_FR ARC_OD_ProbOfExist_Obj_19_FR ARC_OD_DynProp_Obj_19_FR ARC_OD_Length_Obj_19_FR ARC_OD_MaintenanceState_Obj_0042 ARC_OD_Width_Obj_19_FR ARC_OD_RCS_Obj_19_FR ARC_OD_Orientation_Obj_19_FR ARC_OD_LifeCycle_Obj_19_FR ARC_OD_ObstacleProb_Obj_18_FR ARC_OD_ObstacleProb_Obj_19_FR ARC_OD_VabsY_Obj_18_FR ARC_OD_ID_18_FR ARC_OD_ID_19_FR ARC_OD_MsgCounter_Obj_18_19_FR ARC_OD_CRC8_Obj_18_19_FR ARC_OD_AabsY_Obj_18_FR ARC_OD_DistXStd_Obj_18_FR ARC_OD_DistYStd_Obj_18_FR ARC_OD_VabsXStd_Obj_18_FR ARC_OD_VabsYStd_Obj_18_FR ARC_OD_AabsXStd_Obj_18_FR;
SIG_GROUP_ 1369 Signal_Group_ARC_OD_16_17 1 : DistHeight_Obj_17_FR DistHeight_Obj_16_FR ARC_OD_DistX_Obj_16_FR ARC_OD_Classification_Obj_16_FR ARC_OD_AabsYStd_Obj_16_FR ARC_OD_ClassConf_Obj_16_FR ARC_OD_ProbOfExist_Obj_16_FR ARC_OD_VabsX_Obj_16_FR ARC_OD_DynProp_Obj_16_FR ARC_OD_Length_Obj_16_FR ARC_OD_MaintenanceState_Obj_0043 ARC_OD_Width_Obj_16_FR ARC_OD_RCS_Obj_16_FR ARC_OD_Orientation_Obj_16_FR ARC_OD_LifeCycle_Obj_16_FR ARC_OD_DistX_Obj_17_FR ARC_OD_VabsX_Obj_17_FR ARC_OD_AabsX_Obj_17_FR ARC_OD_AabsX_Obj_16_FR ARC_OD_DistY_Obj_17_FR ARC_OD_VabsY_Obj_17_FR ARC_OD_AabsY_Obj_17_FR ARC_OD_DistXStd_Obj_17_FR ARC_OD_DistYStd_Obj_17_FR ARC_OD_VabsXStd_Obj_17_FR ARC_OD_VabsYStd_Obj_17_FR ARC_OD_AabsXStd_Obj_17_FR ARC_OD_Classification_Obj_17_FR ARC_OD_AabsYStd_Obj_17_FR ARC_OD_ClassConf_Obj_17_FR ARC_OD_DistY_Obj_16_FR ARC_OD_ProbOfExist_Obj_17_FR ARC_OD_DynProp_Obj_17_FR ARC_OD_Length_Obj_17_FR ARC_OD_MaintenanceState_Obj_0044 ARC_OD_Width_Obj_17_FR ARC_OD_RCS_Obj_17_FR ARC_OD_Orientation_Obj_17_FR ARC_OD_LifeCycle_Obj_17_FR ARC_OD_ObstacleProb_Obj_16_FR ARC_OD_ObstacleProb_Obj_17_FR ARC_OD_VabsY_Obj_16_FR ARC_OD_ID_16_FR ARC_OD_ID_17_FR ARC_OD_MsgCounter_Obj_16_17_FR ARC_OD_CRC8_Obj_16_17_FR ARC_OD_AabsY_Obj_16_FR ARC_OD_DistXStd_Obj_16_FR ARC_OD_DistYStd_Obj_16_FR ARC_OD_VabsXStd_Obj_16_FR ARC_OD_VabsYStd_Obj_16_FR ARC_OD_AabsXStd_Obj_16_FR;
SIG_GROUP_ 1368 Signal_Group_ARC_OD_14_15 1 : DistHeight_Obj_15_FR DistHeight_Obj_14_FR ARC_OD_DistX_Obj_14_FR ARC_OD_Classification_Obj_14_FR ARC_OD_AabsYStd_Obj_14_FR ARC_OD_ClassConf_Obj_14_FR ARC_OD_ProbOfExist_Obj_14_FR ARC_OD_VabsX_Obj_14_FR ARC_OD_DynProp_Obj_14_FR ARC_OD_Length_Obj_14_FR ARC_OD_MaintenanceState_Obj_0045 ARC_OD_Width_Obj_14_FR ARC_OD_RCS_Obj_14_FR ARC_OD_Orientation_Obj_14_FR ARC_OD_LifeCycle_Obj_14_FR ARC_OD_DistX_Obj_15_FR ARC_OD_VabsX_Obj_15_FR ARC_OD_AabsX_Obj_15_FR ARC_OD_AabsX_Obj_14_FR ARC_OD_DistY_Obj_15_FR ARC_OD_VabsY_Obj_15_FR ARC_OD_AabsY_Obj_15_FR ARC_OD_DistXStd_Obj_15_FR ARC_OD_DistYStd_Obj_15_FR ARC_OD_VabsXStd_Obj_15_FR ARC_OD_VabsYStd_Obj_15_FR ARC_OD_AabsXStd_Obj_15_FR ARC_OD_Classification_Obj_15_FR ARC_OD_AabsYStd_Obj_15_FR ARC_OD_ClassConf_Obj_15_FR ARC_OD_DistY_Obj_14_FR ARC_OD_ProbOfExist_Obj_15_FR ARC_OD_DynProp_Obj_15_FR ARC_OD_Length_Obj_15_FR ARC_OD_MaintenanceState_Obj_0046 ARC_OD_Width_Obj_15_FR ARC_OD_RCS_Obj_15_FR ARC_OD_Orientation_Obj_15_FR ARC_OD_LifeCycle_Obj_15_FR ARC_OD_ObstacleProb_Obj_14_FR ARC_OD_ObstacleProb_Obj_15_FR ARC_OD_VabsY_Obj_14_FR ARC_OD_ID_14_FR ARC_OD_ID_15_FR ARC_OD_MsgCounter_Obj_14_15_FR ARC_OD_CRC8_Obj_14_15_FR ARC_OD_AabsY_Obj_14_FR ARC_OD_DistXStd_Obj_14_FR ARC_OD_DistYStd_Obj_14_FR ARC_OD_VabsXStd_Obj_14_FR ARC_OD_VabsYStd_Obj_14_FR ARC_OD_AabsXStd_Obj_14_FR;
SIG_GROUP_ 1367 Signal_Group_ARC_OD_12_13 1 : DistHeight_Obj_13_FR DistHeight_Obj_12_FR ARC_OD_DistX_Obj_12_FR ARC_OD_Classification_Obj_12_FR ARC_OD_AabsYStd_Obj_12_FR ARC_OD_ClassConf_Obj_12_FR ARC_OD_ProbOfExist_Obj_12_FR ARC_OD_VabsX_Obj_12_FR ARC_OD_DynProp_Obj_12_FR ARC_OD_Length_Obj_12_FR ARC_OD_MaintenanceState_Obj_0047 ARC_OD_Width_Obj_12_FR ARC_OD_RCS_Obj_12_FR ARC_OD_Orientation_Obj_12_FR ARC_OD_LifeCycle_Obj_12_FR ARC_OD_DistX_Obj_13_FR ARC_OD_VabsX_Obj_13_FR ARC_OD_AabsX_Obj_13_FR ARC_OD_AabsX_Obj_12_FR ARC_OD_DistY_Obj_13_FR ARC_OD_VabsY_Obj_13_FR ARC_OD_AabsY_Obj_13_FR ARC_OD_DistXStd_Obj_13_FR ARC_OD_DistYStd_Obj_13_FR ARC_OD_VabsXStd_Obj_13_FR ARC_OD_VabsYStd_Obj_13_FR ARC_OD_AabsXStd_Obj_13_FR ARC_OD_Classification_Obj_13_FR ARC_OD_AabsYStd_Obj_13_FR ARC_OD_ClassConf_Obj_13_FR ARC_OD_DistY_Obj_12_FR ARC_OD_ProbOfExist_Obj_13_FR ARC_OD_DynProp_Obj_13_FR ARC_OD_Length_Obj_13_FR ARC_OD_MaintenanceState_Obj_0048 ARC_OD_Width_Obj_13_FR ARC_OD_RCS_Obj_13_FR ARC_OD_Orientation_Obj_13_FR ARC_OD_LifeCycle_Obj_13_FR ARC_OD_ObstacleProb_Obj_12_FR ARC_OD_ObstacleProb_Obj_13_FR ARC_OD_VabsY_Obj_12_FR ARC_OD_ID_12_FR ARC_OD_ID_13_FR ARC_OD_MsgCounter_Obj_12_13_FR ARC_OD_CRC8_Obj_12_13_FR ARC_OD_AabsY_Obj_12_FR ARC_OD_DistXStd_Obj_12_FR ARC_OD_DistYStd_Obj_12_FR ARC_OD_VabsXStd_Obj_12_FR ARC_OD_VabsYStd_Obj_12_FR ARC_OD_AabsXStd_Obj_12_FR;
SIG_GROUP_ 1366 Signal_Group_ARC_OD_10_11 1 : DistHeight_Obj_11_FR DistHeight_Obj_10_FR ARC_OD_DistX_Obj_10_FR ARC_OD_Classification_Obj_10_FR ARC_OD_AabsYStd_Obj_10_FR ARC_OD_ClassConf_Obj_10_FR ARC_OD_ProbOfExist_Obj_10_FR ARC_OD_VabsX_Obj_10_FR ARC_OD_DynProp_Obj_10_FR ARC_OD_Length_Obj_10_FR ARC_OD_MaintenanceState_Obj_0049 ARC_OD_Width_Obj_10_FR ARC_OD_RCS_Obj_10_FR ARC_OD_Orientation_Obj_10_FR ARC_OD_LifeCycle_Obj_10_FR ARC_OD_DistX_Obj_11_FR ARC_OD_VabsX_Obj_11_FR ARC_OD_AabsX_Obj_11_FR ARC_OD_AabsX_Obj_10_FR ARC_OD_DistY_Obj_11_FR ARC_OD_VabsY_Obj_11_FR ARC_OD_AabsY_Obj_11_FR ARC_OD_DistXStd_Obj_11_FR ARC_OD_DistYStd_Obj_11_FR ARC_OD_VabsXStd_Obj_11_FR ARC_OD_VabsYStd_Obj_11_FR ARC_OD_AabsXStd_Obj_11_FR ARC_OD_Classification_Obj_11_FR ARC_OD_AabsYStd_Obj_11_FR ARC_OD_ClassConf_Obj_11_FR ARC_OD_DistY_Obj_10_FR ARC_OD_ProbOfExist_Obj_11_FR ARC_OD_DynProp_Obj_11_FR ARC_OD_Length_Obj_11_FR ARC_OD_MaintenanceState_Obj_0050 ARC_OD_Width_Obj_11_FR ARC_OD_RCS_Obj_11_FR ARC_OD_Orientation_Obj_11_FR ARC_OD_LifeCycle_Obj_11_FR ARC_OD_ObstacleProb_Obj_10_FR ARC_OD_ObstacleProb_Obj_11_FR ARC_OD_VabsY_Obj_10_FR ARC_OD_ID_10_FR ARC_OD_ID_11_FR ARC_OD_MsgCounter_Obj_10_11_FR ARC_OD_CRC8_Obj_10_11_FR ARC_OD_AabsY_Obj_10_FR ARC_OD_DistXStd_Obj_10_FR ARC_OD_DistYStd_Obj_10_FR ARC_OD_VabsXStd_Obj_10_FR ARC_OD_VabsYStd_Obj_10_FR ARC_OD_AabsXStd_Obj_10_FR;
SIG_GROUP_ 1365 Signal_Group_ARC_OD_08_09 1 : DistHeight_Obj_09_FR DistHeight_Obj_08_FR ARC_OD_DistX_Obj_08_FR ARC_OD_Classification_Obj_08_FR ARC_OD_AabsYStd_Obj_08_FR ARC_OD_ClassConf_Obj_08_FR ARC_OD_ProbOfExist_Obj_08_FR ARC_OD_VabsX_Obj_08_FR ARC_OD_DynProp_Obj_08_FR ARC_OD_Length_Obj_08_FR ARC_OD_MaintenanceState_Obj_0051 ARC_OD_Width_Obj_08_FR ARC_OD_RCS_Obj_08_FR ARC_OD_Orientation_Obj_08_FR ARC_OD_LifeCycle_Obj_08_FR ARC_OD_DistX_Obj_09_FR ARC_OD_VabsX_Obj_09_FR ARC_OD_AabsX_Obj_09_FR ARC_OD_AabsX_Obj_08_FR ARC_OD_DistY_Obj_09_FR ARC_OD_VabsY_Obj_09_FR ARC_OD_AabsY_Obj_09_FR ARC_OD_DistXStd_Obj_09_FR ARC_OD_DistYStd_Obj_09_FR ARC_OD_VabsXStd_Obj_09_FR ARC_OD_VabsYStd_Obj_09_FR ARC_OD_AabsXStd_Obj_09_FR ARC_OD_Classification_Obj_09_FR ARC_OD_AabsYStd_Obj_09_FR ARC_OD_ClassConf_Obj_09_FR ARC_OD_DistY_Obj_08_FR ARC_OD_ProbOfExist_Obj_09_FR ARC_OD_DynProp_Obj_09_FR ARC_OD_Length_Obj_09_FR ARC_OD_MaintenanceState_Obj_0052 ARC_OD_Width_Obj_09_FR ARC_OD_RCS_Obj_09_FR ARC_OD_Orientation_Obj_09_FR ARC_OD_LifeCycle_Obj_09_FR ARC_OD_ObstacleProb_Obj_08_FR ARC_OD_ObstacleProb_Obj_09_FR ARC_OD_VabsY_Obj_08_FR ARC_OD_ID_08_FR ARC_OD_ID_09_FR ARC_OD_MsgCounter_Obj_08_09_FR ARC_OD_CRC8_Obj_08_09_FR ARC_OD_AabsY_Obj_08_FR ARC_OD_DistXStd_Obj_08_FR ARC_OD_DistYStd_Obj_08_FR ARC_OD_VabsXStd_Obj_08_FR ARC_OD_VabsYStd_Obj_08_FR ARC_OD_AabsXStd_Obj_08_FR;
SIG_GROUP_ 1364 Signal_Group_ARC_OD_06_07 1 : DistHeight_Obj_07_FR DistHeight_Obj_06_FR ARC_OD_DistX_Obj_06_FR ARC_OD_Classification_Obj_06_FR ARC_OD_AabsYStd_Obj_06_FR ARC_OD_ClassConf_Obj_06_FR ARC_OD_ProbOfExist_Obj_06_FR ARC_OD_VabsX_Obj_06_FR ARC_OD_DynProp_Obj_06_FR ARC_OD_Length_Obj_06_FR ARC_OD_MaintenanceState_Obj_0053 ARC_OD_Width_Obj_06_FR ARC_OD_RCS_Obj_06_FR ARC_OD_Orientation_Obj_06_FR ARC_OD_LifeCycle_Obj_06_FR ARC_OD_DistX_Obj_07_FR ARC_OD_VabsX_Obj_07_FR ARC_OD_AabsX_Obj_07_FR ARC_OD_AabsX_Obj_06_FR ARC_OD_DistY_Obj_07_FR ARC_OD_VabsY_Obj_07_FR ARC_OD_AabsY_Obj_07_FR ARC_OD_DistXStd_Obj_07_FR ARC_OD_DistYStd_Obj_07_FR ARC_OD_VabsXStd_Obj_07_FR ARC_OD_VabsYStd_Obj_07_FR ARC_OD_AabsXStd_Obj_07_FR ARC_OD_Classification_Obj_07_FR ARC_OD_AabsYStd_Obj_07_FR ARC_OD_ClassConf_Obj_07_FR ARC_OD_DistY_Obj_06_FR ARC_OD_ProbOfExist_Obj_07_FR ARC_OD_DynProp_Obj_07_FR ARC_OD_Length_Obj_07_FR ARC_OD_MaintenanceState_Obj_0054 ARC_OD_Width_Obj_07_FR ARC_OD_RCS_Obj_07_FR ARC_OD_Orientation_Obj_07_FR ARC_OD_LifeCycle_Obj_07_FR ARC_OD_ObstacleProb_Obj_06_FR ARC_OD_ObstacleProb_Obj_07_FR ARC_OD_VabsY_Obj_06_FR ARC_OD_ID_06_FR ARC_OD_ID_07_FR ARC_OD_MsgCounter_Obj_06_07_FR ARC_OD_CRC8_Obj_06_07_FR ARC_OD_AabsY_Obj_06_FR ARC_OD_DistXStd_Obj_06_FR ARC_OD_DistYStd_Obj_06_FR ARC_OD_VabsXStd_Obj_06_FR ARC_OD_VabsYStd_Obj_06_FR ARC_OD_AabsXStd_Obj_06_FR;
SIG_GROUP_ 1363 Signal_Group_ARC_OD_04_05 1 : DistHeight_Obj_04_FR DistHeight_Obj_05_FR ARC_OD_DistX_Obj_04_FR ARC_OD_Classification_Obj_04_FR ARC_OD_AabsYStd_Obj_04_FR ARC_OD_ClassConf_Obj_04_FR ARC_OD_ProbOfExist_Obj_04_FR ARC_OD_VabsX_Obj_04_FR ARC_OD_DynProp_Obj_04_FR ARC_OD_Length_Obj_04_FR ARC_OD_MaintenanceState_Obj_0055 ARC_OD_Width_Obj_04_FR ARC_OD_RCS_Obj_04_FR ARC_OD_Orientation_Obj_04_FR ARC_OD_LifeCycle_Obj_04_FR ARC_OD_DistX_Obj_05_FR ARC_OD_VabsX_Obj_05_FR ARC_OD_AabsX_Obj_05_FR ARC_OD_AabsX_Obj_04_FR ARC_OD_DistY_Obj_05_FR ARC_OD_VabsY_Obj_05_FR ARC_OD_AabsY_Obj_05_FR ARC_OD_DistXStd_Obj_05_FR ARC_OD_DistYStd_Obj_05_FR ARC_OD_VabsXStd_Obj_05_FR ARC_OD_VabsYStd_Obj_05_FR ARC_OD_AabsXStd_Obj_05_FR ARC_OD_Classification_Obj_05_FR ARC_OD_AabsYStd_Obj_05_FR ARC_OD_ClassConf_Obj_05_FR ARC_OD_DistY_Obj_04_FR ARC_OD_ProbOfExist_Obj_05_FR ARC_OD_DynProp_Obj_05_FR ARC_OD_Length_Obj_05_FR ARC_OD_MaintenanceState_Obj_0056 ARC_OD_Width_Obj_05_FR ARC_OD_RCS_Obj_05_FR ARC_OD_Orientation_Obj_05_FR ARC_OD_LifeCycle_Obj_05_FR ARC_OD_ObstacleProb_Obj_04_FR ARC_OD_ObstacleProb_Obj_05_FR ARC_OD_VabsY_Obj_04_FR ARC_OD_ID_04_FR ARC_OD_ID_05_FR ARC_OD_MsgCounter_Obj_04_05_FR ARC_OD_CRC8_Obj_04_05_FR ARC_OD_AabsY_Obj_04_FR ARC_OD_DistXStd_Obj_04_FR ARC_OD_DistYStd_Obj_04_FR ARC_OD_VabsXStd_Obj_04_FR ARC_OD_VabsYStd_Obj_04_FR ARC_OD_AabsXStd_Obj_04_FR;
SIG_GROUP_ 1362 Signal_Group_ARC_OD_02_03 1 : DistHeight_Obj_02_FR DistHeight_Obj_03_FR ARC_OD_DistX_Obj_02_FR ARC_OD_Classification_Obj_02_FR ARC_OD_AabsYStd_Obj_02_FR ARC_OD_ClassConf_Obj_02_FR ARC_OD_ProbOfExist_Obj_02_FR ARC_OD_VabsX_Obj_02_FR ARC_OD_DynProp_Obj_02_FR ARC_OD_Length_Obj_02_FR ARC_OD_MaintenanceState_Obj_0057 ARC_OD_Width_Obj_02_FR ARC_OD_RCS_Obj_02_FR ARC_OD_Orientation_Obj_02_FR ARC_OD_LifeCycle_Obj_02_FR ARC_OD_DistX_Obj_03_FR ARC_OD_VabsX_Obj_03_FR ARC_OD_AabsX_Obj_03_FR ARC_OD_AabsX_Obj_02_FR ARC_OD_DistY_Obj_03_FR ARC_OD_VabsY_Obj_03_FR ARC_OD_AabsY_Obj_03_FR ARC_OD_DistXStd_Obj_03_FR ARC_OD_DistYStd_Obj_03_FR ARC_OD_VabsXStd_Obj_03_FR ARC_OD_VabsYStd_Obj_03_FR ARC_OD_AabsXStd_Obj_03_FR ARC_OD_Classification_Obj_03_FR ARC_OD_AabsYStd_Obj_03_FR ARC_OD_ClassConf_Obj_03_FR ARC_OD_DistY_Obj_02_FR ARC_OD_ProbOfExist_Obj_03_FR ARC_OD_DynProp_Obj_03_FR ARC_OD_Length_Obj_03_FR ARC_OD_MaintenanceState_Obj_0058 ARC_OD_Width_Obj_03_FR ARC_OD_RCS_Obj_03_FR ARC_OD_Orientation_Obj_03_FR ARC_OD_LifeCycle_Obj_03_FR ARC_OD_ObstacleProb_Obj_02_FR ARC_OD_ObstacleProb_Obj_03_FR ARC_OD_VabsY_Obj_02_FR ARC_OD_ID_02_FR ARC_OD_ID_03_FR ARC_OD_MsgCounter_Obj_02_03_FR ARC_OD_CRC8_Obj_02_03_FR ARC_OD_AabsY_Obj_02_FR ARC_OD_DistXStd_Obj_02_FR ARC_OD_DistYStd_Obj_02_FR ARC_OD_VabsXStd_Obj_02_FR ARC_OD_VabsYStd_Obj_02_FR ARC_OD_AabsXStd_Obj_02_FR;
SIG_GROUP_ 1361 Signal_Group_ARC_OD_00_01 1 : DistHeight_Obj_01_FR DistHeight_Obj_00_FR ARC_OD_DistX_Obj_00_FR ARC_OD_Classification_Obj_00_FR ARC_OD_AabsYStd_Obj_00_FR ARC_OD_ClassConf_Obj_00_FR ARC_OD_ProbOfExist_Obj_00_FR ARC_OD_VabsX_Obj_00_FR ARC_OD_DynProp_Obj_00_FR ARC_OD_Length_Obj_00_FR ARC_OD_MaintenanceState_Obj_0059 ARC_OD_Width_Obj_00_FR ARC_OD_RCS_Obj_00_FR ARC_OD_Orientation_Obj_00_FR ARC_OD_LifeCycle_Obj_00_FR ARC_OD_DistX_Obj_01_FR ARC_OD_VabsX_Obj_01_FR ARC_OD_AabsX_Obj_01_FR ARC_OD_AabsX_Obj_00_FR ARC_OD_DistY_Obj_01_FR ARC_OD_VabsY_Obj_01_FR ARC_OD_AabsY_Obj_01_FR ARC_OD_DistXStd_Obj_01_FR ARC_OD_DistYStd_Obj_01_FR ARC_OD_VabsXStd_Obj_01_FR ARC_OD_VabsYStd_Obj_01_FR ARC_OD_AabsXStd_Obj_01_FR ARC_OD_Classification_Obj_01_FR ARC_OD_AabsYStd_Obj_01_FR ARC_OD_ClassConf_Obj_01_FR ARC_OD_DistY_Obj_00_FR ARC_OD_ProbOfExist_Obj_01_FR ARC_OD_DynProp_Obj_01_FR ARC_OD_Length_Obj_01_FR ARC_OD_MaintenanceState_Obj_0060 ARC_OD_Width_Obj_01_FR ARC_OD_RCS_Obj_01_FR ARC_OD_Orientation_Obj_01_FR ARC_OD_LifeCycle_Obj_01_FR ARC_OD_ObstacleProb_Obj_00_FR ARC_OD_ObstacleProb_Obj_01_FR ARC_OD_VabsY_Obj_00_FR ARC_OD_ID_00_FR ARC_OD_ID_01_FR ARC_OD_MsgCounter_Obj_00_01_FR ARC_OD_CRC8_Obj_00_01_FR ARC_OD_AabsY_Obj_00_FR ARC_OD_DistXStd_Obj_00_FR ARC_OD_DistYStd_Obj_00_FR ARC_OD_VabsXStd_Obj_00_FR ARC_OD_VabsYStd_Obj_00_FR ARC_OD_AabsXStd_Obj_00_FR;
SIG_GROUP_ 1134 Signal_Group_ARC_OD_58_59 1 : ARC_OD_DistX_Obj_58_RR ARC_OD_Classification_Obj_58_RR ARC_OD_AabsYStd_Obj_58_RR ARC_OD_ClassConf_Obj_58_RR ARC_OD_ProbOfExist_Obj_58_RR ARC_OD_VabsX_Obj_58_RR ARC_OD_DynProp_Obj_58_RR ARC_OD_Length_Obj_58_RR ARC_OD_MaintenanceState_Obj_58_R ARC_OD_Width_Obj_58_RR ARC_OD_RCS_Obj_58_RR ARC_OD_Orientation_Obj_58_RR ARC_OD_LifeCycle_Obj_58_RR ARC_OD_DistX_Obj_59_RR ARC_OD_VabsX_Obj_59_RR ARC_OD_AabsX_Obj_59_RR ARC_OD_AabsX_Obj_58_RR ARC_OD_DistY_Obj_59_RR ARC_OD_VabsY_Obj_59_RR ARC_OD_AabsY_Obj_59_RR ARC_OD_DistXStd_Obj_59_RR ARC_OD_DistYStd_Obj_59_RR ARC_OD_VabsXStd_Obj_59_RR ARC_OD_VabsYStd_Obj_59_RR ARC_OD_AabsXStd_Obj_59_RR ARC_OD_Classification_Obj_59_RR ARC_OD_AabsYStd_Obj_59_RR ARC_OD_ClassConf_Obj_59_RR ARC_OD_DistY_Obj_58_RR ARC_OD_ProbOfExist_Obj_59_RR ARC_OD_DynProp_Obj_59_RR ARC_OD_Length_Obj_59_RR ARC_OD_MaintenanceState_Obj_59_R ARC_OD_Width_Obj_59_RR ARC_OD_RCS_Obj_59_RR ARC_OD_Orientation_Obj_59_RR ARC_OD_LifeCycle_Obj_59_RR ARC_OD_ObstacleProb_Obj_58_RR ARC_OD_ObstacleProb_Obj_59_RR ARC_OD_VabsY_Obj_58_RR ARC_OD_ID_58_RR ARC_OD_ID_59_RR ARC_OD_MsgCounter_Obj_58_59_RR ARC_OD_CRC8_Obj_58_59_RR ARC_OD_AabsY_Obj_58_RR ARC_OD_DistXStd_Obj_58_RR ARC_OD_DistYStd_Obj_58_RR ARC_OD_VabsXStd_Obj_58_RR ARC_OD_VabsYStd_Obj_58_RR ARC_OD_AabsXStd_Obj_58_RR;
