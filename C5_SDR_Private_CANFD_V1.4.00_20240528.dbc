VERSION "created by canmatrix"

NS_ :

BS_:

BU_: ARC ADC

BO_ 1112 ARC_OD_14_15_RR: 64 ARC
 SG_ DistHeight_Obj_15_RR : 487|8@0+ (0.2,-10) [-10|41] "m"  ADC
 SG_ DistHeight_Obj_14_RR : 479|8@0+ (0.2,-10) [-10|41] "m"  ADC
 SG_ ARC_OD_DistX_Obj_14_RR : 7|12@0+ (0.1,-152) [-152|257.5] "m"  ADC
 SG_ ARC_OD_Classification_Obj_14_RR : 98|3@0+ (1,0) [0|7] ""  ADC
 SG_ ARC_OD_AabsYStd_Obj_14_RR : 111|8@0+ (0.25,0) [0|63.75] "m/s^2"  ADC
 SG_ ARC_OD_ClassConf_Obj_14_RR : 119|7@0+ (1,0) [0|127] "%"  ADC
 SG_ ARC_OD_ProbOfExist_Obj_14_RR : 112|7@0+ (1,0) [0|127] "%"  ADC
 SG_ ARC_OD_VabsX_Obj_14_RR : 11|11@0+ (0.125,-128) [-128|127.875] "m/s"  ADC
 SG_ ARC_OD_DynProp_Obj_14_RR : 130|3@0+ (1,0) [0|7] ""  ADC
 SG_ ARC_OD_Length_Obj_14_RR : 136|7@0+ (0.2,0) [0|25.4] "m"  ADC
 SG_ ARC_OD_MaintenanceState_Obj_14_R : 145|2@0+ (1,0) [0|3] ""  ADC
 SG_ ARC_OD_Width_Obj_14_RR : 159|7@0+ (0.2,0) [0|25.4] "m"  ADC
 SG_ ARC_OD_RCS_Obj_14_RR : 152|9@0+ (0.2,-51.1) [-51.1|51.1] "dBsm"  ADC
 SG_ ARC_OD_Orientation_Obj_14_RR : 175|10@0+ (0.01,-5.11) [-5.11|5.12] "rad"  ADC
 SG_ ARC_OD_LifeCycle_Obj_14_RR : 207|16@0+ (1,0) [0|65535] ""  ADC
 SG_ ARC_OD_DistX_Obj_15_RR : 223|12@0+ (0.1,-152) [-152|257.5] "m"  ADC
 SG_ ARC_OD_VabsX_Obj_15_RR : 227|11@0+ (0.125,-128) [-128|127.875] "m/s"  ADC
 SG_ ARC_OD_AabsX_Obj_15_RR : 232|9@0+ (0.125,-31.875) [-31.875|32] "m/s^2"  ADC
 SG_ ARC_OD_AabsX_Obj_14_RR : 16|9@0+ (0.125,-31.875) [-31.875|32] "m/s^2"  ADC
 SG_ ARC_OD_DistY_Obj_15_RR : 255|12@0+ (0.0875,-179.113) [-179.113|179.2] "m"  ADC
 SG_ ARC_OD_VabsY_Obj_15_RR : 259|11@0+ (0.125,-128) [-128|127.875] "m/s"  ADC
 SG_ ARC_OD_AabsY_Obj_15_RR : 264|9@0+ (0.125,-31.875) [-31.875|32] "m/s^2"  ADC
 SG_ ARC_OD_DistXStd_Obj_15_RR : 287|8@0+ (0.05,0) [0|12.75] "m"  ADC
 SG_ ARC_OD_DistYStd_Obj_15_RR : 295|8@0+ (0.1,0) [0|25.5] "m"  ADC
 SG_ ARC_OD_VabsXStd_Obj_15_RR : 303|7@0+ (0.1,0) [0|12.7] "m/s"  ADC
 SG_ ARC_OD_VabsYStd_Obj_15_RR : 296|7@0+ (0.2,0) [0|25.4] "m/s"  ADC
 SG_ ARC_OD_AabsXStd_Obj_15_RR : 305|7@0+ (0.25,0) [0|31.75] "m/s^2"  ADC
 SG_ ARC_OD_Classification_Obj_15_RR : 314|3@0+ (1,0) [0|7] ""  ADC
 SG_ ARC_OD_AabsYStd_Obj_15_RR : 327|8@0+ (0.25,0) [0|63.75] "m/s^2"  ADC
 SG_ ARC_OD_ClassConf_Obj_15_RR : 335|7@0+ (1,0) [0|127] "%"  ADC
 SG_ ARC_OD_DistY_Obj_14_RR : 39|12@0+ (0.0875,-179.113) [-179.113|179.2] "m"  ADC
 SG_ ARC_OD_ProbOfExist_Obj_15_RR : 328|7@0+ (1,0) [0|127] "%"  ADC
 SG_ ARC_OD_DynProp_Obj_15_RR : 346|3@0+ (1,0) [0|7] ""  ADC
 SG_ ARC_OD_Length_Obj_15_RR : 352|7@0+ (0.2,0) [0|25.4] "m"  ADC
 SG_ ARC_OD_MaintenanceState_Obj_15_R : 361|2@0+ (1,0) [0|3] ""  ADC
 SG_ ARC_OD_Width_Obj_15_RR : 375|7@0+ (0.2,0) [0|25.4] "m"  ADC
 SG_ ARC_OD_RCS_Obj_15_RR : 368|9@0+ (0.2,-51.1) [-51.1|51.1] "dBsm"  ADC
 SG_ ARC_OD_Orientation_Obj_15_RR : 391|10@0+ (0.01,-5.11) [-5.11|5.12] "rad"  ADC
 SG_ ARC_OD_LifeCycle_Obj_15_RR : 423|16@0+ (1,0) [0|65535] ""  ADC
 SG_ ARC_OD_ObstacleProb_Obj_14_RR : 447|7@0+ (1,0) [0|127] "%"  ADC
 SG_ ARC_OD_ObstacleProb_Obj_15_RR : 455|7@0+ (1,0) [0|127] "%"  ADC
 SG_ ARC_OD_VabsY_Obj_14_RR : 43|11@0+ (0.125,-128) [-128|127.875] "m/s"  ADC
 SG_ ARC_OD_ID_14_RR : 463|8@0+ (1,0) [0|255] ""  ADC
 SG_ ARC_OD_ID_15_RR : 471|8@0+ (1,0) [0|255] ""  ADC
 SG_ ARC_OD_MsgCounter_Obj_14_15_RR : 491|4@0+ (1,0) [0|15] ""  ADC
 SG_ ARC_OD_CRC8_Obj_14_15_RR : 511|8@0+ (1,0) [0|256] ""  ADC
 SG_ ARC_OD_AabsY_Obj_14_RR : 48|9@0+ (0.125,-31.875) [-31.875|32] "m/s^2"  ADC
 SG_ ARC_OD_DistXStd_Obj_14_RR : 71|8@0+ (0.05,0) [0|12.75] "m"  ADC
 SG_ ARC_OD_DistYStd_Obj_14_RR : 79|8@0+ (0.1,0) [0|25.5] "m"  ADC
 SG_ ARC_OD_VabsXStd_Obj_14_RR : 87|7@0+ (0.1,0) [0|12.7] "m/s"  ADC
 SG_ ARC_OD_VabsYStd_Obj_14_RR : 80|7@0+ (0.2,0) [0|25.4] "m/s"  ADC
 SG_ ARC_OD_AabsXStd_Obj_14_RR : 89|7@0+ (0.25,0) [0|31.75] "m/s^2"  ADC

BO_ 1111 ARC_OD_12_13_RR: 64 ARC
 SG_ DistHeight_Obj_13_RR : 487|8@0+ (0.2,-10) [-10|41] "m"  ADC
 SG_ DistHeight_Obj_12_RR : 479|8@0+ (0.2,-10) [-10|41] "m"  ADC
 SG_ ARC_OD_DistX_Obj_12_RR : 7|12@0+ (0.1,-152) [-152|257.5] "m"  ADC
 SG_ ARC_OD_Classification_Obj_12_RR : 98|3@0+ (1,0) [0|7] ""  ADC
 SG_ ARC_OD_AabsYStd_Obj_12_RR : 111|8@0+ (0.25,0) [0|63.75] "m/s^2"  ADC
 SG_ ARC_OD_ClassConf_Obj_12_RR : 119|7@0+ (1,0) [0|127] "%"  ADC
 SG_ ARC_OD_ProbOfExist_Obj_12_RR : 112|7@0+ (1,0) [0|127] "%"  ADC
 SG_ ARC_OD_VabsX_Obj_12_RR : 11|11@0+ (0.125,-128) [-128|127.875] "m/s"  ADC
 SG_ ARC_OD_DynProp_Obj_12_RR : 130|3@0+ (1,0) [0|7] ""  ADC
 SG_ ARC_OD_Length_Obj_12_RR : 136|7@0+ (0.2,0) [0|25.4] "m"  ADC
 SG_ ARC_OD_MaintenanceState_Obj_12_R : 145|2@0+ (1,0) [0|3] ""  ADC
 SG_ ARC_OD_Width_Obj_12_RR : 159|7@0+ (0.2,0) [0|25.4] "m"  ADC
 SG_ ARC_OD_RCS_Obj_12_RR : 152|9@0+ (0.2,-51.1) [-51.1|51.1] "dBsm"  ADC
 SG_ ARC_OD_Orientation_Obj_12_RR : 175|10@0+ (0.01,-5.11) [-5.11|5.12] "rad"  ADC
 SG_ ARC_OD_LifeCycle_Obj_12_RR : 207|16@0+ (1,0) [0|65535] ""  ADC
 SG_ ARC_OD_DistX_Obj_13_RR : 223|12@0+ (0.1,-152) [-152|257.5] "m"  ADC
 SG_ ARC_OD_VabsX_Obj_13_RR : 227|11@0+ (0.125,-128) [-128|127.875] "m/s"  ADC
 SG_ ARC_OD_AabsX_Obj_13_RR : 232|9@0+ (0.125,-31.875) [-31.875|32] "m/s^2"  ADC
 SG_ ARC_OD_AabsX_Obj_12_RR : 16|9@0+ (0.125,-31.875) [-31.875|32] "m/s^2"  ADC
 SG_ ARC_OD_DistY_Obj_13_RR : 255|12@0+ (0.0875,-179.113) [-179.113|179.2] "m"  ADC
 SG_ ARC_OD_VabsY_Obj_13_RR : 259|11@0+ (0.125,-128) [-128|127.875] "m/s"  ADC
 SG_ ARC_OD_AabsY_Obj_13_RR : 264|9@0+ (0.125,-31.875) [-31.875|32] "m/s^2"  ADC
 SG_ ARC_OD_DistXStd_Obj_13_RR : 287|8@0+ (0.05,0) [0|12.75] "m"  ADC
 SG_ ARC_OD_DistYStd_Obj_13_RR : 295|8@0+ (0.1,0) [0|25.5] "m"  ADC
 SG_ ARC_OD_VabsXStd_Obj_13_RR : 303|7@0+ (0.1,0) [0|12.7] "m/s"  ADC
 SG_ ARC_OD_VabsYStd_Obj_13_RR : 296|7@0+ (0.2,0) [0|25.4] "m/s"  ADC
 SG_ ARC_OD_AabsXStd_Obj_13_RR : 305|7@0+ (0.25,0) [0|31.75] "m/s^2"  ADC
 SG_ ARC_OD_Classification_Obj_13_RR : 314|3@0+ (1,0) [0|7] ""  ADC
 SG_ ARC_OD_AabsYStd_Obj_13_RR : 327|8@0+ (0.25,0) [0|63.75] "m/s^2"  ADC
 SG_ ARC_OD_ClassConf_Obj_13_RR : 335|7@0+ (1,0) [0|127] "%"  ADC
 SG_ ARC_OD_DistY_Obj_12_RR : 39|12@0+ (0.0875,-179.113) [-179.113|179.2] "m"  ADC
 SG_ ARC_OD_ProbOfExist_Obj_13_RR : 328|7@0+ (1,0) [0|127] "%"  ADC
 SG_ ARC_OD_DynProp_Obj_13_RR : 346|3@0+ (1,0) [0|7] ""  ADC
 SG_ ARC_OD_Length_Obj_13_RR : 352|7@0+ (0.2,0) [0|25.4] "m"  ADC
 SG_ ARC_OD_MaintenanceState_Obj_13_R : 361|2@0+ (1,0) [0|3] ""  ADC
 SG_ ARC_OD_Width_Obj_13_RR : 375|7@0+ (0.2,0) [0|25.4] "m"  ADC
 SG_ ARC_OD_RCS_Obj_13_RR : 368|9@0+ (0.2,-51.1) [-51.1|51.1] "dBsm"  ADC
 SG_ ARC_OD_Orientation_Obj_13_RR : 391|10@0+ (0.01,-5.11) [-5.11|5.12] "rad"  ADC
 SG_ ARC_OD_LifeCycle_Obj_13_RR : 423|16@0+ (1,0) [0|65535] ""  ADC
 SG_ ARC_OD_ObstacleProb_Obj_12_RR : 447|7@0+ (1,0) [0|127] "%"  ADC
 SG_ ARC_OD_ObstacleProb_Obj_13_RR : 455|7@0+ (1,0) [0|127] "%"  ADC
 SG_ ARC_OD_VabsY_Obj_12_RR : 43|11@0+ (0.125,-128) [-128|127.875] "m/s"  ADC
 SG_ ARC_OD_ID_12_RR : 463|8@0+ (1,0) [0|255] ""  ADC
 SG_ ARC_OD_ID_13_RR : 471|8@0+ (1,0) [0|255] ""  ADC
 SG_ ARC_OD_MsgCounter_Obj_12_13_RR : 491|4@0+ (1,0) [0|15] ""  ADC
 SG_ ARC_OD_CRC8_Obj_12_13_RR : 511|8@0+ (1,0) [0|256] ""  ADC
 SG_ ARC_OD_AabsY_Obj_12_RR : 48|9@0+ (0.125,-31.875) [-31.875|32] "m/s^2"  ADC
 SG_ ARC_OD_DistXStd_Obj_12_RR : 71|8@0+ (0.05,0) [0|12.75] "m"  ADC
 SG_ ARC_OD_DistYStd_Obj_12_RR : 79|8@0+ (0.1,0) [0|25.5] "m"  ADC
 SG_ ARC_OD_VabsXStd_Obj_12_RR : 87|7@0+ (0.1,0) [0|12.7] "m/s"  ADC
 SG_ ARC_OD_VabsYStd_Obj_12_RR : 80|7@0+ (0.2,0) [0|25.4] "m/s"  ADC
 SG_ ARC_OD_AabsXStd_Obj_12_RR : 89|7@0+ (0.25,0) [0|31.75] "m/s^2"  ADC

BO_ 1110 ARC_OD_10_11_RR: 64 ARC
 SG_ DistHeight_Obj_11_RR : 487|8@0+ (0.2,-10) [-10|41] "m"  ADC
 SG_ DistHeight_Obj_10_RR : 479|8@0+ (0.2,-10) [-10|41] "m"  ADC
 SG_ ARC_OD_DistX_Obj_10_RR : 7|12@0+ (0.1,-152) [-152|257.5] "m"  ADC
 SG_ ARC_OD_Classification_Obj_10_RR : 98|3@0+ (1,0) [0|7] ""  ADC
 SG_ ARC_OD_AabsYStd_Obj_10_RR : 111|8@0+ (0.25,0) [0|63.75] "m/s^2"  ADC
 SG_ ARC_OD_ClassConf_Obj_10_RR : 119|7@0+ (1,0) [0|127] "%"  ADC
 SG_ ARC_OD_ProbOfExist_Obj_10_RR : 112|7@0+ (1,0) [0|127] "%"  ADC
 SG_ ARC_OD_VabsX_Obj_10_RR : 11|11@0+ (0.125,-128) [-128|127.875] "m/s"  ADC
 SG_ ARC_OD_DynProp_Obj_10_RR : 130|3@0+ (1,0) [0|7] ""  ADC
 SG_ ARC_OD_Length_Obj_10_RR : 136|7@0+ (0.2,0) [0|25.4] "m"  ADC
 SG_ ARC_OD_MaintenanceState_Obj_10_R : 145|2@0+ (1,0) [0|3] ""  ADC
 SG_ ARC_OD_Width_Obj_10_RR : 159|7@0+ (0.2,0) [0|25.4] "m"  ADC
 SG_ ARC_OD_RCS_Obj_10_RR : 152|9@0+ (0.2,-51.1) [-51.1|51.1] "dBsm"  ADC
 SG_ ARC_OD_Orientation_Obj_10_RR : 175|10@0+ (0.01,-5.11) [-5.11|5.12] "rad"  ADC
 SG_ ARC_OD_LifeCycle_Obj_10_RR : 207|16@0+ (1,0) [0|65535] ""  ADC
 SG_ ARC_OD_DistX_Obj_11_RR : 223|12@0+ (0.1,-152) [-152|257.5] "m"  ADC
 SG_ ARC_OD_VabsX_Obj_11_RR : 227|11@0+ (0.125,-128) [-128|127.875] "m/s"  ADC
 SG_ ARC_OD_AabsX_Obj_11_RR : 232|9@0+ (0.125,-31.875) [-31.875|32] "m/s^2"  ADC
 SG_ ARC_OD_AabsX_Obj_10_RR : 16|9@0+ (0.125,-31.875) [-31.875|32] "m/s^2"  ADC
 SG_ ARC_OD_DistY_Obj_11_RR : 255|12@0+ (0.0875,-179.113) [-179.113|179.2] "m"  ADC
 SG_ ARC_OD_VabsY_Obj_11_RR : 259|11@0+ (0.125,-128) [-128|127.875] "m/s"  ADC
 SG_ ARC_OD_AabsY_Obj_11_RR : 264|9@0+ (0.125,-31.875) [-31.875|32] "m/s^2"  ADC
 SG_ ARC_OD_DistXStd_Obj_11_RR : 287|8@0+ (0.05,0) [0|12.75] "m"  ADC
 SG_ ARC_OD_DistYStd_Obj_11_RR : 295|8@0+ (0.1,0) [0|25.5] "m"  ADC
 SG_ ARC_OD_VabsXStd_Obj_11_RR : 303|7@0+ (0.1,0) [0|12.7] "m/s"  ADC
 SG_ ARC_OD_VabsYStd_Obj_11_RR : 296|7@0+ (0.2,0) [0|25.4] "m/s"  ADC
 SG_ ARC_OD_AabsXStd_Obj_11_RR : 305|7@0+ (0.25,0) [0|31.75] "m/s^2"  ADC
 SG_ ARC_OD_Classification_Obj_11_RR : 314|3@0+ (1,0) [0|7] ""  ADC
 SG_ ARC_OD_AabsYStd_Obj_11_RR : 327|8@0+ (0.25,0) [0|63.75] "m/s^2"  ADC
 SG_ ARC_OD_ClassConf_Obj_11_RR : 335|7@0+ (1,0) [0|127] "%"  ADC
 SG_ ARC_OD_DistY_Obj_10_RR : 39|12@0+ (0.0875,-179.113) [-179.113|179.2] "m"  ADC
 SG_ ARC_OD_ProbOfExist_Obj_11_RR : 328|7@0+ (1,0) [0|127] "%"  ADC
 SG_ ARC_OD_DynProp_Obj_11_RR : 346|3@0+ (1,0) [0|7] ""  ADC
 SG_ ARC_OD_Length_Obj_11_RR : 352|7@0+ (0.2,0) [0|25.4] "m"  ADC
 SG_ ARC_OD_MaintenanceState_Obj_11_R : 361|2@0+ (1,0) [0|3] ""  ADC
 SG_ ARC_OD_Width_Obj_11_RR : 375|7@0+ (0.2,0) [0|25.4] "m"  ADC
 SG_ ARC_OD_RCS_Obj_11_RR : 368|9@0+ (0.2,-51.1) [-51.1|51.1] "dBsm"  ADC
 SG_ ARC_OD_Orientation_Obj_11_RR : 391|10@0+ (0.01,-5.11) [-5.11|5.12] "rad"  ADC
 SG_ ARC_OD_LifeCycle_Obj_11_RR : 423|16@0+ (1,0) [0|65535] ""  ADC
 SG_ ARC_OD_ObstacleProb_Obj_10_RR : 447|7@0+ (1,0) [0|127] "%"  ADC
 SG_ ARC_OD_ObstacleProb_Obj_11_RR : 455|7@0+ (1,0) [0|127] "%"  ADC
 SG_ ARC_OD_VabsY_Obj_10_RR : 43|11@0+ (0.125,-128) [-128|127.875] "m/s"  ADC
 SG_ ARC_OD_ID_10_RR : 463|8@0+ (1,0) [0|255] ""  ADC
 SG_ ARC_OD_ID_11_RR : 471|8@0+ (1,0) [0|255] ""  ADC
 SG_ ARC_OD_MsgCounter_Obj_10_11_RR : 491|4@0+ (1,0) [0|15] ""  ADC
 SG_ ARC_OD_CRC8_Obj_10_11_RR : 511|8@0+ (1,0) [0|256] ""  ADC
 SG_ ARC_OD_AabsY_Obj_10_RR : 48|9@0+ (0.125,-31.875) [-31.875|32] "m/s^2"  ADC
 SG_ ARC_OD_DistXStd_Obj_10_RR : 71|8@0+ (0.05,0) [0|12.75] "m"  ADC
 SG_ ARC_OD_DistYStd_Obj_10_RR : 79|8@0+ (0.1,0) [0|25.5] "m"  ADC
 SG_ ARC_OD_VabsXStd_Obj_10_RR : 87|7@0+ (0.1,0) [0|12.7] "m/s"  ADC
 SG_ ARC_OD_VabsYStd_Obj_10_RR : 80|7@0+ (0.2,0) [0|25.4] "m/s"  ADC
 SG_ ARC_OD_AabsXStd_Obj_10_RR : 89|7@0+ (0.25,0) [0|31.75] "m/s^2"  ADC

BO_ 1109 ARC_OD_08_09_RR: 64 ARC
 SG_ DistHeight_Obj_09_RR : 487|8@0+ (0.2,-10) [-10|41] "m"  ADC
 SG_ DistHeight_Obj_08_RR : 479|8@0+ (0.2,-10) [-10|41] "m"  ADC
 SG_ ARC_OD_DistX_Obj_08_RR : 7|12@0+ (0.1,-152) [-152|257.5] "m"  ADC
 SG_ ARC_OD_Classification_Obj_08_RR : 98|3@0+ (1,0) [0|7] ""  ADC
 SG_ ARC_OD_AabsYStd_Obj_08_RR : 111|8@0+ (0.25,0) [0|63.75] "m/s^2"  ADC
 SG_ ARC_OD_ClassConf_Obj_08_RR : 119|7@0+ (1,0) [0|127] "%"  ADC
 SG_ ARC_OD_ProbOfExist_Obj_08_RR : 112|7@0+ (1,0) [0|127] "%"  ADC
 SG_ ARC_OD_VabsX_Obj_08_RR : 11|11@0+ (0.125,-128) [-128|127.875] "m/s"  ADC
 SG_ ARC_OD_DynProp_Obj_08_RR : 130|3@0+ (1,0) [0|7] ""  ADC
 SG_ ARC_OD_Length_Obj_08_RR : 136|7@0+ (0.2,0) [0|25.4] "m"  ADC
 SG_ ARC_OD_MaintenanceState_Obj_08_R : 145|2@0+ (1,0) [0|3] ""  ADC
 SG_ ARC_OD_Width_Obj_08_RR : 159|7@0+ (0.2,0) [0|25.4] "m"  ADC
 SG_ ARC_OD_RCS_Obj_08_RR : 152|9@0+ (0.2,-51.1) [-51.1|51.1] "dBsm"  ADC
 SG_ ARC_OD_Orientation_Obj_08_RR : 175|10@0+ (0.01,-5.11) [-5.11|5.12] "rad"  ADC
 SG_ ARC_OD_LifeCycle_Obj_08_RR : 207|16@0+ (1,0) [0|65535] ""  ADC
 SG_ ARC_OD_DistX_Obj_09_RR : 223|12@0+ (0.1,-152) [-152|257.5] "m"  ADC
 SG_ ARC_OD_VabsX_Obj_09_RR : 227|11@0+ (0.125,-128) [-128|127.875] "m/s"  ADC
 SG_ ARC_OD_AabsX_Obj_09_RR : 232|9@0+ (0.125,-31.875) [-31.875|32] "m/s^2"  ADC
 SG_ ARC_OD_AabsX_Obj_08_RR : 16|9@0+ (0.125,-31.875) [-31.875|32] "m/s^2"  ADC
 SG_ ARC_OD_DistY_Obj_09_RR : 255|12@0+ (0.0875,-179.113) [-179.113|179.2] "m"  ADC
 SG_ ARC_OD_VabsY_Obj_09_RR : 259|11@0+ (0.125,-128) [-128|127.875] "m/s"  ADC
 SG_ ARC_OD_AabsY_Obj_09_RR : 264|9@0+ (0.125,-31.875) [-31.875|32] "m/s^2"  ADC
 SG_ ARC_OD_DistXStd_Obj_09_RR : 287|8@0+ (0.05,0) [0|12.75] "m"  ADC
 SG_ ARC_OD_DistYStd_Obj_09_RR : 295|8@0+ (0.1,0) [0|25.5] "m"  ADC
 SG_ ARC_OD_VabsXStd_Obj_09_RR : 303|7@0+ (0.1,0) [0|12.7] "m/s"  ADC
 SG_ ARC_OD_VabsYStd_Obj_09_RR : 296|7@0+ (0.2,0) [0|25.4] "m/s"  ADC
 SG_ ARC_OD_AabsXStd_Obj_09_RR : 305|7@0+ (0.25,0) [0|31.75] "m/s^2"  ADC
 SG_ ARC_OD_Classification_Obj_09_RR : 314|3@0+ (1,0) [0|7] ""  ADC
 SG_ ARC_OD_AabsYStd_Obj_09_RR : 327|8@0+ (0.25,0) [0|63.75] "m/s^2"  ADC
 SG_ ARC_OD_ClassConf_Obj_09_RR : 335|7@0+ (1,0) [0|127] "%"  ADC
 SG_ ARC_OD_DistY_Obj_08_RR : 39|12@0+ (0.0875,-179.113) [-179.113|179.2] "m"  ADC
 SG_ ARC_OD_ProbOfExist_Obj_09_RR : 328|7@0+ (1,0) [0|127] "%"  ADC
 SG_ ARC_OD_DynProp_Obj_09_RR : 346|3@0+ (1,0) [0|7] ""  ADC
 SG_ ARC_OD_Length_Obj_09_RR : 352|7@0+ (0.2,0) [0|25.4] "m"  ADC
 SG_ ARC_OD_MaintenanceState_Obj_09_R : 361|2@0+ (1,0) [0|3] ""  ADC
 SG_ ARC_OD_Width_Obj_09_RR : 375|7@0+ (0.2,0) [0|25.4] "m"  ADC
 SG_ ARC_OD_RCS_Obj_09_RR : 368|9@0+ (0.2,-51.1) [-51.1|51.1] "dBsm"  ADC
 SG_ ARC_OD_Orientation_Obj_09_RR : 391|10@0+ (0.01,-5.11) [-5.11|5.12] "rad"  ADC
 SG_ ARC_OD_LifeCycle_Obj_09_RR : 423|16@0+ (1,0) [0|65535] ""  ADC
 SG_ ARC_OD_ObstacleProb_Obj_08_RR : 447|7@0+ (1,0) [0|127] "%"  ADC
 SG_ ARC_OD_ObstacleProb_Obj_09_RR : 455|7@0+ (1,0) [0|127] "%"  ADC
 SG_ ARC_OD_VabsY_Obj_08_RR : 43|11@0+ (0.125,-128) [-128|127.875] "m/s"  ADC
 SG_ ARC_OD_ID_08_RR : 463|8@0+ (1,0) [0|255] ""  ADC
 SG_ ARC_OD_ID_09_RR : 471|8@0+ (1,0) [0|255] ""  ADC
 SG_ ARC_OD_MsgCounter_Obj_08_09_RR : 491|4@0+ (1,0) [0|15] ""  ADC
 SG_ ARC_OD_CRC8_Obj_08_09_RR : 511|8@0+ (1,0) [0|256] ""  ADC
 SG_ ARC_OD_AabsY_Obj_08_RR : 48|9@0+ (0.125,-31.875) [-31.875|32] "m/s^2"  ADC
 SG_ ARC_OD_DistXStd_Obj_08_RR : 71|8@0+ (0.05,0) [0|12.75] "m"  ADC
 SG_ ARC_OD_DistYStd_Obj_08_RR : 79|8@0+ (0.1,0) [0|25.5] "m"  ADC
 SG_ ARC_OD_VabsXStd_Obj_08_RR : 87|7@0+ (0.1,0) [0|12.7] "m/s"  ADC
 SG_ ARC_OD_VabsYStd_Obj_08_RR : 80|7@0+ (0.2,0) [0|25.4] "m/s"  ADC
 SG_ ARC_OD_AabsXStd_Obj_08_RR : 89|7@0+ (0.25,0) [0|31.75] "m/s^2"  ADC

BO_ 1108 ARC_OD_06_07_RR: 64 ARC
 SG_ DistHeight_Obj_07_RR : 487|8@0+ (0.2,-10) [-10|41] "m"  ADC
 SG_ DistHeight_Obj_06_RR : 479|8@0+ (0.2,-10) [-10|41] "m"  ADC
 SG_ ARC_OD_DistX_Obj_06_RR : 7|12@0+ (0.1,-152) [-152|257.5] "m"  ADC
 SG_ ARC_OD_Classification_Obj_06_RR : 98|3@0+ (1,0) [0|7] ""  ADC
 SG_ ARC_OD_AabsYStd_Obj_06_RR : 111|8@0+ (0.25,0) [0|63.75] "m/s^2"  ADC
 SG_ ARC_OD_ClassConf_Obj_06_RR : 119|7@0+ (1,0) [0|127] "%"  ADC
 SG_ ARC_OD_ProbOfExist_Obj_06_RR : 112|7@0+ (1,0) [0|127] "%"  ADC
 SG_ ARC_OD_VabsX_Obj_06_RR : 11|11@0+ (0.125,-128) [-128|127.875] "m/s"  ADC
 SG_ ARC_OD_DynProp_Obj_06_RR : 130|3@0+ (1,0) [0|7] ""  ADC
 SG_ ARC_OD_Length_Obj_06_RR : 136|7@0+ (0.2,0) [0|25.4] "m"  ADC
 SG_ ARC_OD_MaintenanceState_Obj_06_R : 145|2@0+ (1,0) [0|3] ""  ADC
 SG_ ARC_OD_Width_Obj_06_RR : 159|7@0+ (0.2,0) [0|25.4] "m"  ADC
 SG_ ARC_OD_RCS_Obj_06_RR : 152|9@0+ (0.2,-51.1) [-51.1|51.1] "dBsm"  ADC
 SG_ ARC_OD_Orientation_Obj_06_RR : 175|10@0+ (0.01,-5.11) [-5.11|5.12] "rad"  ADC
 SG_ ARC_OD_LifeCycle_Obj_06_RR : 207|16@0+ (1,0) [0|65535] ""  ADC
 SG_ ARC_OD_DistX_Obj_07_RR : 223|12@0+ (0.1,-152) [-152|257.5] "m"  ADC
 SG_ ARC_OD_VabsX_Obj_07_RR : 227|11@0+ (0.125,-128) [-128|127.875] "m/s"  ADC
 SG_ ARC_OD_AabsX_Obj_07_RR : 232|9@0+ (0.125,-31.875) [-31.875|32] "m/s^2"  ADC
 SG_ ARC_OD_AabsX_Obj_06_RR : 16|9@0+ (0.125,-31.875) [-31.875|32] "m/s^2"  ADC
 SG_ ARC_OD_DistY_Obj_07_RR : 255|12@0+ (0.0875,-179.113) [-179.113|179.2] "m"  ADC
 SG_ ARC_OD_VabsY_Obj_07_RR : 259|11@0+ (0.125,-128) [-128|127.875] "m/s"  ADC
 SG_ ARC_OD_AabsY_Obj_07_RR : 264|9@0+ (0.125,-31.875) [-31.875|32] "m/s^2"  ADC
 SG_ ARC_OD_DistXStd_Obj_07_RR : 287|8@0+ (0.05,0) [0|12.75] "m"  ADC
 SG_ ARC_OD_DistYStd_Obj_07_RR : 295|8@0+ (0.1,0) [0|25.5] "m"  ADC
 SG_ ARC_OD_VabsXStd_Obj_07_RR : 303|7@0+ (0.1,0) [0|12.7] "m/s"  ADC
 SG_ ARC_OD_VabsYStd_Obj_07_RR : 296|7@0+ (0.2,0) [0|25.4] "m/s"  ADC
 SG_ ARC_OD_AabsXStd_Obj_07_RR : 305|7@0+ (0.25,0) [0|31.75] "m/s^2"  ADC
 SG_ ARC_OD_Classification_Obj_07_RR : 314|3@0+ (1,0) [0|7] ""  ADC
 SG_ ARC_OD_AabsYStd_Obj_07_RR : 327|8@0+ (0.25,0) [0|63.75] "m/s^2"  ADC
 SG_ ARC_OD_ClassConf_Obj_07_RR : 335|7@0+ (1,0) [0|127] "%"  ADC
 SG_ ARC_OD_DistY_Obj_06_RR : 39|12@0+ (0.0875,-179.113) [-179.113|179.2] "m"  ADC
 SG_ ARC_OD_ProbOfExist_Obj_07_RR : 328|7@0+ (1,0) [0|127] "%"  ADC
 SG_ ARC_OD_DynProp_Obj_07_RR : 346|3@0+ (1,0) [0|7] ""  ADC
 SG_ ARC_OD_Length_Obj_07_RR : 352|7@0+ (0.2,0) [0|25.4] "m"  ADC
 SG_ ARC_OD_MaintenanceState_Obj_07_R : 361|2@0+ (1,0) [0|3] ""  ADC
 SG_ ARC_OD_Width_Obj_07_RR : 375|7@0+ (0.2,0) [0|25.4] "m"  ADC
 SG_ ARC_OD_RCS_Obj_07_RR : 368|9@0+ (0.2,-51.1) [-51.1|51.1] "dBsm"  ADC
 SG_ ARC_OD_Orientation_Obj_07_RR : 391|10@0+ (0.01,-5.11) [-5.11|5.12] "rad"  ADC
 SG_ ARC_OD_LifeCycle_Obj_07_RR : 423|16@0+ (1,0) [0|65535] ""  ADC
 SG_ ARC_OD_ObstacleProb_Obj_06_RR : 447|7@0+ (1,0) [0|127] "%"  ADC
 SG_ ARC_OD_ObstacleProb_Obj_07_RR : 455|7@0+ (1,0) [0|127] "%"  ADC
 SG_ ARC_OD_VabsY_Obj_06_RR : 43|11@0+ (0.125,-128) [-128|127.875] "m/s"  ADC
 SG_ ARC_OD_ID_06_RR : 463|8@0+ (1,0) [0|255] ""  ADC
 SG_ ARC_OD_ID_07_RR : 471|8@0+ (1,0) [0|255] ""  ADC
 SG_ ARC_OD_MsgCounter_Obj_06_07_RR : 491|4@0+ (1,0) [0|15] ""  ADC
 SG_ ARC_OD_CRC8_Obj_06_07_RR : 511|8@0+ (1,0) [0|256] ""  ADC
 SG_ ARC_OD_AabsY_Obj_06_RR : 48|9@0+ (0.125,-31.875) [-31.875|32] "m/s^2"  ADC
 SG_ ARC_OD_DistXStd_Obj_06_RR : 71|8@0+ (0.05,0) [0|12.75] "m"  ADC
 SG_ ARC_OD_DistYStd_Obj_06_RR : 79|8@0+ (0.1,0) [0|25.5] "m"  ADC
 SG_ ARC_OD_VabsXStd_Obj_06_RR : 87|7@0+ (0.1,0) [0|12.7] "m/s"  ADC
 SG_ ARC_OD_VabsYStd_Obj_06_RR : 80|7@0+ (0.2,0) [0|25.4] "m/s"  ADC
 SG_ ARC_OD_AabsXStd_Obj_06_RR : 89|7@0+ (0.25,0) [0|31.75] "m/s^2"  ADC

BO_ 1107 ARC_OD_04_05_RR: 64 ARC
 SG_ DistHeight_Obj_05_RR : 487|8@0+ (0.2,-10) [-10|41] "m"  ADC
 SG_ DistHeight_Obj_04_RR : 479|8@0+ (0.2,-10) [-10|41] "m"  ADC
 SG_ ARC_OD_DistX_Obj_04_RR : 7|12@0+ (0.1,-152) [-152|257.5] "m"  ADC
 SG_ ARC_OD_Classification_Obj_04_RR : 98|3@0+ (1,0) [0|7] ""  ADC
 SG_ ARC_OD_AabsYStd_Obj_04_RR : 111|8@0+ (0.25,0) [0|63.75] "m/s^2"  ADC
 SG_ ARC_OD_ClassConf_Obj_04_RR : 119|7@0+ (1,0) [0|127] "%"  ADC
 SG_ ARC_OD_ProbOfExist_Obj_04_RR : 112|7@0+ (1,0) [0|127] "%"  ADC
 SG_ ARC_OD_VabsX_Obj_04_RR : 11|11@0+ (0.125,-128) [-128|127.875] "m/s"  ADC
 SG_ ARC_OD_DynProp_Obj_04_RR : 130|3@0+ (1,0) [0|7] ""  ADC
 SG_ ARC_OD_Length_Obj_04_RR : 136|7@0+ (0.2,0) [0|25.4] "m"  ADC
 SG_ ARC_OD_MaintenanceState_Obj_04_R : 145|2@0+ (1,0) [0|3] ""  ADC
 SG_ ARC_OD_Width_Obj_04_RR : 159|7@0+ (0.2,0) [0|25.4] "m"  ADC
 SG_ ARC_OD_RCS_Obj_04_RR : 152|9@0+ (0.2,-51.1) [-51.1|51.1] "dBsm"  ADC
 SG_ ARC_OD_Orientation_Obj_04_RR : 175|10@0+ (0.01,-5.11) [-5.11|5.12] "rad"  ADC
 SG_ ARC_OD_LifeCycle_Obj_04_RR : 207|16@0+ (1,0) [0|65535] ""  ADC
 SG_ ARC_OD_DistX_Obj_05_RR : 223|12@0+ (0.1,-152) [-152|257.5] "m"  ADC
 SG_ ARC_OD_VabsX_Obj_05_RR : 227|11@0+ (0.125,-128) [-128|127.875] "m/s"  ADC
 SG_ ARC_OD_AabsX_Obj_05_RR : 232|9@0+ (0.125,-31.875) [-31.875|32] "m/s^2"  ADC
 SG_ ARC_OD_AabsX_Obj_04_RR : 16|9@0+ (0.125,-31.875) [-31.875|32] "m/s^2"  ADC
 SG_ ARC_OD_DistY_Obj_05_RR : 255|12@0+ (0.0875,-179.113) [-179.113|179.2] "m"  ADC
 SG_ ARC_OD_VabsY_Obj_05_RR : 259|11@0+ (0.125,-128) [-128|127.875] "m/s"  ADC
 SG_ ARC_OD_AabsY_Obj_05_RR : 264|9@0+ (0.125,-31.875) [-31.875|32] "m/s^2"  ADC
 SG_ ARC_OD_DistXStd_Obj_05_RR : 287|8@0+ (0.05,0) [0|12.75] "m"  ADC
 SG_ ARC_OD_DistYStd_Obj_05_RR : 295|8@0+ (0.1,0) [0|25.5] "m"  ADC
 SG_ ARC_OD_VabsXStd_Obj_05_RR : 303|7@0+ (0.1,0) [0|12.7] "m/s"  ADC
 SG_ ARC_OD_VabsYStd_Obj_05_RR : 296|7@0+ (0.2,0) [0|25.4] "m/s"  ADC
 SG_ ARC_OD_AabsXStd_Obj_05_RR : 305|7@0+ (0.25,0) [0|31.75] "m/s^2"  ADC
 SG_ ARC_OD_Classification_Obj_05_RR : 314|3@0+ (1,0) [0|7] ""  ADC
 SG_ ARC_OD_AabsYStd_Obj_05_RR : 327|8@0+ (0.25,0) [0|63.75] "m/s^2"  ADC
 SG_ ARC_OD_ClassConf_Obj_05_RR : 335|7@0+ (1,0) [0|127] "%"  ADC
 SG_ ARC_OD_DistY_Obj_04_RR : 39|12@0+ (0.0875,-179.113) [-179.113|179.2] "m"  ADC
 SG_ ARC_OD_ProbOfExist_Obj_05_RR : 328|7@0+ (1,0) [0|127] "%"  ADC
 SG_ ARC_OD_DynProp_Obj_05_RR : 346|3@0+ (1,0) [0|7] ""  ADC
 SG_ ARC_OD_Length_Obj_05_RR : 352|7@0+ (0.2,0) [0|25.4] "m"  ADC
 SG_ ARC_OD_MaintenanceState_Obj_05_R : 361|2@0+ (1,0) [0|3] ""  ADC
 SG_ ARC_OD_Width_Obj_05_RR : 375|7@0+ (0.2,0) [0|25.4] "m"  ADC
 SG_ ARC_OD_RCS_Obj_05_RR : 368|9@0+ (0.2,-51.1) [-51.1|51.1] "dBsm"  ADC
 SG_ ARC_OD_Orientation_Obj_05_RR : 391|10@0+ (0.01,-5.11) [-5.11|5.12] "rad"  ADC
 SG_ ARC_OD_LifeCycle_Obj_05_RR : 423|16@0+ (1,0) [0|65535] ""  ADC
 SG_ ARC_OD_ObstacleProb_Obj_04_RR : 447|7@0+ (1,0) [0|127] "%"  ADC
 SG_ ARC_OD_ObstacleProb_Obj_05_RR : 455|7@0+ (1,0) [0|127] "%"  ADC
 SG_ ARC_OD_VabsY_Obj_04_RR : 43|11@0+ (0.125,-128) [-128|127.875] "m/s"  ADC
 SG_ ARC_OD_ID_04_RR : 463|8@0+ (1,0) [0|255] ""  ADC
 SG_ ARC_OD_ID_05_RR : 471|8@0+ (1,0) [0|255] ""  ADC
 SG_ ARC_OD_MsgCounter_Obj_04_05_RR : 491|4@0+ (1,0) [0|15] ""  ADC
 SG_ ARC_OD_CRC8_Obj_04_05_RR : 511|8@0+ (1,0) [0|256] ""  ADC
 SG_ ARC_OD_AabsY_Obj_04_RR : 48|9@0+ (0.125,-31.875) [-31.875|32] "m/s^2"  ADC
 SG_ ARC_OD_DistXStd_Obj_04_RR : 71|8@0+ (0.05,0) [0|12.75] "m"  ADC
 SG_ ARC_OD_DistYStd_Obj_04_RR : 79|8@0+ (0.1,0) [0|25.5] "m"  ADC
 SG_ ARC_OD_VabsXStd_Obj_04_RR : 87|7@0+ (0.1,0) [0|12.7] "m/s"  ADC
 SG_ ARC_OD_VabsYStd_Obj_04_RR : 80|7@0+ (0.2,0) [0|25.4] "m/s"  ADC
 SG_ ARC_OD_AabsXStd_Obj_04_RR : 89|7@0+ (0.25,0) [0|31.75] "m/s^2"  ADC

BO_ 1106 ARC_OD_02_03_RR: 64 ARC
 SG_ DistHeight_Obj_03_RR : 487|8@0+ (0.2,-10) [-10|41] "m"  ADC
 SG_ DistHeight_Obj_02_RR : 479|8@0+ (0.2,-10) [-10|41] "m"  ADC
 SG_ ARC_OD_DistX_Obj_02_RR : 7|12@0+ (0.1,-152) [-152|257.5] "m"  ADC
 SG_ ARC_OD_Classification_Obj_02_RR : 98|3@0+ (1,0) [0|7] ""  ADC
 SG_ ARC_OD_AabsYStd_Obj_02_RR : 111|8@0+ (0.25,0) [0|63.75] "m/s^2"  ADC
 SG_ ARC_OD_ClassConf_Obj_02_RR : 119|7@0+ (1,0) [0|127] "%"  ADC
 SG_ ARC_OD_ProbOfExist_Obj_02_RR : 112|7@0+ (1,0) [0|127] "%"  ADC
 SG_ ARC_OD_VabsX_Obj_02_RR : 11|11@0+ (0.125,-128) [-128|127.875] "m/s"  ADC
 SG_ ARC_OD_DynProp_Obj_02_RR : 130|3@0+ (1,0) [0|7] ""  ADC
 SG_ ARC_OD_Length_Obj_02_RR : 136|7@0+ (0.2,0) [0|25.4] "m"  ADC
 SG_ ARC_OD_MaintenanceState_Obj_02_R : 145|2@0+ (1,0) [0|3] ""  ADC
 SG_ ARC_OD_Width_Obj_02_RR : 159|7@0+ (0.2,0) [0|25.4] "m"  ADC
 SG_ ARC_OD_RCS_Obj_02_RR : 152|9@0+ (0.2,-51.1) [-51.1|51.1] "dBsm"  ADC
 SG_ ARC_OD_Orientation_Obj_02_RR : 175|10@0+ (0.01,-5.11) [-5.11|5.12] "rad"  ADC
 SG_ ARC_OD_LifeCycle_Obj_02_RR : 207|16@0+ (1,0) [0|65535] ""  ADC
 SG_ ARC_OD_DistX_Obj_03_RR : 223|12@0+ (0.1,-152) [-152|257.5] "m"  ADC
 SG_ ARC_OD_VabsX_Obj_03_RR : 227|11@0+ (0.125,-128) [-128|127.875] "m/s"  ADC
 SG_ ARC_OD_AabsX_Obj_03_RR : 232|9@0+ (0.125,-31.875) [-31.875|32] "m/s^2"  ADC
 SG_ ARC_OD_AabsX_Obj_02_RR : 16|9@0+ (0.125,-31.875) [-31.875|32] "m/s^2"  ADC
 SG_ ARC_OD_DistY_Obj_03_RR : 255|12@0+ (0.0875,-179.113) [-179.113|179.2] "m"  ADC
 SG_ ARC_OD_VabsY_Obj_03_RR : 259|11@0+ (0.125,-128) [-128|127.875] "m/s"  ADC
 SG_ ARC_OD_AabsY_Obj_03_RR : 264|9@0+ (0.125,-31.875) [-31.875|32] "m/s^2"  ADC
 SG_ ARC_OD_DistXStd_Obj_03_RR : 287|8@0+ (0.05,0) [0|12.75] "m"  ADC
 SG_ ARC_OD_DistYStd_Obj_03_RR : 295|8@0+ (0.1,0) [0|25.5] "m"  ADC
 SG_ ARC_OD_VabsXStd_Obj_03_RR : 303|7@0+ (0.1,0) [0|12.7] "m/s"  ADC
 SG_ ARC_OD_VabsYStd_Obj_03_RR : 296|7@0+ (0.2,0) [0|25.4] "m/s"  ADC
 SG_ ARC_OD_AabsXStd_Obj_03_RR : 305|7@0+ (0.25,0) [0|31.75] "m/s^2"  ADC
 SG_ ARC_OD_Classification_Obj_03_RR : 314|3@0+ (1,0) [0|7] ""  ADC
 SG_ ARC_OD_AabsYStd_Obj_03_RR : 327|8@0+ (0.25,0) [0|63.75] "m/s^2"  ADC
 SG_ ARC_OD_ClassConf_Obj_03_RR : 335|7@0+ (1,0) [0|127] "%"  ADC
 SG_ ARC_OD_DistY_Obj_02_RR : 39|12@0+ (0.0875,-179.113) [-179.113|179.2] "m"  ADC
 SG_ ARC_OD_ProbOfExist_Obj_03_RR : 328|7@0+ (1,0) [0|127] "%"  ADC
 SG_ ARC_OD_DynProp_Obj_03_RR : 346|3@0+ (1,0) [0|7] ""  ADC
 SG_ ARC_OD_Length_Obj_03_RR : 352|7@0+ (0.2,0) [0|25.4] "m"  ADC
 SG_ ARC_OD_MaintenanceState_Obj_03_R : 361|2@0+ (1,0) [0|3] ""  ADC
 SG_ ARC_OD_Width_Obj_03_RR : 375|7@0+ (0.2,0) [0|25.4] "m"  ADC
 SG_ ARC_OD_RCS_Obj_03_RR : 368|9@0+ (0.2,-51.1) [-51.1|51.1] "dBsm"  ADC
 SG_ ARC_OD_Orientation_Obj_03_RR : 391|10@0+ (0.01,-5.11) [-5.11|5.12] "rad"  ADC
 SG_ ARC_OD_LifeCycle_Obj_03_RR : 423|16@0+ (1,0) [0|65535] ""  ADC
 SG_ ARC_OD_ObstacleProb_Obj_02_RR : 447|7@0+ (1,0) [0|127] "%"  ADC
 SG_ ARC_OD_ObstacleProb_Obj_03_RR : 455|7@0+ (1,0) [0|127] "%"  ADC
 SG_ ARC_OD_VabsY_Obj_02_RR : 43|11@0+ (0.125,-128) [-128|127.875] "m/s"  ADC
 SG_ ARC_OD_ID_02_RR : 463|8@0+ (1,0) [0|255] ""  ADC
 SG_ ARC_OD_ID_03_RR : 471|8@0+ (1,0) [0|255] ""  ADC
 SG_ ARC_OD_MsgCounter_Obj_02_03_RR : 491|4@0+ (1,0) [0|15] ""  ADC
 SG_ ARC_OD_CRC8_Obj_02_03_RR : 511|8@0+ (1,0) [0|256] ""  ADC
 SG_ ARC_OD_AabsY_Obj_02_RR : 48|9@0+ (0.125,-31.875) [-31.875|32] "m/s^2"  ADC
 SG_ ARC_OD_DistXStd_Obj_02_RR : 71|8@0+ (0.05,0) [0|12.75] "m"  ADC
 SG_ ARC_OD_DistYStd_Obj_02_RR : 79|8@0+ (0.1,0) [0|25.5] "m"  ADC
 SG_ ARC_OD_VabsXStd_Obj_02_RR : 87|7@0+ (0.1,0) [0|12.7] "m/s"  ADC
 SG_ ARC_OD_VabsYStd_Obj_02_RR : 80|7@0+ (0.2,0) [0|25.4] "m/s"  ADC
 SG_ ARC_OD_AabsXStd_Obj_02_RR : 89|7@0+ (0.25,0) [0|31.75] "m/s^2"  ADC

BO_ 1105 ARC_OD_00_01_RR: 64 ARC
 SG_ DistHeight_Obj_01_RR : 487|8@0+ (0.2,-10) [-10|41] "m"  ADC
 SG_ DistHeight_Obj_00_RR : 479|8@0+ (0.2,-10) [-10|41] "m"  ADC
 SG_ ARC_OD_DistX_Obj_00_RR : 7|12@0+ (0.1,-152) [-152|257.5] "m"  ADC
 SG_ ARC_OD_Classification_Obj_00_RR : 98|3@0+ (1,0) [0|7] ""  ADC
 SG_ ARC_OD_AabsYStd_Obj_00_RR : 111|8@0+ (0.25,0) [0|63.75] "m/s^2"  ADC
 SG_ ARC_OD_ClassConf_Obj_00_RR : 119|7@0+ (1,0) [0|127] "%"  ADC
 SG_ ARC_OD_ProbOfExist_Obj_00_RR : 112|7@0+ (1,0) [0|127] "%"  ADC
 SG_ ARC_OD_VabsX_Obj_00_RR : 11|11@0+ (0.125,-128) [-128|127.875] "m/s"  ADC
 SG_ ARC_OD_DynProp_Obj_00_RR : 130|3@0+ (1,0) [0|7] ""  ADC
 SG_ ARC_OD_Length_Obj_00_RR : 136|7@0+ (0.2,0) [0|25.4] "m"  ADC
 SG_ ARC_OD_MaintenanceState_Obj_00_R : 145|2@0+ (1,0) [0|3] ""  ADC
 SG_ ARC_OD_Width_Obj_00_RR : 159|7@0+ (0.2,0) [0|25.4] "m"  ADC
 SG_ ARC_OD_RCS_Obj_00_RR : 152|9@0+ (0.2,-51.1) [-51.1|51.1] "dBsm"  ADC
 SG_ ARC_OD_Orientation_Obj_00_RR : 175|10@0+ (0.01,-5.11) [-5.11|5.12] "rad"  ADC
 SG_ ARC_OD_LifeCycle_Obj_00_RR : 207|16@0+ (1,0) [0|65535] ""  ADC
 SG_ ARC_OD_DistX_Obj_01_RR : 223|12@0+ (0.1,-152) [-152|257.5] "m"  ADC
 SG_ ARC_OD_VabsX_Obj_01_RR : 227|11@0+ (0.125,-128) [-128|127.875] "m/s"  ADC
 SG_ ARC_OD_AabsX_Obj_01_RR : 232|9@0+ (0.125,-31.875) [-31.875|32] "m/s^2"  ADC
 SG_ ARC_OD_AabsX_Obj_00_RR : 16|9@0+ (0.125,-31.875) [-31.875|32] "m/s^2"  ADC
 SG_ ARC_OD_DistY_Obj_01_RR : 255|12@0+ (0.0875,-179.113) [-179.113|179.2] "m"  ADC
 SG_ ARC_OD_VabsY_Obj_01_RR : 259|11@0+ (0.125,-128) [-128|127.875] "m/s"  ADC
 SG_ ARC_OD_AabsY_Obj_01_RR : 264|9@0+ (0.125,-31.875) [-31.875|32] "m/s^2"  ADC
 SG_ ARC_OD_DistXStd_Obj_01_RR : 287|8@0+ (0.05,0) [0|12.75] "m"  ADC
 SG_ ARC_OD_DistYStd_Obj_01_RR : 295|8@0+ (0.1,0) [0|25.5] "m"  ADC
 SG_ ARC_OD_VabsXStd_Obj_01_RR : 303|7@0+ (0.1,0) [0|12.7] "m/s"  ADC
 SG_ ARC_OD_VabsYStd_Obj_01_RR : 296|7@0+ (0.2,0) [0|25.4] "m/s"  ADC
 SG_ ARC_OD_AabsXStd_Obj_01_RR : 305|7@0+ (0.25,0) [0|31.75] "m/s^2"  ADC
 SG_ ARC_OD_Classification_Obj_01_RR : 314|3@0+ (1,0) [0|7] ""  ADC
 SG_ ARC_OD_AabsYStd_Obj_01_RR : 327|8@0+ (0.25,0) [0|63.75] "m/s^2"  ADC
 SG_ ARC_OD_ClassConf_Obj_01_RR : 335|7@0+ (1,0) [0|127] "%"  ADC
 SG_ ARC_OD_DistY_Obj_00_RR : 39|12@0+ (0.0875,-179.113) [-179.113|179.2] "m"  ADC
 SG_ ARC_OD_ProbOfExist_Obj_01_RR : 328|7@0+ (1,0) [0|127] "%"  ADC
 SG_ ARC_OD_DynProp_Obj_01_RR : 346|3@0+ (1,0) [0|7] ""  ADC
 SG_ ARC_OD_Length_Obj_01_RR : 352|7@0+ (0.2,0) [0|25.4] "m"  ADC
 SG_ ARC_OD_MaintenanceState_Obj_01_R : 361|2@0+ (1,0) [0|3] ""  ADC
 SG_ ARC_OD_Width_Obj_01_RR : 375|7@0+ (0.2,0) [0|25.4] "m"  ADC
 SG_ ARC_OD_RCS_Obj_01_RR : 368|9@0+ (0.2,-51.1) [-51.1|51.1] "dBsm"  ADC
 SG_ ARC_OD_Orientation_Obj_01_RR : 391|10@0+ (0.01,-5.11) [-5.11|5.12] "rad"  ADC
 SG_ ARC_OD_LifeCycle_Obj_01_RR : 423|16@0+ (1,0) [0|65535] ""  ADC
 SG_ ARC_OD_ObstacleProb_Obj_00_RR : 447|7@0+ (1,0) [0|127] "%"  ADC
 SG_ ARC_OD_ObstacleProb_Obj_01_RR : 455|7@0+ (1,0) [0|127] "%"  ADC
 SG_ ARC_OD_VabsY_Obj_00_RR : 43|11@0+ (0.125,-128) [-128|127.875] "m/s"  ADC
 SG_ ARC_OD_ID_00_RR : 463|8@0+ (1,0) [0|255] ""  ADC
 SG_ ARC_OD_ID_01_RR : 471|8@0+ (1,0) [0|255] ""  ADC
 SG_ ARC_OD_MsgCounter_Obj_00_01_RR : 491|4@0+ (1,0) [0|15] ""  ADC
 SG_ ARC_OD_CRC8_Obj_00_01_RR : 511|8@0+ (1,0) [0|255] ""  ADC
 SG_ ARC_OD_AabsY_Obj_00_RR : 48|9@0+ (0.125,-31.875) [-31.875|32] "m/s^2"  ADC
 SG_ ARC_OD_DistXStd_Obj_00_RR : 71|8@0+ (0.05,0) [0|12.75] "m"  ADC
 SG_ ARC_OD_DistYStd_Obj_00_RR : 79|8@0+ (0.1,0) [0|25.5] "m"  ADC
 SG_ ARC_OD_VabsXStd_Obj_00_RR : 87|7@0+ (0.1,0) [0|12.7] "m/s"  ADC
 SG_ ARC_OD_VabsYStd_Obj_00_RR : 80|7@0+ (0.2,0) [0|25.4] "m/s"  ADC
 SG_ ARC_OD_AabsXStd_Obj_00_RR : 89|7@0+ (0.25,0) [0|31.75] "m/s^2"  ADC

BO_ 1616 ARC_OD_Header_FL: 32 ARC
 SG_ ARC_OD_TimeStampGlobSec_FL : 7|32@0+ (1,0) [0|4294970000] "s"  ADC
 SG_ ARC_OD_CycleCounter_FL : 119|16@0+ (1,0) [0|65535] ""  ADC
 SG_ ARC_OD_NumOfObjects_FL : 135|6@0+ (1,0) [0|63] ""  ADC
 SG_ ARC_OD_TaskValidFlag_FL : 129|1@0+ (1,0) [0|1] ""  ADC
 SG_ ARC_OD_ExtendedCycleFlag_FL : 128|1@0+ (1,0) [0|1] ""  ADC
 SG_ ARC_OD_Latency_FL : 143|11@0+ (0.1,0) [0|284.7] "ms"  ADC
 SG_ ARC_OD_MsgCounter_Header_FL : 235|4@0+ (1,0) [0|15] ""  ADC
 SG_ ARC_OD_CRC8_Header_FL : 255|8@0+ (1,0) [0|255] ""  ADC
 SG_ ARC_OD_TimeStampGlobNanoSec_FL : 39|32@0+ (1,0) [0|4294970000] "ns"  ADC
 SG_ ARC_OD_TimeStampLocal_FL : 71|32@0+ (1,0) [0|4294970000] "us"  ADC
 SG_ ARC_OD_MeasCounter_FL : 103|16@0+ (1,0) [0|65535] ""  ADC

BO_ 1360 ARC_OD_Header_FR: 32 ARC
 SG_ ARC_OD_TimeStampGlobSec_FR : 7|32@0+ (1,0) [0|4294970000] "s"  ADC
 SG_ ARC_OD_CycleCounter_FR : 119|16@0+ (1,0) [0|65535] ""  ADC
 SG_ ARC_OD_NumOfObjects_FR : 135|6@0+ (1,0) [0|63] ""  ADC
 SG_ ARC_OD_TaskValidFlag_FR : 129|1@0+ (1,0) [0|1] ""  ADC
 SG_ ARC_OD_ExtendedCycleFlag_FR : 128|1@0+ (1,0) [0|1] ""  ADC
 SG_ ARC_OD_Latency_FR : 143|11@0+ (0.1,0) [0|284.7] "ms"  ADC
 SG_ ARC_OD_MsgCounter_Header_FR : 235|4@0+ (1,0) [0|15] ""  ADC
 SG_ ARC_OD_CRC8_Header_FR : 255|8@0+ (1,0) [0|255] ""  ADC
 SG_ ARC_OD_TimeStampGlobNanoSec_FR : 39|32@0+ (1,0) [0|4294970000] "ns"  ADC
 SG_ ARC_OD_TimeStampLocal_FR : 71|32@0+ (1,0) [0|4294970000] "us"  ADC
 SG_ ARC_OD_MeasCounter_FR : 103|16@0+ (1,0) [0|65535] ""  ADC

BO_ 1104 ARC_OD_Header_RR: 32 ARC
 SG_ ARC_OD_TimeStampGlobSec_RR : 7|32@0+ (1,0) [0|4294970000] "s"  ADC
 SG_ ARC_OD_CycleCounter_RR : 119|16@0+ (1,0) [0|65535] ""  ADC
 SG_ ARC_OD_NumOfObjects_RR : 135|6@0+ (1,0) [0|63] ""  ADC
 SG_ ARC_OD_TaskValidFlag_RR : 129|1@0+ (1,0) [0|1] ""  ADC
 SG_ ARC_OD_ExtendedCycleFlag_RR : 128|1@0+ (1,0) [0|1] ""  ADC
 SG_ ARC_OD_Latency_RR : 143|11@0+ (0.1,0) [0|284.7] "ms"  ADC
 SG_ ARC_OD_MsgCounter_Header_RR : 235|4@0+ (1,0) [0|15] ""  ADC
 SG_ ARC_OD_CRC8_Header_RR : 255|8@0+ (1,0) [0|255] ""  ADC
 SG_ ARC_OD_TimeStampGlobNanoSec_RR : 39|32@0+ (1,0) [0|4294970000] "ns"  ADC
 SG_ ARC_OD_TimeStampLocal_RR : 71|32@0+ (1,0) [0|4294970000] "us"  ADC
 SG_ ARC_OD_MeasCounter_RR : 103|16@0+ (1,0) [0|65535] ""  ADC

BO_ 102 ARC_CONFIG_STATE_FR: 32 ARC
 SG_ ARC_ERROR_STATE_FR : 9|1@0+ (1,0) [0|1] "" Vector__XXX
 SG_ ARC_CFG_Mode_FR : 7|8@0+ (1,0) [0|255] ""  ADC
 SG_ ARC_CFG_TmeSynEnFl_FR : 8|1@0+ (1,0) [0|1] ""  ADC
 SG_ ARC_CONFIG_STATE_FR_RC : 235|4@0+ (1,0) [0|15] ""  ADC
 SG_ ARC_CONFIG_STATE_FR_CRC : 255|8@0+ (1,0) [0|255] ""  ADC

BO_ 105 ARC_CONFIG_STATE_FL: 32 ARC
 SG_ ARC_ERROR_STATE_FL : 9|1@0+ (1,0) [0|1] "" Vector__XXX
 SG_ ARC_CFG_Mode_FL : 7|8@0+ (1,0) [0|255] ""  ADC
 SG_ ARC_CFG_TmeSynEnFl_FL : 8|1@0+ (1,0) [0|1] ""  ADC
 SG_ ARC_CONFIG_STATE_FL_RC : 235|4@0+ (1,0) [0|15] ""  ADC
 SG_ ARC_CONFIG_STATE_FL_CRC : 255|8@0+ (1,0) [0|255] ""  ADC

BO_ 99 ARC_CONFIG_STATE_RR: 32 ARC
 SG_ ARC_ERROR_STATE_RR : 9|1@0+ (1,0) [0|1] "" Vector__XXX
 SG_ ARC_CFG_Mode_RR : 7|8@0+ (1,0) [0|255] ""  ADC
 SG_ ARC_CFG_TmeSynEnFl_RR : 8|1@0+ (1,0) [0|1] ""  ADC
 SG_ ARC_CONFIG_STATE_RR_RC : 235|4@0+ (1,0) [0|15] ""  ADC
 SG_ ARC_CONFIG_STATE_RR_CRC : 255|8@0+ (1,0) [0|255] ""  ADC

BO_ 96 ARC_CONFIG_STATE_RL: 32 ARC
 SG_ ARC_ERROR_STATE_RL : 9|1@0+ (1,0) [0|1] "" Vector__XXX
 SG_ ARC_CFG_Mode_RL : 7|8@0+ (1,0) [0|255] ""  ADC
 SG_ ARC_CFG_TmeSynEnFl_RL : 8|1@0+ (1,0) [0|1] ""  ADC
 SG_ ARC_CONFIG_STATE_RL_RC : 235|4@0+ (1,0) [0|15] ""  ADC
 SG_ ARC_CONFIG_STATE_RL_CRC : 255|8@0+ (1,0) [0|255] ""  ADC

BO_ 848 ARC_OD_Header_RL: 32 ARC
 SG_ ARC_OD_TimeStampGlobSec_RL : 7|32@0+ (1,0) [0|4294970000] "s"  ADC
 SG_ ARC_OD_CycleCounter_RL : 119|16@0+ (1,0) [0|65535] ""  ADC
 SG_ ARC_OD_NumOfObjects_RL : 135|6@0+ (1,0) [0|63] ""  ADC
 SG_ ARC_OD_TaskValidFlag_RL : 129|1@0+ (1,0) [0|1] ""  ADC
 SG_ ARC_OD_ExtendedCycleFlag_RL : 128|1@0+ (1,0) [0|1] ""  ADC
 SG_ ARC_OD_Latency_RL : 143|11@0+ (0.1,0) [0|284.7] "ms"  ADC
 SG_ ARC_OD_MsgCounter_Header_RL : 235|4@0+ (1,0) [0|15] ""  ADC
 SG_ ARC_OD_CRC8_Header_RL : 255|8@0+ (1,0) [0|255] ""  ADC
 SG_ ARC_OD_TimeStampGlobNanoSec_RL : 39|32@0+ (1,0) [0|4294970000] "ns"  ADC
 SG_ ARC_OD_TimeStampLocal_RL : 71|32@0+ (1,0) [0|4294970000] "us"  ADC
 SG_ ARC_OD_MeasCounter_RL : 103|16@0+ (1,0) [0|65535] ""  ADC

BO_ 849 ARC_OD_00_01_RL: 64 ARC
 SG_ DistHeight_Obj_01_RL : 487|8@0+ (0.2,-10) [-10|41] "m"  ADC
 SG_ DistHeight_Obj_00_RL : 479|8@0+ (0.2,-10) [-10|41] "m"  ADC
 SG_ ARC_OD_DistX_Obj_00_RL : 7|12@0+ (0.1,-152) [-152|257.5] "m"  ADC
 SG_ ARC_OD_Classification_Obj_00_RL : 98|3@0+ (1,0) [0|7] ""  ADC
 SG_ ARC_OD_AabsYStd_Obj_00_RL : 111|8@0+ (0.25,0) [0|63.75] "m/s^2"  ADC
 SG_ ARC_OD_ClassConf_Obj_00_RL : 119|7@0+ (1,0) [0|127] "%"  ADC
 SG_ ARC_OD_ProbOfExist_Obj_00_RL : 112|7@0+ (1,0) [0|127] "%"  ADC
 SG_ ARC_OD_VabsX_Obj_00_RL : 11|11@0+ (0.125,-128) [-128|127.875] "m/s"  ADC
 SG_ ARC_OD_DynProp_Obj_00_RL : 130|3@0+ (1,0) [0|7] ""  ADC
 SG_ ARC_OD_Length_Obj_00_RL : 136|7@0+ (0.2,0) [0|25.4] "m"  ADC
 SG_ ARC_OD_MaintenanceState_Obj_0061 : 145|2@0+ (1,0) [0|3] ""  ADC
 SG_ ARC_OD_Width_Obj_00_RL : 159|7@0+ (0.2,0) [0|25.4] "m"  ADC
 SG_ ARC_OD_RCS_Obj_00_RL : 152|9@0+ (0.2,-51.1) [-51.1|51.1] "dBsm"  ADC
 SG_ ARC_OD_Orientation_Obj_00_RL : 175|10@0+ (0.01,-5.11) [-5.11|5.12] "rad"  ADC
 SG_ ARC_OD_LifeCycle_Obj_00_RL : 207|16@0+ (1,0) [0|65535] ""  ADC
 SG_ ARC_OD_DistX_Obj_01_RL : 223|12@0+ (0.1,-152) [-152|257.5] "m"  ADC
 SG_ ARC_OD_VabsX_Obj_01_RL : 227|11@0+ (0.125,-128) [-128|127.875] "m/s"  ADC
 SG_ ARC_OD_AabsX_Obj_01_RL : 232|9@0+ (0.125,-31.875) [-31.875|32] "m/s^2"  ADC
 SG_ ARC_OD_AabsX_Obj_00_RL : 16|9@0+ (0.125,-31.875) [-31.875|32] "m/s^2"  ADC
 SG_ ARC_OD_DistY_Obj_01_RL : 255|12@0+ (0.0875,-179.113) [-179.113|179.2] "m"  ADC
 SG_ ARC_OD_VabsY_Obj_01_RL : 259|11@0+ (0.125,-128) [-128|127.875] "m/s"  ADC
 SG_ ARC_OD_AabsY_Obj_01_RL : 264|9@0+ (0.125,-31.875) [-31.875|32] "m/s^2"  ADC
 SG_ ARC_OD_DistXStd_Obj_01_RL : 287|8@0+ (0.05,0) [0|12.75] "m"  ADC
 SG_ ARC_OD_DistYStd_Obj_01_RL : 295|8@0+ (0.1,0) [0|25.5] "m"  ADC
 SG_ ARC_OD_VabsXStd_Obj_01_RL : 303|7@0+ (0.1,0) [0|12.7] "m/s"  ADC
 SG_ ARC_OD_VabsYStd_Obj_01_RL : 296|7@0+ (0.2,0) [0|25.4] "m/s"  ADC
 SG_ ARC_OD_AabsXStd_Obj_01_RL : 305|7@0+ (0.25,0) [0|31.75] "m/s^2"  ADC
 SG_ ARC_OD_Classification_Obj_01_RL : 314|3@0+ (1,0) [0|7] ""  ADC
 SG_ ARC_OD_AabsYStd_Obj_01_RL : 327|8@0+ (0.25,0) [0|63.75] "m/s^2"  ADC
 SG_ ARC_OD_ClassConf_Obj_01_RL : 335|7@0+ (1,0) [0|127] "%"  ADC
 SG_ ARC_OD_DistY_Obj_00_RL : 39|12@0+ (0.0875,-179.113) [-179.113|179.2] "m"  ADC
 SG_ ARC_OD_ProbOfExist_Obj_01_RL : 328|7@0+ (1,0) [0|127] "%"  ADC
 SG_ ARC_OD_DynProp_Obj_01_RL : 346|3@0+ (1,0) [0|7] ""  ADC
 SG_ ARC_OD_Length_Obj_01_RL : 352|7@0+ (0.2,0) [0|25.4] "m"  ADC
 SG_ ARC_OD_MaintenanceState_Obj_0062 : 361|2@0+ (1,0) [0|3] ""  ADC
 SG_ ARC_OD_Width_Obj_01_RL : 375|7@0+ (0.2,0) [0|25.4] "m"  ADC
 SG_ ARC_OD_RCS_Obj_01_RL : 368|9@0+ (0.2,-51.1) [-51.1|51.1] "dBsm"  ADC
 SG_ ARC_OD_Orientation_Obj_01_RL : 391|10@0+ (0.01,-5.11) [-5.11|5.12] "rad"  ADC
 SG_ ARC_OD_LifeCycle_Obj_01_RL : 423|16@0+ (1,0) [0|65535] ""  ADC
 SG_ ARC_OD_ObstacleProb_Obj_00_RL : 447|7@0+ (1,0) [0|127] "%"  ADC
 SG_ ARC_OD_ObstacleProb_Obj_01_RL : 455|7@0+ (1,0) [0|127] "%"  ADC
 SG_ ARC_OD_VabsY_Obj_00_RL : 43|11@0+ (0.125,-128) [-128|127.875] "m/s"  ADC
 SG_ ARC_OD_ID_00_RL : 463|8@0+ (1,0) [0|255] ""  ADC
 SG_ ARC_OD_ID_01_RL : 471|8@0+ (1,0) [0|255] ""  ADC
 SG_ ARC_OD_MsgCounter_Obj_00_01_RL : 491|4@0+ (1,0) [0|15] ""  ADC
 SG_ ARC_OD_CRC8_Obj_00_01_RL : 511|8@0+ (1,0) [0|255] ""  ADC
 SG_ ARC_OD_AabsY_Obj_00_RL : 48|9@0+ (0.125,-31.875) [-31.875|32] "m/s^2"  ADC
 SG_ ARC_OD_DistXStd_Obj_00_RL : 71|8@0+ (0.05,0) [0|12.75] "m"  ADC
 SG_ ARC_OD_DistYStd_Obj_00_RL : 79|8@0+ (0.1,0) [0|25.5] "m"  ADC
 SG_ ARC_OD_VabsXStd_Obj_00_RL : 87|7@0+ (0.1,0) [0|12.7] "m/s"  ADC
 SG_ ARC_OD_VabsYStd_Obj_00_RL : 80|7@0+ (0.2,0) [0|25.4] "m/s"  ADC
 SG_ ARC_OD_AabsXStd_Obj_00_RL : 89|7@0+ (0.25,0) [0|31.75] "m/s^2"  ADC

BO_ 850 ARC_OD_02_03_RL: 64 ARC
 SG_ DistHeight_Obj_03_RL : 487|8@0+ (0.2,-10) [-10|41] "m"  ADC
 SG_ DistHeight_Obj_02_RL : 479|8@0+ (0.2,-10) [-10|41] "m"  ADC
 SG_ ARC_OD_DistX_Obj_02_RL : 7|12@0+ (0.1,-152) [-152|257.5] "m"  ADC
 SG_ ARC_OD_Classification_Obj_02_RL : 98|3@0+ (1,0) [0|7] ""  ADC
 SG_ ARC_OD_AabsYStd_Obj_02_RL : 111|8@0+ (0.25,0) [0|63.75] "m/s^2"  ADC
 SG_ ARC_OD_ClassConf_Obj_02_RL : 119|7@0+ (1,0) [0|127] "%"  ADC
 SG_ ARC_OD_ProbOfExist_Obj_02_RL : 112|7@0+ (1,0) [0|127] "%"  ADC
 SG_ ARC_OD_VabsX_Obj_02_RL : 11|11@0+ (0.125,-128) [-128|127.875] "m/s"  ADC
 SG_ ARC_OD_DynProp_Obj_02_RL : 130|3@0+ (1,0) [0|7] ""  ADC
 SG_ ARC_OD_Length_Obj_02_RL : 136|7@0+ (0.2,0) [0|25.4] "m"  ADC
 SG_ ARC_OD_MaintenanceState_Obj_0063 : 145|2@0+ (1,0) [0|3] ""  ADC
 SG_ ARC_OD_Width_Obj_02_RL : 159|7@0+ (0.2,0) [0|25.4] "m"  ADC
 SG_ ARC_OD_RCS_Obj_02_RL : 152|9@0+ (0.2,-51.1) [-51.1|51.1] "dBsm"  ADC
 SG_ ARC_OD_Orientation_Obj_02_RL : 175|10@0+ (0.01,-5.11) [-5.11|5.12] "rad"  ADC
 SG_ ARC_OD_LifeCycle_Obj_02_RL : 207|16@0+ (1,0) [0|65535] ""  ADC
 SG_ ARC_OD_DistX_Obj_03_RL : 223|12@0+ (0.1,-152) [-152|257.5] "m"  ADC
 SG_ ARC_OD_VabsX_Obj_03_RL : 227|11@0+ (0.125,-128) [-128|127.875] "m/s"  ADC
 SG_ ARC_OD_AabsX_Obj_03_RL : 232|9@0+ (0.125,-31.875) [-31.875|32] "m/s^2"  ADC
 SG_ ARC_OD_AabsX_Obj_02_RL : 16|9@0+ (0.125,-31.875) [-31.875|32] "m/s^2"  ADC
 SG_ ARC_OD_DistY_Obj_03_RL : 255|12@0+ (0.0875,-179.113) [-179.113|179.2] "m"  ADC
 SG_ ARC_OD_VabsY_Obj_03_RL : 259|11@0+ (0.125,-128) [-128|127.875] "m/s"  ADC
 SG_ ARC_OD_AabsY_Obj_03_RL : 264|9@0+ (0.125,-31.875) [-31.875|32] "m/s^2"  ADC
 SG_ ARC_OD_DistXStd_Obj_03_RL : 287|8@0+ (0.05,0) [0|12.75] "m"  ADC
 SG_ ARC_OD_DistYStd_Obj_03_RL : 295|8@0+ (0.1,0) [0|25.5] "m"  ADC
 SG_ ARC_OD_VabsXStd_Obj_03_RL : 303|7@0+ (0.1,0) [0|12.7] "m/s"  ADC
 SG_ ARC_OD_VabsYStd_Obj_03_RL : 296|7@0+ (0.2,0) [0|25.4] "m/s"  ADC
 SG_ ARC_OD_AabsXStd_Obj_03_RL : 305|7@0+ (0.25,0) [0|31.75] "m/s^2"  ADC
 SG_ ARC_OD_Classification_Obj_03_RL : 314|3@0+ (1,0) [0|7] ""  ADC
 SG_ ARC_OD_AabsYStd_Obj_03_RL : 327|8@0+ (0.25,0) [0|63.75] "m/s^2"  ADC
 SG_ ARC_OD_ClassConf_Obj_03_RL : 335|7@0+ (1,0) [0|127] "%"  ADC
 SG_ ARC_OD_DistY_Obj_02_RL : 39|12@0+ (0.0875,-179.113) [-179.113|179.2] "m"  ADC
 SG_ ARC_OD_ProbOfExist_Obj_03_RL : 328|7@0+ (1,0) [0|127] "%"  ADC
 SG_ ARC_OD_DynProp_Obj_03_RL : 346|3@0+ (1,0) [0|7] ""  ADC
 SG_ ARC_OD_Length_Obj_03_RL : 352|7@0+ (0.2,0) [0|25.4] "m"  ADC
 SG_ ARC_OD_MaintenanceState_Obj_0064 : 361|2@0+ (1,0) [0|3] ""  ADC
 SG_ ARC_OD_Width_Obj_03_RL : 375|7@0+ (0.2,0) [0|25.4] "m"  ADC
 SG_ ARC_OD_RCS_Obj_03_RL : 368|9@0+ (0.2,-51.1) [-51.1|51.1] "dBsm"  ADC
 SG_ ARC_OD_Orientation_Obj_03_RL : 391|10@0+ (0.01,-5.11) [-5.11|5.12] "rad"  ADC
 SG_ ARC_OD_LifeCycle_Obj_03_RL : 423|16@0+ (1,0) [0|65535] ""  ADC
 SG_ ARC_OD_ObstacleProb_Obj_02_RL : 447|7@0+ (1,0) [0|127] "%"  ADC
 SG_ ARC_OD_ObstacleProb_Obj_03_RL : 455|7@0+ (1,0) [0|127] "%"  ADC
 SG_ ARC_OD_VabsY_Obj_02_RL : 43|11@0+ (0.125,-128) [-128|127.875] "m/s"  ADC
 SG_ ARC_OD_ID_02_RL : 463|8@0+ (1,0) [0|255] ""  ADC
 SG_ ARC_OD_ID_03_RL : 471|8@0+ (1,0) [0|255] ""  ADC
 SG_ ARC_OD_MsgCounter_Obj_02_03_RL : 491|4@0+ (1,0) [0|15] ""  ADC
 SG_ ARC_OD_CRC8_Obj_02_03_RL : 511|8@0+ (1,0) [0|255] ""  ADC
 SG_ ARC_OD_AabsY_Obj_02_RL : 48|9@0+ (0.125,-31.875) [-31.875|32] "m/s^2"  ADC
 SG_ ARC_OD_DistXStd_Obj_02_RL : 71|8@0+ (0.05,0) [0|12.75] "m"  ADC
 SG_ ARC_OD_DistYStd_Obj_02_RL : 79|8@0+ (0.1,0) [0|25.5] "m"  ADC
 SG_ ARC_OD_VabsXStd_Obj_02_RL : 87|7@0+ (0.1,0) [0|12.7] "m/s"  ADC
 SG_ ARC_OD_VabsYStd_Obj_02_RL : 80|7@0+ (0.2,0) [0|25.4] "m/s"  ADC
 SG_ ARC_OD_AabsXStd_Obj_02_RL : 89|7@0+ (0.25,0) [0|31.75] "m/s^2"  ADC

BO_ 851 ARC_OD_04_05_RL: 64 ARC
 SG_ DistHeight_Obj_05_RL : 487|8@0+ (0.2,-10) [-10|41] "m"  ADC
 SG_ DistHeight_Obj_04_RL : 479|8@0+ (0.2,-10) [-10|41] "m"  ADC
 SG_ ARC_OD_DistX_Obj_04_RL : 7|12@0+ (0.1,-152) [-152|257.5] "m"  ADC
 SG_ ARC_OD_Classification_Obj_04_RL : 98|3@0+ (1,0) [0|7] ""  ADC
 SG_ ARC_OD_AabsYStd_Obj_04_RL : 111|8@0+ (0.25,0) [0|63.75] "m/s^2"  ADC
 SG_ ARC_OD_ClassConf_Obj_04_RL : 119|7@0+ (1,0) [0|127] "%"  ADC
 SG_ ARC_OD_ProbOfExist_Obj_04_RL : 112|7@0+ (1,0) [0|127] "%"  ADC
 SG_ ARC_OD_VabsX_Obj_04_RL : 11|11@0+ (0.125,-128) [-128|127.875] "m/s"  ADC
 SG_ ARC_OD_DynProp_Obj_04_RL : 130|3@0+ (1,0) [0|7] ""  ADC
 SG_ ARC_OD_Length_Obj_04_RL : 136|7@0+ (0.2,0) [0|25.4] "m"  ADC
 SG_ ARC_OD_MaintenanceState_Obj_0065 : 145|2@0+ (1,0) [0|3] ""  ADC
 SG_ ARC_OD_Width_Obj_04_RL : 159|7@0+ (0.2,0) [0|25.4] "m"  ADC
 SG_ ARC_OD_RCS_Obj_04_RL : 152|9@0+ (0.2,-51.1) [-51.1|51.1] "dBsm"  ADC
 SG_ ARC_OD_Orientation_Obj_04_RL : 175|10@0+ (0.01,-5.11) [-5.11|5.12] "rad"  ADC
 SG_ ARC_OD_LifeCycle_Obj_04_RL : 207|16@0+ (1,0) [0|65535] ""  ADC
 SG_ ARC_OD_DistX_Obj_05_RL : 223|12@0+ (0.1,-152) [-152|257.5] "m"  ADC
 SG_ ARC_OD_VabsX_Obj_05_RL : 227|11@0+ (0.125,-128) [-128|127.875] "m/s"  ADC
 SG_ ARC_OD_AabsX_Obj_05_RL : 232|9@0+ (0.125,-31.875) [-31.875|32] "m/s^2"  ADC
 SG_ ARC_OD_AabsX_Obj_04_RL : 16|9@0+ (0.125,-31.875) [-31.875|32] "m/s^2"  ADC
 SG_ ARC_OD_DistY_Obj_05_RL : 255|12@0+ (0.0875,-179.113) [-179.113|179.2] "m"  ADC
 SG_ ARC_OD_VabsY_Obj_05_RL : 259|11@0+ (0.125,-128) [-128|127.875] "m/s"  ADC
 SG_ ARC_OD_AabsY_Obj_05_RL : 264|9@0+ (0.125,-31.875) [-31.875|32] "m/s^2"  ADC
 SG_ ARC_OD_DistXStd_Obj_05_RL : 287|8@0+ (0.05,0) [0|12.75] "m"  ADC
 SG_ ARC_OD_DistYStd_Obj_05_RL : 295|8@0+ (0.1,0) [0|25.5] "m"  ADC
 SG_ ARC_OD_VabsXStd_Obj_05_RL : 303|7@0+ (0.1,0) [0|12.7] "m/s"  ADC
 SG_ ARC_OD_VabsYStd_Obj_05_RL : 296|7@0+ (0.2,0) [0|25.4] "m/s"  ADC
 SG_ ARC_OD_AabsXStd_Obj_05_RL : 305|7@0+ (0.25,0) [0|31.75] "m/s^2"  ADC
 SG_ ARC_OD_Classification_Obj_05_RL : 314|3@0+ (1,0) [0|7] ""  ADC
 SG_ ARC_OD_AabsYStd_Obj_05_RL : 327|8@0+ (0.25,0) [0|63.75] "m/s^2"  ADC
 SG_ ARC_OD_ClassConf_Obj_05_RL : 335|7@0+ (1,0) [0|127] "%"  ADC
 SG_ ARC_OD_DistY_Obj_04_RL : 39|12@0+ (0.0875,-179.113) [-179.113|179.2] "m"  ADC
 SG_ ARC_OD_ProbOfExist_Obj_05_RL : 328|7@0+ (1,0) [0|127] "%"  ADC
 SG_ ARC_OD_DynProp_Obj_05_RL : 346|3@0+ (1,0) [0|7] ""  ADC
 SG_ ARC_OD_Length_Obj_05_RL : 352|7@0+ (0.2,0) [0|25.4] "m"  ADC
 SG_ ARC_OD_MaintenanceState_Obj_0066 : 361|2@0+ (1,0) [0|3] ""  ADC
 SG_ ARC_OD_Width_Obj_05_RL : 375|7@0+ (0.2,0) [0|25.4] "m"  ADC
 SG_ ARC_OD_RCS_Obj_05_RL : 368|9@0+ (0.2,-51.1) [-51.1|51.1] "dBsm"  ADC
 SG_ ARC_OD_Orientation_Obj_05_RL : 391|10@0+ (0.01,-5.11) [-5.11|5.12] "rad"  ADC
 SG_ ARC_OD_LifeCycle_Obj_05_RL : 423|16@0+ (1,0) [0|65535] ""  ADC
 SG_ ARC_OD_ObstacleProb_Obj_04_RL : 447|7@0+ (1,0) [0|127] "%"  ADC
 SG_ ARC_OD_ObstacleProb_Obj_05_RL : 455|7@0+ (1,0) [0|127] "%"  ADC
 SG_ ARC_OD_VabsY_Obj_04_RL : 43|11@0+ (0.125,-128) [-128|127.875] "m/s"  ADC
 SG_ ARC_OD_ID_04_RL : 463|8@0+ (1,0) [0|255] ""  ADC
 SG_ ARC_OD_ID_05_RL : 471|8@0+ (1,0) [0|255] ""  ADC
 SG_ ARC_OD_MsgCounter_Obj_04_05_RL : 491|4@0+ (1,0) [0|15] ""  ADC
 SG_ ARC_OD_CRC8_Obj_04_05_RL : 511|8@0+ (1,0) [0|256] ""  ADC
 SG_ ARC_OD_AabsY_Obj_04_RL : 48|9@0+ (0.125,-31.875) [-31.875|32] "m/s^2"  ADC
 SG_ ARC_OD_DistXStd_Obj_04_RL : 71|8@0+ (0.05,0) [0|12.75] "m"  ADC
 SG_ ARC_OD_DistYStd_Obj_04_RL : 79|8@0+ (0.1,0) [0|25.5] "m"  ADC
 SG_ ARC_OD_VabsXStd_Obj_04_RL : 87|7@0+ (0.1,0) [0|12.7] "m/s"  ADC
 SG_ ARC_OD_VabsYStd_Obj_04_RL : 80|7@0+ (0.2,0) [0|25.4] "m/s"  ADC
 SG_ ARC_OD_AabsXStd_Obj_04_RL : 89|7@0+ (0.25,0) [0|31.75] "m/s^2"  ADC

BO_ 852 ARC_OD_06_07_RL: 64 ARC
 SG_ DistHeight_Obj_07_RL : 487|8@0+ (0.2,-10) [-10|41] "m"  ADC
 SG_ DistHeight_Obj_06_RL : 479|8@0+ (0.2,-10) [-10|41] "m"  ADC
 SG_ ARC_OD_DistX_Obj_06_RL : 7|12@0+ (0.1,-152) [-152|257.5] "m"  ADC
 SG_ ARC_OD_Classification_Obj_06_RL : 98|3@0+ (1,0) [0|7] ""  ADC
 SG_ ARC_OD_AabsYStd_Obj_06_RL : 111|8@0+ (0.25,0) [0|63.75] "m/s^2"  ADC
 SG_ ARC_OD_ClassConf_Obj_06_RL : 119|7@0+ (1,0) [0|127] "%"  ADC
 SG_ ARC_OD_ProbOfExist_Obj_06_RL : 112|7@0+ (1,0) [0|127] "%"  ADC
 SG_ ARC_OD_VabsX_Obj_06_RL : 11|11@0+ (0.125,-128) [-128|127.875] "m/s"  ADC
 SG_ ARC_OD_DynProp_Obj_06_RL : 130|3@0+ (1,0) [0|7] ""  ADC
 SG_ ARC_OD_Length_Obj_06_RL : 136|7@0+ (0.2,0) [0|25.4] "m"  ADC
 SG_ ARC_OD_MaintenanceState_Obj_0067 : 145|2@0+ (1,0) [0|3] ""  ADC
 SG_ ARC_OD_Width_Obj_06_RL : 159|7@0+ (0.2,0) [0|25.4] "m"  ADC
 SG_ ARC_OD_RCS_Obj_06_RL : 152|9@0+ (0.2,-51.1) [-51.1|51.1] "dBsm"  ADC
 SG_ ARC_OD_Orientation_Obj_06_RL : 175|10@0+ (0.01,-5.11) [-5.11|5.12] "rad"  ADC
 SG_ ARC_OD_LifeCycle_Obj_06_RL : 207|16@0+ (1,0) [0|65535] ""  ADC
 SG_ ARC_OD_DistX_Obj_07_RL : 223|12@0+ (0.1,-152) [-152|257.5] "m"  ADC
 SG_ ARC_OD_VabsX_Obj_07_RL : 227|11@0+ (0.125,-128) [-128|127.875] "m/s"  ADC
 SG_ ARC_OD_AabsX_Obj_07_RL : 232|9@0+ (0.125,-31.875) [-31.875|32] "m/s^2"  ADC
 SG_ ARC_OD_AabsX_Obj_06_RL : 16|9@0+ (0.125,-31.875) [-31.875|32] "m/s^2"  ADC
 SG_ ARC_OD_DistY_Obj_07_RL : 255|12@0+ (0.0875,-179.113) [-179.113|179.2] "m"  ADC
 SG_ ARC_OD_VabsY_Obj_07_RL : 259|11@0+ (0.125,-128) [-128|127.875] "m/s"  ADC
 SG_ ARC_OD_AabsY_Obj_07_RL : 264|9@0+ (0.125,-31.875) [-31.875|32] "m/s^2"  ADC
 SG_ ARC_OD_DistXStd_Obj_07_RL : 287|8@0+ (0.05,0) [0|12.75] "m"  ADC
 SG_ ARC_OD_DistYStd_Obj_07_RL : 295|8@0+ (0.1,0) [0|25.5] "m"  ADC
 SG_ ARC_OD_VabsXStd_Obj_07_RL : 303|7@0+ (0.1,0) [0|12.7] "m/s"  ADC
 SG_ ARC_OD_VabsYStd_Obj_07_RL : 296|7@0+ (0.2,0) [0|25.4] "m/s"  ADC
 SG_ ARC_OD_AabsXStd_Obj_07_RL : 305|7@0+ (0.25,0) [0|31.75] "m/s^2"  ADC
 SG_ ARC_OD_Classification_Obj_07_RL : 314|3@0+ (1,0) [0|7] ""  ADC
 SG_ ARC_OD_AabsYStd_Obj_07_RL : 327|8@0+ (0.25,0) [0|63.75] "m/s^2"  ADC
 SG_ ARC_OD_ClassConf_Obj_07_RL : 335|7@0+ (1,0) [0|127] "%"  ADC
 SG_ ARC_OD_DistY_Obj_06_RL : 39|12@0+ (0.0875,-179.113) [-179.113|179.2] "m"  ADC
 SG_ ARC_OD_ProbOfExist_Obj_07_RL : 328|7@0+ (1,0) [0|127] "%"  ADC
 SG_ ARC_OD_DynProp_Obj_07_RL : 346|3@0+ (1,0) [0|7] ""  ADC
 SG_ ARC_OD_Length_Obj_07_RL : 352|7@0+ (0.2,0) [0|25.4] "m"  ADC
 SG_ ARC_OD_MaintenanceState_Obj_0068 : 361|2@0+ (1,0) [0|3] ""  ADC
 SG_ ARC_OD_Width_Obj_07_RL : 375|7@0+ (0.2,0) [0|25.4] "m"  ADC
 SG_ ARC_OD_RCS_Obj_07_RL : 368|9@0+ (0.2,-51.1) [-51.1|51.1] "dBsm"  ADC
 SG_ ARC_OD_Orientation_Obj_07_RL : 391|10@0+ (0.01,-5.11) [-5.11|5.12] "rad"  ADC
 SG_ ARC_OD_LifeCycle_Obj_07_RL : 423|16@0+ (1,0) [0|65535] ""  ADC
 SG_ ARC_OD_ObstacleProb_Obj_06_RL : 447|7@0+ (1,0) [0|127] "%"  ADC
 SG_ ARC_OD_ObstacleProb_Obj_07_RL : 455|7@0+ (1,0) [0|127] "%"  ADC
 SG_ ARC_OD_VabsY_Obj_06_RL : 43|11@0+ (0.125,-128) [-128|127.875] "m/s"  ADC
 SG_ ARC_OD_ID_06_RL : 463|8@0+ (1,0) [0|255] ""  ADC
 SG_ ARC_OD_ID_07_RL : 471|8@0+ (1,0) [0|255] ""  ADC
 SG_ ARC_OD_MsgCounter_Obj_06_07_RL : 491|4@0+ (1,0) [0|15] ""  ADC
 SG_ ARC_OD_CRC8_Obj_06_07_RL : 511|8@0+ (1,0) [0|256] ""  ADC
 SG_ ARC_OD_AabsY_Obj_06_RL : 48|9@0+ (0.125,-31.875) [-31.875|32] "m/s^2"  ADC
 SG_ ARC_OD_DistXStd_Obj_06_RL : 71|8@0+ (0.05,0) [0|12.75] "m"  ADC
 SG_ ARC_OD_DistYStd_Obj_06_RL : 79|8@0+ (0.1,0) [0|25.5] "m"  ADC
 SG_ ARC_OD_VabsXStd_Obj_06_RL : 87|7@0+ (0.1,0) [0|12.7] "m/s"  ADC
 SG_ ARC_OD_VabsYStd_Obj_06_RL : 80|7@0+ (0.2,0) [0|25.4] "m/s"  ADC
 SG_ ARC_OD_AabsXStd_Obj_06_RL : 89|7@0+ (0.25,0) [0|31.75] "m/s^2"  ADC

BO_ 853 ARC_OD_08_09_RL: 64 ARC
 SG_ DistHeight_Obj_09_RL : 487|8@0+ (0.2,-10) [-10|41] "m"  ADC
 SG_ DistHeight_Obj_08_RL : 479|8@0+ (0.2,-10) [-10|41] "m"  ADC
 SG_ ARC_OD_DistX_Obj_08_RL : 7|12@0+ (0.1,-152) [-152|257.5] "m"  ADC
 SG_ ARC_OD_Classification_Obj_08_RL : 98|3@0+ (1,0) [0|7] ""  ADC
 SG_ ARC_OD_AabsYStd_Obj_08_RL : 111|8@0+ (0.25,0) [0|63.75] "m/s^2"  ADC
 SG_ ARC_OD_ClassConf_Obj_08_RL : 119|7@0+ (1,0) [0|127] "%"  ADC
 SG_ ARC_OD_ProbOfExist_Obj_08_RL : 112|7@0+ (1,0) [0|127] "%"  ADC
 SG_ ARC_OD_VabsX_Obj_08_RL : 11|11@0+ (0.125,-128) [-128|127.875] "m/s"  ADC
 SG_ ARC_OD_DynProp_Obj_08_RL : 130|3@0+ (1,0) [0|7] ""  ADC
 SG_ ARC_OD_Length_Obj_08_RL : 136|7@0+ (0.2,0) [0|25.4] "m"  ADC
 SG_ ARC_OD_MaintenanceState_Obj_0069 : 145|2@0+ (1,0) [0|3] ""  ADC
 SG_ ARC_OD_Width_Obj_08_RL : 159|7@0+ (0.2,0) [0|25.4] "m"  ADC
 SG_ ARC_OD_RCS_Obj_08_RL : 152|9@0+ (0.2,-51.1) [-51.1|51.1] "dBsm"  ADC
 SG_ ARC_OD_Orientation_Obj_08_RL : 175|10@0+ (0.01,-5.11) [-5.11|5.12] "rad"  ADC
 SG_ ARC_OD_LifeCycle_Obj_08_RL : 207|16@0+ (1,0) [0|65535] ""  ADC
 SG_ ARC_OD_DistX_Obj_09_RL : 223|12@0+ (0.1,-152) [-152|257.5] "m"  ADC
 SG_ ARC_OD_VabsX_Obj_09_RL : 227|11@0+ (0.125,-128) [-128|127.875] "m/s"  ADC
 SG_ ARC_OD_AabsX_Obj_09_RL : 232|9@0+ (0.125,-31.875) [-31.875|32] "m/s^2"  ADC
 SG_ ARC_OD_AabsX_Obj_08_RL : 16|9@0+ (0.125,-31.875) [-31.875|32] "m/s^2"  ADC
 SG_ ARC_OD_DistY_Obj_09_RL : 255|12@0+ (0.0875,-179.113) [-179.113|179.2] "m"  ADC
 SG_ ARC_OD_VabsY_Obj_09_RL : 259|11@0+ (0.125,-128) [-128|127.875] "m/s"  ADC
 SG_ ARC_OD_AabsY_Obj_09_RL : 264|9@0+ (0.125,-31.875) [-31.875|32] "m/s^2"  ADC
 SG_ ARC_OD_DistXStd_Obj_09_RL : 287|8@0+ (0.05,0) [0|12.75] "m"  ADC
 SG_ ARC_OD_DistYStd_Obj_09_RL : 295|8@0+ (0.1,0) [0|25.5] "m"  ADC
 SG_ ARC_OD_VabsXStd_Obj_09_RL : 303|7@0+ (0.1,0) [0|12.7] "m/s"  ADC
 SG_ ARC_OD_VabsYStd_Obj_09_RL : 296|7@0+ (0.2,0) [0|25.4] "m/s"  ADC
 SG_ ARC_OD_AabsXStd_Obj_09_RL : 305|7@0+ (0.25,0) [0|31.75] "m/s^2"  ADC
 SG_ ARC_OD_Classification_Obj_09_RL : 314|3@0+ (1,0) [0|7] ""  ADC
 SG_ ARC_OD_AabsYStd_Obj_09_RL : 327|8@0+ (0.25,0) [0|63.75] "m/s^2"  ADC
 SG_ ARC_OD_ClassConf_Obj_09_RL : 335|7@0+ (1,0) [0|127] "%"  ADC
 SG_ ARC_OD_DistY_Obj_08_RL : 39|12@0+ (0.0875,-179.113) [-179.113|179.2] "m"  ADC
 SG_ ARC_OD_ProbOfExist_Obj_09_RL : 328|7@0+ (1,0) [0|127] "%"  ADC
 SG_ ARC_OD_DynProp_Obj_09_RL : 346|3@0+ (1,0) [0|7] ""  ADC
 SG_ ARC_OD_Length_Obj_09_RL : 352|7@0+ (0.2,0) [0|25.4] "m"  ADC
 SG_ ARC_OD_MaintenanceState_Obj_0070 : 361|2@0+ (1,0) [0|3] ""  ADC
 SG_ ARC_OD_Width_Obj_09_RL : 375|7@0+ (0.2,0) [0|25.4] "m"  ADC
 SG_ ARC_OD_RCS_Obj_09_RL : 368|9@0+ (0.2,-51.1) [-51.1|51.1] "dBsm"  ADC
 SG_ ARC_OD_Orientation_Obj_09_RL : 391|10@0+ (0.01,-5.11) [-5.11|5.12] "rad"  ADC
 SG_ ARC_OD_LifeCycle_Obj_09_RL : 423|16@0+ (1,0) [0|65535] ""  ADC
 SG_ ARC_OD_ObstacleProb_Obj_08_RL : 447|7@0+ (1,0) [0|127] "%"  ADC
 SG_ ARC_OD_ObstacleProb_Obj_09_RL : 455|7@0+ (1,0) [0|127] "%"  ADC
 SG_ ARC_OD_VabsY_Obj_08_RL : 43|11@0+ (0.125,-128) [-128|127.875] "m/s"  ADC
 SG_ ARC_OD_ID_08_RL : 463|8@0+ (1,0) [0|255] ""  ADC
 SG_ ARC_OD_ID_09_RL : 471|8@0+ (1,0) [0|255] ""  ADC
 SG_ ARC_OD_MsgCounter_Obj_08_09_RL : 491|4@0+ (1,0) [0|15] ""  ADC
 SG_ ARC_OD_CRC8_Obj_08_09_RL : 511|8@0+ (1,0) [0|256] ""  ADC
 SG_ ARC_OD_AabsY_Obj_08_RL : 48|9@0+ (0.125,-31.875) [-31.875|32] "m/s^2"  ADC
 SG_ ARC_OD_DistXStd_Obj_08_RL : 71|8@0+ (0.05,0) [0|12.75] "m"  ADC
 SG_ ARC_OD_DistYStd_Obj_08_RL : 79|8@0+ (0.1,0) [0|25.5] "m"  ADC
 SG_ ARC_OD_VabsXStd_Obj_08_RL : 87|7@0+ (0.1,0) [0|12.7] "m/s"  ADC
 SG_ ARC_OD_VabsYStd_Obj_08_RL : 80|7@0+ (0.2,0) [0|25.4] "m/s"  ADC
 SG_ ARC_OD_AabsXStd_Obj_08_RL : 89|7@0+ (0.25,0) [0|31.75] "m/s^2"  ADC

BO_ 854 ARC_OD_10_11_RL: 64 ARC
 SG_ DistHeight_Obj_11_RL : 487|8@0+ (0.2,-10) [-10|41] "m"  ADC
 SG_ DistHeight_Obj_10_RL : 479|8@0+ (0.2,-10) [-10|41] "m"  ADC
 SG_ ARC_OD_DistX_Obj_10_RL : 7|12@0+ (0.1,-152) [-152|257.5] "m"  ADC
 SG_ ARC_OD_Classification_Obj_10_RL : 98|3@0+ (1,0) [0|7] ""  ADC
 SG_ ARC_OD_AabsYStd_Obj_10_RL : 111|8@0+ (0.25,0) [0|63.75] "m/s^2"  ADC
 SG_ ARC_OD_ClassConf_Obj_10_RL : 119|7@0+ (1,0) [0|127] "%"  ADC
 SG_ ARC_OD_ProbOfExist_Obj_10_RL : 112|7@0+ (1,0) [0|127] "%"  ADC
 SG_ ARC_OD_VabsX_Obj_10_RL : 11|11@0+ (0.125,-128) [-128|127.875] "m/s"  ADC
 SG_ ARC_OD_DynProp_Obj_10_RL : 130|3@0+ (1,0) [0|7] ""  ADC
 SG_ ARC_OD_Length_Obj_10_RL : 136|7@0+ (0.2,0) [0|25.4] "m"  ADC
 SG_ ARC_OD_MaintenanceState_Obj_0071 : 145|2@0+ (1,0) [0|3] ""  ADC
 SG_ ARC_OD_Width_Obj_10_RL : 159|7@0+ (0.2,0) [0|25.4] "m"  ADC
 SG_ ARC_OD_RCS_Obj_10_RL : 152|9@0+ (0.2,-51.1) [-51.1|51.1] "dBsm"  ADC
 SG_ ARC_OD_Orientation_Obj_10_RL : 175|10@0+ (0.01,-5.11) [-5.11|5.12] "rad"  ADC
 SG_ ARC_OD_LifeCycle_Obj_10_RL : 207|16@0+ (1,0) [0|65535] ""  ADC
 SG_ ARC_OD_DistX_Obj_11_RL : 223|12@0+ (0.1,-152) [-152|257.5] "m"  ADC
 SG_ ARC_OD_VabsX_Obj_11_RL : 227|11@0+ (0.125,-128) [-128|127.875] "m/s"  ADC
 SG_ ARC_OD_AabsX_Obj_11_RL : 232|9@0+ (0.125,-31.875) [-31.875|32] "m/s^2"  ADC
 SG_ ARC_OD_AabsX_Obj_10_RL : 16|9@0+ (0.125,-31.875) [-31.875|32] "m/s^2"  ADC
 SG_ ARC_OD_DistY_Obj_11_RL : 255|12@0+ (0.0875,-179.113) [-179.113|179.2] "m"  ADC
 SG_ ARC_OD_VabsY_Obj_11_RL : 259|11@0+ (0.125,-128) [-128|127.875] "m/s"  ADC
 SG_ ARC_OD_AabsY_Obj_11_RL : 264|9@0+ (0.125,-31.875) [-31.875|32] "m/s^2"  ADC
 SG_ ARC_OD_DistXStd_Obj_11_RL : 287|8@0+ (0.05,0) [0|12.75] "m"  ADC
 SG_ ARC_OD_DistYStd_Obj_11_RL : 295|8@0+ (0.1,0) [0|25.5] "m"  ADC
 SG_ ARC_OD_VabsXStd_Obj_11_RL : 303|7@0+ (0.1,0) [0|12.7] "m/s"  ADC
 SG_ ARC_OD_VabsYStd_Obj_11_RL : 296|7@0+ (0.2,0) [0|25.4] "m/s"  ADC
 SG_ ARC_OD_AabsXStd_Obj_11_RL : 305|7@0+ (0.25,0) [0|31.75] "m/s^2"  ADC
 SG_ ARC_OD_Classification_Obj_11_RL : 314|3@0+ (1,0) [0|7] ""  ADC
 SG_ ARC_OD_AabsYStd_Obj_11_RL : 327|8@0+ (0.25,0) [0|63.75] "m/s^2"  ADC
 SG_ ARC_OD_ClassConf_Obj_11_RL : 335|7@0+ (1,0) [0|127] "%"  ADC
 SG_ ARC_OD_DistY_Obj_10_RL : 39|12@0+ (0.0875,-179.113) [-179.113|179.2] "m"  ADC
 SG_ ARC_OD_ProbOfExist_Obj_11_RL : 328|7@0+ (1,0) [0|127] "%"  ADC
 SG_ ARC_OD_DynProp_Obj_11_RL : 346|3@0+ (1,0) [0|7] ""  ADC
 SG_ ARC_OD_Length_Obj_11_RL : 352|7@0+ (0.2,0) [0|25.4] "m"  ADC
 SG_ ARC_OD_MaintenanceState_Obj_0072 : 361|2@0+ (1,0) [0|3] ""  ADC
 SG_ ARC_OD_Width_Obj_11_RL : 375|7@0+ (0.2,0) [0|25.4] "m"  ADC
 SG_ ARC_OD_RCS_Obj_11_RL : 368|9@0+ (0.2,-51.1) [-51.1|51.1] "dBsm"  ADC
 SG_ ARC_OD_Orientation_Obj_11_RL : 391|10@0+ (0.01,-5.11) [-5.11|5.12] "rad"  ADC
 SG_ ARC_OD_LifeCycle_Obj_11_RL : 423|16@0+ (1,0) [0|65535] ""  ADC
 SG_ ARC_OD_ObstacleProb_Obj_10_RL : 447|7@0+ (1,0) [0|127] "%"  ADC
 SG_ ARC_OD_ObstacleProb_Obj_11_RL : 455|7@0+ (1,0) [0|127] "%"  ADC
 SG_ ARC_OD_VabsY_Obj_10_RL : 43|11@0+ (0.125,-128) [-128|127.875] "m/s"  ADC
 SG_ ARC_OD_ID_10_RL : 463|8@0+ (1,0) [0|255] ""  ADC
 SG_ ARC_OD_ID_11_RL : 471|8@0+ (1,0) [0|255] ""  ADC
 SG_ ARC_OD_MsgCounter_Obj_10_11_RL : 491|4@0+ (1,0) [0|15] ""  ADC
 SG_ ARC_OD_CRC8_Obj_10_11_RL : 511|8@0+ (1,0) [0|256] ""  ADC
 SG_ ARC_OD_AabsY_Obj_10_RL : 48|9@0+ (0.125,-31.875) [-31.875|32] "m/s^2"  ADC
 SG_ ARC_OD_DistXStd_Obj_10_RL : 71|8@0+ (0.05,0) [0|12.75] "m"  ADC
 SG_ ARC_OD_DistYStd_Obj_10_RL : 79|8@0+ (0.1,0) [0|25.5] "m"  ADC
 SG_ ARC_OD_VabsXStd_Obj_10_RL : 87|7@0+ (0.1,0) [0|12.7] "m/s"  ADC
 SG_ ARC_OD_VabsYStd_Obj_10_RL : 80|7@0+ (0.2,0) [0|25.4] "m/s"  ADC
 SG_ ARC_OD_AabsXStd_Obj_10_RL : 89|7@0+ (0.25,0) [0|31.75] "m/s^2"  ADC

BO_ 855 ARC_OD_12_13_RL: 64 ARC
 SG_ DistHeight_Obj_13_RL : 487|8@0+ (0.2,-10) [-10|41] "m"  ADC
 SG_ DistHeight_Obj_12_RL : 479|8@0+ (0.2,-10) [-10|41] "m"  ADC
 SG_ ARC_OD_DistX_Obj_12_RL : 7|12@0+ (0.1,-152) [-152|257.5] "m"  ADC
 SG_ ARC_OD_Classification_Obj_12_RL : 98|3@0+ (1,0) [0|7] ""  ADC
 SG_ ARC_OD_AabsYStd_Obj_12_RL : 111|8@0+ (0.25,0) [0|63.75] "m/s^2"  ADC
 SG_ ARC_OD_ClassConf_Obj_12_RL : 119|7@0+ (1,0) [0|127] "%"  ADC
 SG_ ARC_OD_ProbOfExist_Obj_12_RL : 112|7@0+ (1,0) [0|127] "%"  ADC
 SG_ ARC_OD_VabsX_Obj_12_RL : 11|11@0+ (0.125,-128) [-128|127.875] "m/s"  ADC
 SG_ ARC_OD_DynProp_Obj_12_RL : 130|3@0+ (1,0) [0|7] ""  ADC
 SG_ ARC_OD_Length_Obj_12_RL : 136|7@0+ (0.2,0) [0|25.4] "m"  ADC
 SG_ ARC_OD_MaintenanceState_Obj_0073 : 145|2@0+ (1,0) [0|3] ""  ADC
 SG_ ARC_OD_Width_Obj_12_RL : 159|7@0+ (0.2,0) [0|25.4] "m"  ADC
 SG_ ARC_OD_RCS_Obj_12_RL : 152|9@0+ (0.2,-51.1) [-51.1|51.1] "dBsm"  ADC
 SG_ ARC_OD_Orientation_Obj_12_RL : 175|10@0+ (0.01,-5.11) [-5.11|5.12] "rad"  ADC
 SG_ ARC_OD_LifeCycle_Obj_12_RL : 207|16@0+ (1,0) [0|65535] ""  ADC
 SG_ ARC_OD_DistX_Obj_13_RL : 223|12@0+ (0.1,-152) [-152|257.5] "m"  ADC
 SG_ ARC_OD_VabsX_Obj_13_RL : 227|11@0+ (0.125,-128) [-128|127.875] "m/s"  ADC
 SG_ ARC_OD_AabsX_Obj_13_RL : 232|9@0+ (0.125,-31.875) [-31.875|32] "m/s^2"  ADC
 SG_ ARC_OD_AabsX_Obj_12_RL : 16|9@0+ (0.125,-31.875) [-31.875|32] "m/s^2"  ADC
 SG_ ARC_OD_DistY_Obj_13_RL : 255|12@0+ (0.0875,-179.113) [-179.113|179.2] "m"  ADC
 SG_ ARC_OD_VabsY_Obj_13_RL : 259|11@0+ (0.125,-128) [-128|127.875] "m/s"  ADC
 SG_ ARC_OD_AabsY_Obj_13_RL : 264|9@0+ (0.125,-31.875) [-31.875|32] "m/s^2"  ADC
 SG_ ARC_OD_DistXStd_Obj_13_RL : 287|8@0+ (0.05,0) [0|12.75] "m"  ADC
 SG_ ARC_OD_DistYStd_Obj_13_RL : 295|8@0+ (0.1,0) [0|25.5] "m"  ADC
 SG_ ARC_OD_VabsXStd_Obj_13_RL : 303|7@0+ (0.1,0) [0|12.7] "m/s"  ADC
 SG_ ARC_OD_VabsYStd_Obj_13_RL : 296|7@0+ (0.2,0) [0|25.4] "m/s"  ADC
 SG_ ARC_OD_AabsXStd_Obj_13_RL : 305|7@0+ (0.25,0) [0|31.75] "m/s^2"  ADC
 SG_ ARC_OD_Classification_Obj_13_RL : 314|3@0+ (1,0) [0|7] ""  ADC
 SG_ ARC_OD_AabsYStd_Obj_13_RL : 327|8@0+ (0.25,0) [0|63.75] "m/s^2"  ADC
 SG_ ARC_OD_ClassConf_Obj_13_RL : 335|7@0+ (1,0) [0|127] "%"  ADC
 SG_ ARC_OD_DistY_Obj_12_RL : 39|12@0+ (0.0875,-179.113) [-179.113|179.2] "m"  ADC
 SG_ ARC_OD_ProbOfExist_Obj_13_RL : 328|7@0+ (1,0) [0|127] "%"  ADC
 SG_ ARC_OD_DynProp_Obj_13_RL : 346|3@0+ (1,0) [0|7] ""  ADC
 SG_ ARC_OD_Length_Obj_13_RL : 352|7@0+ (0.2,0) [0|25.4] "m"  ADC
 SG_ ARC_OD_MaintenanceState_Obj_0074 : 361|2@0+ (1,0) [0|3] ""  ADC
 SG_ ARC_OD_Width_Obj_13_RL : 375|7@0+ (0.2,0) [0|25.4] "m"  ADC
 SG_ ARC_OD_RCS_Obj_13_RL : 368|9@0+ (0.2,-51.1) [-51.1|51.1] "dBsm"  ADC
 SG_ ARC_OD_Orientation_Obj_13_RL : 391|10@0+ (0.01,-5.11) [-5.11|5.12] "rad"  ADC
 SG_ ARC_OD_LifeCycle_Obj_13_RL : 423|16@0+ (1,0) [0|65535] ""  ADC
 SG_ ARC_OD_ObstacleProb_Obj_12_RL : 447|7@0+ (1,0) [0|127] "%"  ADC
 SG_ ARC_OD_ObstacleProb_Obj_13_RL : 455|7@0+ (1,0) [0|127] "%"  ADC
 SG_ ARC_OD_VabsY_Obj_12_RL : 43|11@0+ (0.125,-128) [-128|127.875] "m/s"  ADC
 SG_ ARC_OD_ID_12_RL : 463|8@0+ (1,0) [0|255] ""  ADC
 SG_ ARC_OD_ID_13_RL : 471|8@0+ (1,0) [0|255] ""  ADC
 SG_ ARC_OD_MsgCounter_Obj_12_13_RL : 491|4@0+ (1,0) [0|15] ""  ADC
 SG_ ARC_OD_CRC8_Obj_12_13_RL : 511|8@0+ (1,0) [0|256] ""  ADC
 SG_ ARC_OD_AabsY_Obj_12_RL : 48|9@0+ (0.125,-31.875) [-31.875|32] "m/s^2"  ADC
 SG_ ARC_OD_DistXStd_Obj_12_RL : 71|8@0+ (0.05,0) [0|12.75] "m"  ADC
 SG_ ARC_OD_DistYStd_Obj_12_RL : 79|8@0+ (0.1,0) [0|25.5] "m"  ADC
 SG_ ARC_OD_VabsXStd_Obj_12_RL : 87|7@0+ (0.1,0) [0|12.7] "m/s"  ADC
 SG_ ARC_OD_VabsYStd_Obj_12_RL : 80|7@0+ (0.2,0) [0|25.4] "m/s"  ADC
 SG_ ARC_OD_AabsXStd_Obj_12_RL : 89|7@0+ (0.25,0) [0|31.75] "m/s^2"  ADC

BO_ 856 ARC_OD_14_15_RL: 64 ARC
 SG_ DistHeight_Obj_15_RL : 487|8@0+ (0.2,-10) [-10|41] "m"  ADC
 SG_ DistHeight_Obj_14_RL : 479|8@0+ (0.2,-10) [-10|41] "m"  ADC
 SG_ ARC_OD_DistX_Obj_14_RL : 7|12@0+ (0.1,-152) [-152|257.5] "m"  ADC
 SG_ ARC_OD_Classification_Obj_14_RL : 98|3@0+ (1,0) [0|7] ""  ADC
 SG_ ARC_OD_AabsYStd_Obj_14_RL : 111|8@0+ (0.25,0) [0|63.75] "m/s^2"  ADC
 SG_ ARC_OD_ClassConf_Obj_14_RL : 119|7@0+ (1,0) [0|127] "%"  ADC
 SG_ ARC_OD_ProbOfExist_Obj_14_RL : 112|7@0+ (1,0) [0|127] "%"  ADC
 SG_ ARC_OD_VabsX_Obj_14_RL : 11|11@0+ (0.125,-128) [-128|127.875] "m/s"  ADC
 SG_ ARC_OD_DynProp_Obj_14_RL : 130|3@0+ (1,0) [0|7] ""  ADC
 SG_ ARC_OD_Length_Obj_14_RL : 136|7@0+ (0.2,0) [0|25.4] "m"  ADC
 SG_ ARC_OD_MaintenanceState_Obj_0075 : 145|2@0+ (1,0) [0|3] ""  ADC
 SG_ ARC_OD_Width_Obj_14_RL : 159|7@0+ (0.2,0) [0|25.4] "m"  ADC
 SG_ ARC_OD_RCS_Obj_14_RL : 152|9@0+ (0.2,-51.1) [-51.1|51.1] "dBsm"  ADC
 SG_ ARC_OD_Orientation_Obj_14_RL : 175|10@0+ (0.01,-5.11) [-5.11|5.12] "rad"  ADC
 SG_ ARC_OD_LifeCycle_Obj_14_RL : 207|16@0+ (1,0) [0|65535] ""  ADC
 SG_ ARC_OD_DistX_Obj_15_RL : 223|12@0+ (0.1,-152) [-152|257.5] "m"  ADC
 SG_ ARC_OD_VabsX_Obj_15_RL : 227|11@0+ (0.125,-128) [-128|127.875] "m/s"  ADC
 SG_ ARC_OD_AabsX_Obj_15_RL : 232|9@0+ (0.125,-31.875) [-31.875|32] "m/s^2"  ADC
 SG_ ARC_OD_AabsX_Obj_14_RL : 16|9@0+ (0.125,-31.875) [-31.875|32] "m/s^2"  ADC
 SG_ ARC_OD_DistY_Obj_15_RL : 255|12@0+ (0.0875,-179.113) [-179.113|179.2] "m"  ADC
 SG_ ARC_OD_VabsY_Obj_15_RL : 259|11@0+ (0.125,-128) [-128|127.875] "m/s"  ADC
 SG_ ARC_OD_AabsY_Obj_15_RL : 264|9@0+ (0.125,-31.875) [-31.875|32] "m/s^2"  ADC
 SG_ ARC_OD_DistXStd_Obj_15_RL : 287|8@0+ (0.05,0) [0|12.75] "m"  ADC
 SG_ ARC_OD_DistYStd_Obj_15_RL : 295|8@0+ (0.1,0) [0|25.5] "m"  ADC
 SG_ ARC_OD_VabsXStd_Obj_15_RL : 303|7@0+ (0.1,0) [0|12.7] "m/s"  ADC
 SG_ ARC_OD_VabsYStd_Obj_15_RL : 296|7@0+ (0.2,0) [0|25.4] "m/s"  ADC
 SG_ ARC_OD_AabsXStd_Obj_15_RL : 305|7@0+ (0.25,0) [0|31.75] "m/s^2"  ADC
 SG_ ARC_OD_Classification_Obj_15_RL : 314|3@0+ (1,0) [0|7] ""  ADC
 SG_ ARC_OD_AabsYStd_Obj_15_RL : 327|8@0+ (0.25,0) [0|63.75] "m/s^2"  ADC
 SG_ ARC_OD_ClassConf_Obj_15_RL : 335|7@0+ (1,0) [0|127] "%"  ADC
 SG_ ARC_OD_DistY_Obj_14_RL : 39|12@0+ (0.0875,-179.113) [-179.113|179.2] "m"  ADC
 SG_ ARC_OD_ProbOfExist_Obj_15_RL : 328|7@0+ (1,0) [0|127] "%"  ADC
 SG_ ARC_OD_DynProp_Obj_15_RL : 346|3@0+ (1,0) [0|7] ""  ADC
 SG_ ARC_OD_Length_Obj_15_RL : 352|7@0+ (0.2,0) [0|25.4] "m"  ADC
 SG_ ARC_OD_MaintenanceState_Obj_0076 : 361|2@0+ (1,0) [0|3] ""  ADC
 SG_ ARC_OD_Width_Obj_15_RL : 375|7@0+ (0.2,0) [0|25.4] "m"  ADC
 SG_ ARC_OD_RCS_Obj_15_RL : 368|9@0+ (0.2,-51.1) [-51.1|51.1] "dBsm"  ADC
 SG_ ARC_OD_Orientation_Obj_15_RL : 391|10@0+ (0.01,-5.11) [-5.11|5.12] "rad"  ADC
 SG_ ARC_OD_LifeCycle_Obj_15_RL : 423|16@0+ (1,0) [0|65535] ""  ADC
 SG_ ARC_OD_ObstacleProb_Obj_14_RL : 447|7@0+ (1,0) [0|127] "%"  ADC
 SG_ ARC_OD_ObstacleProb_Obj_15_RL : 455|7@0+ (1,0) [0|127] "%"  ADC
 SG_ ARC_OD_VabsY_Obj_14_RL : 43|11@0+ (0.125,-128) [-128|127.875] "m/s"  ADC
 SG_ ARC_OD_ID_14_RL : 463|8@0+ (1,0) [0|255] ""  ADC
 SG_ ARC_OD_ID_15_RL : 471|8@0+ (1,0) [0|255] ""  ADC
 SG_ ARC_OD_MsgCounter_Obj_14_15_RL : 491|4@0+ (1,0) [0|15] ""  ADC
 SG_ ARC_OD_CRC8_Obj_14_15_RL : 511|8@0+ (1,0) [0|256] ""  ADC
 SG_ ARC_OD_AabsY_Obj_14_RL : 48|9@0+ (0.125,-31.875) [-31.875|32] "m/s^2"  ADC
 SG_ ARC_OD_DistXStd_Obj_14_RL : 71|8@0+ (0.05,0) [0|12.75] "m"  ADC
 SG_ ARC_OD_DistYStd_Obj_14_RL : 79|8@0+ (0.1,0) [0|25.5] "m"  ADC
 SG_ ARC_OD_VabsXStd_Obj_14_RL : 87|7@0+ (0.1,0) [0|12.7] "m/s"  ADC
 SG_ ARC_OD_VabsYStd_Obj_14_RL : 80|7@0+ (0.2,0) [0|25.4] "m/s"  ADC
 SG_ ARC_OD_AabsXStd_Obj_14_RL : 89|7@0+ (0.25,0) [0|31.75] "m/s^2"  ADC

BO_ 857 ARC_OD_16_17_RL: 64 ARC
 SG_ DistHeight_Obj_17_RL : 487|8@0+ (0.2,-10) [-10|41] "m"  ADC
 SG_ DistHeight_Obj_16_RL : 479|8@0+ (0.2,-10) [-10|41] "m"  ADC
 SG_ ARC_OD_DistX_Obj_16_RL : 7|12@0+ (0.1,-152) [-152|257.5] "m"  ADC
 SG_ ARC_OD_Classification_Obj_16_RL : 98|3@0+ (1,0) [0|7] ""  ADC
 SG_ ARC_OD_AabsYStd_Obj_16_RL : 111|8@0+ (0.25,0) [0|63.75] "m/s^2"  ADC
 SG_ ARC_OD_ClassConf_Obj_16_RL : 119|7@0+ (1,0) [0|127] "%"  ADC
 SG_ ARC_OD_ProbOfExist_Obj_16_RL : 112|7@0+ (1,0) [0|127] "%"  ADC
 SG_ ARC_OD_VabsX_Obj_16_RL : 11|11@0+ (0.125,-128) [-128|127.875] "m/s"  ADC
 SG_ ARC_OD_DynProp_Obj_16_RL : 130|3@0+ (1,0) [0|7] ""  ADC
 SG_ ARC_OD_Length_Obj_16_RL : 136|7@0+ (0.2,0) [0|25.4] "m"  ADC
 SG_ ARC_OD_MaintenanceState_Obj_0077 : 145|2@0+ (1,0) [0|3] ""  ADC
 SG_ ARC_OD_Width_Obj_16_RL : 159|7@0+ (0.2,0) [0|25.4] "m"  ADC
 SG_ ARC_OD_RCS_Obj_16_RL : 152|9@0+ (0.2,-51.1) [-51.1|51.1] "dBsm"  ADC
 SG_ ARC_OD_Orientation_Obj_16_RL : 175|10@0+ (0.01,-5.11) [-5.11|5.12] "rad"  ADC
 SG_ ARC_OD_LifeCycle_Obj_16_RL : 207|16@0+ (1,0) [0|65535] ""  ADC
 SG_ ARC_OD_DistX_Obj_17_RL : 223|12@0+ (0.1,-152) [-152|257.5] "m"  ADC
 SG_ ARC_OD_VabsX_Obj_17_RL : 227|11@0+ (0.125,-128) [-128|127.875] "m/s"  ADC
 SG_ ARC_OD_AabsX_Obj_17_RL : 232|9@0+ (0.125,-31.875) [-31.875|32] "m/s^2"  ADC
 SG_ ARC_OD_AabsX_Obj_16_RL : 16|9@0+ (0.125,-31.875) [-31.875|32] "m/s^2"  ADC
 SG_ ARC_OD_DistY_Obj_17_RL : 255|12@0+ (0.0875,-179.113) [-179.113|179.2] "m"  ADC
 SG_ ARC_OD_VabsY_Obj_17_RL : 259|11@0+ (0.125,-128) [-128|127.875] "m/s"  ADC
 SG_ ARC_OD_AabsY_Obj_17_RL : 264|9@0+ (0.125,-31.875) [-31.875|32] "m/s^2"  ADC
 SG_ ARC_OD_DistXStd_Obj_17_RL : 287|8@0+ (0.05,0) [0|12.75] "m"  ADC
 SG_ ARC_OD_DistYStd_Obj_17_RL : 295|8@0+ (0.1,0) [0|25.5] "m"  ADC
 SG_ ARC_OD_VabsXStd_Obj_17_RL : 303|7@0+ (0.1,0) [0|12.7] "m/s"  ADC
 SG_ ARC_OD_VabsYStd_Obj_17_RL : 296|7@0+ (0.2,0) [0|25.4] "m/s"  ADC
 SG_ ARC_OD_AabsXStd_Obj_17_RL : 305|7@0+ (0.25,0) [0|31.75] "m/s^2"  ADC
 SG_ ARC_OD_Classification_Obj_17_RL : 314|3@0+ (1,0) [0|7] ""  ADC
 SG_ ARC_OD_AabsYStd_Obj_17_RL : 327|8@0+ (0.25,0) [0|63.75] "m/s^2"  ADC
 SG_ ARC_OD_ClassConf_Obj_17_RL : 335|7@0+ (1,0) [0|127] "%"  ADC
 SG_ ARC_OD_DistY_Obj_16_RL : 39|12@0+ (0.0875,-179.113) [-179.113|179.2] "m"  ADC
 SG_ ARC_OD_ProbOfExist_Obj_17_RL : 328|7@0+ (1,0) [0|127] "%"  ADC
 SG_ ARC_OD_DynProp_Obj_17_RL : 346|3@0+ (1,0) [0|7] ""  ADC
 SG_ ARC_OD_Length_Obj_17_RL : 352|7@0+ (0.2,0) [0|25.4] "m"  ADC
 SG_ ARC_OD_MaintenanceState_Obj_0078 : 361|2@0+ (1,0) [0|3] ""  ADC
 SG_ ARC_OD_Width_Obj_17_RL : 375|7@0+ (0.2,0) [0|25.4] "m"  ADC
 SG_ ARC_OD_RCS_Obj_17_RL : 368|9@0+ (0.2,-51.1) [-51.1|51.1] "dBsm"  ADC
 SG_ ARC_OD_Orientation_Obj_17_RL : 391|10@0+ (0.01,-5.11) [-5.11|5.12] "rad"  ADC
 SG_ ARC_OD_LifeCycle_Obj_17_RL : 423|16@0+ (1,0) [0|65535] ""  ADC
 SG_ ARC_OD_ObstacleProb_Obj_16_RL : 447|7@0+ (1,0) [0|127] "%"  ADC
 SG_ ARC_OD_ObstacleProb_Obj_17_RL : 455|7@0+ (1,0) [0|127] "%"  ADC
 SG_ ARC_OD_VabsY_Obj_16_RL : 43|11@0+ (0.125,-128) [-128|127.875] "m/s"  ADC
 SG_ ARC_OD_ID_16_RL : 463|8@0+ (1,0) [0|255] ""  ADC
 SG_ ARC_OD_ID_17_RL : 471|8@0+ (1,0) [0|255] ""  ADC
 SG_ ARC_OD_MsgCounter_Obj_16_17_RL : 491|4@0+ (1,0) [0|15] ""  ADC
 SG_ ARC_OD_CRC8_Obj_16_17_RL : 511|8@0+ (1,0) [0|256] ""  ADC
 SG_ ARC_OD_AabsY_Obj_16_RL : 48|9@0+ (0.125,-31.875) [-31.875|32] "m/s^2"  ADC
 SG_ ARC_OD_DistXStd_Obj_16_RL : 71|8@0+ (0.05,0) [0|12.75] "m"  ADC
 SG_ ARC_OD_DistYStd_Obj_16_RL : 79|8@0+ (0.1,0) [0|25.5] "m"  ADC
 SG_ ARC_OD_VabsXStd_Obj_16_RL : 87|7@0+ (0.1,0) [0|12.7] "m/s"  ADC
 SG_ ARC_OD_VabsYStd_Obj_16_RL : 80|7@0+ (0.2,0) [0|25.4] "m/s"  ADC
 SG_ ARC_OD_AabsXStd_Obj_16_RL : 89|7@0+ (0.25,0) [0|31.75] "m/s^2"  ADC

BO_ 858 ARC_OD_18_19_RL: 64 ARC
 SG_ DistHeight_Obj_19_RL : 487|8@0+ (0.2,-10) [-10|41] "m"  ADC
 SG_ DistHeight_Obj_18_RL : 479|8@0+ (0.2,-10) [-10|41] "m"  ADC
 SG_ ARC_OD_DistX_Obj_18_RL : 7|12@0+ (0.1,-152) [-152|257.5] "m"  ADC
 SG_ ARC_OD_Classification_Obj_18_RL : 98|3@0+ (1,0) [0|7] ""  ADC
 SG_ ARC_OD_AabsYStd_Obj_18_RL : 111|8@0+ (0.25,0) [0|63.75] "m/s^2"  ADC
 SG_ ARC_OD_ClassConf_Obj_18_RL : 119|7@0+ (1,0) [0|127] "%"  ADC
 SG_ ARC_OD_ProbOfExist_Obj_18_RL : 112|7@0+ (1,0) [0|127] "%"  ADC
 SG_ ARC_OD_VabsX_Obj_18_RL : 11|11@0+ (0.125,-128) [-128|127.875] "m/s"  ADC
 SG_ ARC_OD_DynProp_Obj_18_RL : 130|3@0+ (1,0) [0|7] ""  ADC
 SG_ ARC_OD_Length_Obj_18_RL : 136|7@0+ (0.2,0) [0|25.4] "m"  ADC
 SG_ ARC_OD_MaintenanceState_Obj_0079 : 145|2@0+ (1,0) [0|3] ""  ADC
 SG_ ARC_OD_Width_Obj_18_RL : 159|7@0+ (0.2,0) [0|25.4] "m"  ADC
 SG_ ARC_OD_RCS_Obj_18_RL : 152|9@0+ (0.2,-51.1) [-51.1|51.1] "dBsm"  ADC
 SG_ ARC_OD_Orientation_Obj_18_RL : 175|10@0+ (0.01,-5.11) [-5.11|5.12] "rad"  ADC
 SG_ ARC_OD_LifeCycle_Obj_18_RL : 207|16@0+ (1,0) [0|65535] ""  ADC
 SG_ ARC_OD_DistX_Obj_19_RL : 223|12@0+ (0.1,-152) [-152|257.5] "m"  ADC
 SG_ ARC_OD_VabsX_Obj_19_RL : 227|11@0+ (0.125,-128) [-128|127.875] "m/s"  ADC
 SG_ ARC_OD_AabsX_Obj_19_RL : 232|9@0+ (0.125,-31.875) [-31.875|32] "m/s^2"  ADC
 SG_ ARC_OD_AabsX_Obj_18_RL : 16|9@0+ (0.125,-31.875) [-31.875|32] "m/s^2"  ADC
 SG_ ARC_OD_DistY_Obj_19_RL : 255|12@0+ (0.0875,-179.113) [-179.113|179.2] "m"  ADC
 SG_ ARC_OD_VabsY_Obj_19_RL : 259|11@0+ (0.125,-128) [-128|127.875] "m/s"  ADC
 SG_ ARC_OD_AabsY_Obj_19_RL : 264|9@0+ (0.125,-31.875) [-31.875|32] "m/s^2"  ADC
 SG_ ARC_OD_DistXStd_Obj_19_RL : 287|8@0+ (0.05,0) [0|12.75] "m"  ADC
 SG_ ARC_OD_DistYStd_Obj_19_RL : 295|8@0+ (0.1,0) [0|25.5] "m"  ADC
 SG_ ARC_OD_VabsXStd_Obj_19_RL : 303|7@0+ (0.1,0) [0|12.7] "m/s"  ADC
 SG_ ARC_OD_VabsYStd_Obj_19_RL : 296|7@0+ (0.2,0) [0|25.4] "m/s"  ADC
 SG_ ARC_OD_AabsXStd_Obj_19_RL : 305|7@0+ (0.25,0) [0|31.75] "m/s^2"  ADC
 SG_ ARC_OD_Classification_Obj_19_RL : 314|3@0+ (1,0) [0|7] ""  ADC
 SG_ ARC_OD_AabsYStd_Obj_19_RL : 327|8@0+ (0.25,0) [0|63.75] "m/s^2"  ADC
 SG_ ARC_OD_ClassConf_Obj_19_RL : 335|7@0+ (1,0) [0|127] "%"  ADC
 SG_ ARC_OD_DistY_Obj_18_RL : 39|12@0+ (0.0875,-179.113) [-179.113|179.2] "m"  ADC
 SG_ ARC_OD_ProbOfExist_Obj_19_RL : 328|7@0+ (1,0) [0|127] "%"  ADC
 SG_ ARC_OD_DynProp_Obj_19_RL : 346|3@0+ (1,0) [0|7] ""  ADC
 SG_ ARC_OD_Length_Obj_19_RL : 352|7@0+ (0.2,0) [0|25.4] "m"  ADC
 SG_ ARC_OD_MaintenanceState_Obj_0080 : 361|2@0+ (1,0) [0|3] ""  ADC
 SG_ ARC_OD_Width_Obj_19_RL : 375|7@0+ (0.2,0) [0|25.4] "m"  ADC
 SG_ ARC_OD_RCS_Obj_19_RL : 368|9@0+ (0.2,-51.1) [-51.1|51.1] "dBsm"  ADC
 SG_ ARC_OD_Orientation_Obj_19_RL : 391|10@0+ (0.01,-5.11) [-5.11|5.12] "rad"  ADC
 SG_ ARC_OD_LifeCycle_Obj_19_RL : 423|16@0+ (1,0) [0|65535] ""  ADC
 SG_ ARC_OD_ObstacleProb_Obj_18_RL : 447|7@0+ (1,0) [0|127] "%"  ADC
 SG_ ARC_OD_ObstacleProb_Obj_19_RL : 455|7@0+ (1,0) [0|127] "%"  ADC
 SG_ ARC_OD_VabsY_Obj_18_RL : 43|11@0+ (0.125,-128) [-128|127.875] "m/s"  ADC
 SG_ ARC_OD_ID_18_RL : 463|8@0+ (1,0) [0|255] ""  ADC
 SG_ ARC_OD_ID_19_RL : 471|8@0+ (1,0) [0|255] ""  ADC
 SG_ ARC_OD_MsgCounter_Obj_18_19_RL : 491|4@0+ (1,0) [0|15] ""  ADC
 SG_ ARC_OD_CRC8_Obj_18_19_RL : 511|8@0+ (1,0) [0|256] ""  ADC
 SG_ ARC_OD_AabsY_Obj_18_RL : 48|9@0+ (0.125,-31.875) [-31.875|32] "m/s^2"  ADC
 SG_ ARC_OD_DistXStd_Obj_18_RL : 71|8@0+ (0.05,0) [0|12.75] "m"  ADC
 SG_ ARC_OD_DistYStd_Obj_18_RL : 79|8@0+ (0.1,0) [0|25.5] "m"  ADC
 SG_ ARC_OD_VabsXStd_Obj_18_RL : 87|7@0+ (0.1,0) [0|12.7] "m/s"  ADC
 SG_ ARC_OD_VabsYStd_Obj_18_RL : 80|7@0+ (0.2,0) [0|25.4] "m/s"  ADC
 SG_ ARC_OD_AabsXStd_Obj_18_RL : 89|7@0+ (0.25,0) [0|31.75] "m/s^2"  ADC

BO_ 859 ARC_OD_20_21_RL: 64 ARC
 SG_ DistHeight_Obj_21_RL : 487|8@0+ (0.2,-10) [-10|41] "m"  ADC
 SG_ DistHeight_Obj_20_RL : 479|8@0+ (0.2,-10) [-10|41] "m"  ADC
 SG_ ARC_OD_DistX_Obj_20_RL : 7|12@0+ (0.1,-152) [-152|257.5] "m"  ADC
 SG_ ARC_OD_Classification_Obj_20_RL : 98|3@0+ (1,0) [0|7] ""  ADC
 SG_ ARC_OD_AabsYStd_Obj_20_RL : 111|8@0+ (0.25,0) [0|63.75] "m/s^2"  ADC
 SG_ ARC_OD_ClassConf_Obj_20_RL : 119|7@0+ (1,0) [0|127] "%"  ADC
 SG_ ARC_OD_ProbOfExist_Obj_20_RL : 112|7@0+ (1,0) [0|127] "%"  ADC
 SG_ ARC_OD_VabsX_Obj_20_RL : 11|11@0+ (0.125,-128) [-128|127.875] "m/s"  ADC
 SG_ ARC_OD_DynProp_Obj_20_RL : 130|3@0+ (1,0) [0|7] ""  ADC
 SG_ ARC_OD_Length_Obj_20_RL : 136|7@0+ (0.2,0) [0|25.4] "m"  ADC
 SG_ ARC_OD_MaintenanceState_Obj_0081 : 145|2@0+ (1,0) [0|3] ""  ADC
 SG_ ARC_OD_Width_Obj_20_RL : 159|7@0+ (0.2,0) [0|25.4] "m"  ADC
 SG_ ARC_OD_RCS_Obj_20_RL : 152|9@0+ (0.2,-51.1) [-51.1|51.1] "dBsm"  ADC
 SG_ ARC_OD_Orientation_Obj_20_RL : 175|10@0+ (0.01,-5.11) [-5.11|5.12] "rad"  ADC
 SG_ ARC_OD_LifeCycle_Obj_20_RL : 207|16@0+ (1,0) [0|65535] ""  ADC
 SG_ ARC_OD_DistX_Obj_21_RL : 223|12@0+ (0.1,-152) [-152|257.5] "m"  ADC
 SG_ ARC_OD_VabsX_Obj_21_RL : 227|11@0+ (0.125,-128) [-128|127.875] "m/s"  ADC
 SG_ ARC_OD_AabsX_Obj_21_RL : 232|9@0+ (0.125,-31.875) [-31.875|32] "m/s^2"  ADC
 SG_ ARC_OD_AabsX_Obj_20_RL : 16|9@0+ (0.125,-31.875) [-31.875|32] "m/s^2"  ADC
 SG_ ARC_OD_DistY_Obj_21_RL : 255|12@0+ (0.0875,-179.113) [-179.113|179.2] "m"  ADC
 SG_ ARC_OD_VabsY_Obj_21_RL : 259|11@0+ (0.125,-128) [-128|127.875] "m/s"  ADC
 SG_ ARC_OD_AabsY_Obj_21_RL : 264|9@0+ (0.125,-31.875) [-31.875|32] "m/s^2"  ADC
 SG_ ARC_OD_DistXStd_Obj_21_RL : 287|8@0+ (0.05,0) [0|12.75] "m"  ADC
 SG_ ARC_OD_DistYStd_Obj_21_RL : 295|8@0+ (0.1,0) [0|25.5] "m"  ADC
 SG_ ARC_OD_VabsXStd_Obj_21_RL : 303|7@0+ (0.1,0) [0|12.7] "m/s"  ADC
 SG_ ARC_OD_VabsYStd_Obj_21_RL : 296|7@0+ (0.2,0) [0|25.4] "m/s"  ADC
 SG_ ARC_OD_AabsXStd_Obj_21_RL : 305|7@0+ (0.25,0) [0|31.75] "m/s^2"  ADC
 SG_ ARC_OD_Classification_Obj_21_RL : 314|3@0+ (1,0) [0|7] ""  ADC
 SG_ ARC_OD_AabsYStd_Obj_21_RL : 327|8@0+ (0.25,0) [0|63.75] "m/s^2"  ADC
 SG_ ARC_OD_ClassConf_Obj_21_RL : 335|7@0+ (1,0) [0|127] "%"  ADC
 SG_ ARC_OD_DistY_Obj_20_RL : 39|12@0+ (0.0875,-179.113) [-179.113|179.2] "m"  ADC
 SG_ ARC_OD_ProbOfExist_Obj_21_RL : 328|7@0+ (1,0) [0|127] "%"  ADC
 SG_ ARC_OD_DynProp_Obj_21_RL : 346|3@0+ (1,0) [0|7] ""  ADC
 SG_ ARC_OD_Length_Obj_21_RL : 352|7@0+ (0.2,0) [0|25.4] "m"  ADC
 SG_ ARC_OD_MaintenanceState_Obj_0082 : 361|2@0+ (1,0) [0|3] ""  ADC
 SG_ ARC_OD_Width_Obj_21_RL : 375|7@0+ (0.2,0) [0|25.4] "m"  ADC
 SG_ ARC_OD_RCS_Obj_21_RL : 368|9@0+ (0.2,-51.1) [-51.1|51.1] "dBsm"  ADC
 SG_ ARC_OD_Orientation_Obj_21_RL : 391|10@0+ (0.01,-5.11) [-5.11|5.12] "rad"  ADC
 SG_ ARC_OD_LifeCycle_Obj_21_RL : 423|16@0+ (1,0) [0|65535] ""  ADC
 SG_ ARC_OD_ObstacleProb_Obj_20_RL : 447|7@0+ (1,0) [0|127] "%"  ADC
 SG_ ARC_OD_ObstacleProb_Obj_21_RL : 455|7@0+ (1,0) [0|127] "%"  ADC
 SG_ ARC_OD_VabsY_Obj_20_RL : 43|11@0+ (0.125,-128) [-128|127.875] "m/s"  ADC
 SG_ ARC_OD_ID_20_RL : 463|8@0+ (1,0) [0|255] ""  ADC
 SG_ ARC_OD_ID_21_RL : 471|8@0+ (1,0) [0|255] ""  ADC
 SG_ ARC_OD_MsgCounter_Obj_20_21_RL : 491|4@0+ (1,0) [0|15] ""  ADC
 SG_ ARC_OD_CRC8_Obj_20_21_RL : 511|8@0+ (1,0) [0|256] ""  ADC
 SG_ ARC_OD_AabsY_Obj_20_RL : 48|9@0+ (0.125,-31.875) [-31.875|32] "m/s^2"  ADC
 SG_ ARC_OD_DistXStd_Obj_20_RL : 71|8@0+ (0.05,0) [0|12.75] "m"  ADC
 SG_ ARC_OD_DistYStd_Obj_20_RL : 79|8@0+ (0.1,0) [0|25.5] "m"  ADC
 SG_ ARC_OD_VabsXStd_Obj_20_RL : 87|7@0+ (0.1,0) [0|12.7] "m/s"  ADC
 SG_ ARC_OD_VabsYStd_Obj_20_RL : 80|7@0+ (0.2,0) [0|25.4] "m/s"  ADC
 SG_ ARC_OD_AabsXStd_Obj_20_RL : 89|7@0+ (0.25,0) [0|31.75] "m/s^2"  ADC

CM_ SG_ 1112 ARC_OD_DistX_Obj_14_RR "Longitudinal distance of object_14
00????????";
CM_ SG_ 1112 ARC_OD_Classification_Obj_14_RR "Classification of object_14
00??????";
CM_ SG_ 1112 ARC_OD_AabsYStd_Obj_14_RR "Lateral absolution acceleration standard deviation of object_14
00????????????????";
CM_ SG_ 1112 ARC_OD_ClassConf_Obj_14_RR "Classification confidence of object_14
00?????????";
CM_ SG_ 1112 ARC_OD_ProbOfExist_Obj_14_RR "Existence probability of object_14
00????????";
CM_ SG_ 1112 ARC_OD_VabsX_Obj_14_RR "Longitudinal absolution velocity over ground of object_14
00????????????";
CM_ SG_ 1112 ARC_OD_DynProp_Obj_14_RR "Dynamic property of object_14
00????????";
CM_ SG_ 1112 ARC_OD_Length_Obj_14_RR "Length of object_14
00??????";
CM_ SG_ 1112 ARC_OD_MaintenanceState_Obj_14_R "Maintenance state of object_14
00????????";
CM_ SG_ 1112 ARC_OD_Width_Obj_14_RR "Width of object_14
00??????";
CM_ SG_ 1112 ARC_OD_RCS_Obj_14_RR "RCS of object_14
00?????????";
CM_ SG_ 1112 ARC_OD_Orientation_Obj_14_RR "Orientation of object_14
00???????";
CM_ SG_ 1112 ARC_OD_LifeCycle_Obj_14_RR "Life cycle of object_14
00????????";
CM_ SG_ 1112 ARC_OD_AabsX_Obj_14_RR "Longitudinal absolution acceleration over ground of object_14
00?????????????";
CM_ SG_ 1112 ARC_OD_DistY_Obj_14_RR "Lateral distance of object_14
00????????";
CM_ SG_ 1112 ARC_OD_ObstacleProb_Obj_14_RR "Obstacle probability of object_14
00?????????";
CM_ SG_ 1112 ARC_OD_VabsY_Obj_14_RR "Lateral absolution velocity over ground of object_14
00????????????";
CM_ SG_ 1112 ARC_OD_AabsY_Obj_14_RR "Lateral absolution acceleration over ground of object_14
00?????????????";
CM_ SG_ 1112 ARC_OD_DistXStd_Obj_14_RR "Longitudinal distance standard deviation of object_14
00???????????";
CM_ SG_ 1112 ARC_OD_DistYStd_Obj_14_RR "Lateral distance standard deviation of object_14
00???????????";
CM_ SG_ 1112 ARC_OD_VabsXStd_Obj_14_RR "Longitudinal absolution velocity standard deviation of object_14
00???????????????";
CM_ SG_ 1112 ARC_OD_VabsYStd_Obj_14_RR "Lateral absolution velocity standard deviation of object_14
00???????????????";
CM_ SG_ 1112 ARC_OD_AabsXStd_Obj_14_RR "Longitudinal absolution acceleration standard deviation of object_14
00????????????????";
CM_ SG_ 1111 ARC_OD_DistX_Obj_12_RR "Longitudinal distance of object_12
00????????";
CM_ SG_ 1111 ARC_OD_Classification_Obj_12_RR "Classification of object_12
00??????";
CM_ SG_ 1111 ARC_OD_AabsYStd_Obj_12_RR "Lateral absolution acceleration standard deviation of object_12
00????????????????";
CM_ SG_ 1111 ARC_OD_ClassConf_Obj_12_RR "Classification confidence of object_12
00?????????";
CM_ SG_ 1111 ARC_OD_ProbOfExist_Obj_12_RR "Existence probability of object_12
00????????";
CM_ SG_ 1111 ARC_OD_VabsX_Obj_12_RR "Longitudinal absolution velocity over ground of object_12
00????????????";
CM_ SG_ 1111 ARC_OD_DynProp_Obj_12_RR "Dynamic property of object_12
00????????";
CM_ SG_ 1111 ARC_OD_Length_Obj_12_RR "Length of object_12
00??????";
CM_ SG_ 1111 ARC_OD_MaintenanceState_Obj_12_R "Maintenance state of object_12
00????????";
CM_ SG_ 1111 ARC_OD_Width_Obj_12_RR "Width of object_12
00??????";
CM_ SG_ 1111 ARC_OD_RCS_Obj_12_RR "RCS of object_12
00?????????";
CM_ SG_ 1111 ARC_OD_Orientation_Obj_12_RR "Orientation of object_12
00???????";
CM_ SG_ 1111 ARC_OD_LifeCycle_Obj_12_RR "Life cycle of object_12
00????????";
CM_ SG_ 1111 ARC_OD_AabsX_Obj_12_RR "Longitudinal absolution acceleration over ground of object_12
00?????????????";
CM_ SG_ 1111 ARC_OD_DistY_Obj_12_RR "Lateral distance of object_12
00????????";
CM_ SG_ 1111 ARC_OD_ObstacleProb_Obj_12_RR "Obstacle probability of object_12
00?????????";
CM_ SG_ 1111 ARC_OD_VabsY_Obj_12_RR "Lateral absolution velocity over ground of object_12
00????????????";
CM_ SG_ 1111 ARC_OD_AabsY_Obj_12_RR "Lateral absolution acceleration over ground of object_12
00?????????????";
CM_ SG_ 1111 ARC_OD_DistXStd_Obj_12_RR "Longitudinal distance standard deviation of object_12
00???????????";
CM_ SG_ 1111 ARC_OD_DistYStd_Obj_12_RR "Lateral distance standard deviation of object_12
00???????????";
CM_ SG_ 1111 ARC_OD_VabsXStd_Obj_12_RR "Longitudinal absolution velocity standard deviation of object_12
00???????????????";
CM_ SG_ 1111 ARC_OD_VabsYStd_Obj_12_RR "Lateral absolution velocity standard deviation of object_12
00???????????????";
CM_ SG_ 1111 ARC_OD_AabsXStd_Obj_12_RR "Longitudinal absolution acceleration standard deviation of object_12
00????????????????";
CM_ SG_ 1110 ARC_OD_DistX_Obj_10_RR "Longitudinal distance of object_10
00????????";
CM_ SG_ 1110 ARC_OD_Classification_Obj_10_RR "Classification of object_10
00??????";
CM_ SG_ 1110 ARC_OD_AabsYStd_Obj_10_RR "Lateral absolution acceleration standard deviation of object_10
00????????????????";
CM_ SG_ 1110 ARC_OD_ClassConf_Obj_10_RR "Classification confidence of object_10
00?????????";
CM_ SG_ 1110 ARC_OD_ProbOfExist_Obj_10_RR "Existence probability of object_10
00????????";
CM_ SG_ 1110 ARC_OD_VabsX_Obj_10_RR "Longitudinal absolution velocity over ground of object_10
00????????????";
CM_ SG_ 1110 ARC_OD_DynProp_Obj_10_RR "Dynamic property of object_10
00????????";
CM_ SG_ 1110 ARC_OD_Length_Obj_10_RR "Length of object_10
00??????";
CM_ SG_ 1110 ARC_OD_MaintenanceState_Obj_10_R "Maintenance state of object_10
00????????";
CM_ SG_ 1110 ARC_OD_Width_Obj_10_RR "Width of object_10
00??????";
CM_ SG_ 1110 ARC_OD_RCS_Obj_10_RR "RCS of object_10
00?????????";
CM_ SG_ 1110 ARC_OD_Orientation_Obj_10_RR "Orientation of object_10
00???????";
CM_ SG_ 1110 ARC_OD_LifeCycle_Obj_10_RR "Life cycle of object_10
00????????";
CM_ SG_ 1110 ARC_OD_AabsX_Obj_10_RR "Longitudinal absolution acceleration over ground of object_10
00?????????????";
CM_ SG_ 1110 ARC_OD_DistY_Obj_10_RR "Lateral distance of object_10
00????????";
CM_ SG_ 1110 ARC_OD_ObstacleProb_Obj_10_RR "Obstacle probability of object_10
00?????????";
CM_ SG_ 1110 ARC_OD_VabsY_Obj_10_RR "Lateral absolution velocity over ground of object_10
00????????????";
CM_ SG_ 1110 ARC_OD_AabsY_Obj_10_RR "Lateral absolution acceleration over ground of object_10
00?????????????";
CM_ SG_ 1110 ARC_OD_DistXStd_Obj_10_RR "Longitudinal distance standard deviation of object_10
00???????????";
CM_ SG_ 1110 ARC_OD_DistYStd_Obj_10_RR "Lateral distance standard deviation of object_10
00???????????";
CM_ SG_ 1110 ARC_OD_VabsXStd_Obj_10_RR "Longitudinal absolution velocity standard deviation of object_10
00???????????????";
CM_ SG_ 1110 ARC_OD_VabsYStd_Obj_10_RR "Lateral absolution velocity standard deviation of object_10
00???????????????";
CM_ SG_ 1110 ARC_OD_AabsXStd_Obj_10_RR "Longitudinal absolution acceleration standard deviation of object_10
00????????????????";
CM_ SG_ 1109 ARC_OD_DistX_Obj_08_RR "Longitudinal distance of object_08
00????????";
CM_ SG_ 1109 ARC_OD_Classification_Obj_08_RR "Classification of object_08
00??????";
CM_ SG_ 1109 ARC_OD_AabsYStd_Obj_08_RR "Lateral absolution acceleration standard deviation of object_08
00????????????????";
CM_ SG_ 1109 ARC_OD_ClassConf_Obj_08_RR "Classification confidence of object_08
00?????????";
CM_ SG_ 1109 ARC_OD_ProbOfExist_Obj_08_RR "Existence probability of object_08
00????????";
CM_ SG_ 1109 ARC_OD_VabsX_Obj_08_RR "Longitudinal absolution velocity over ground of object_08
00????????????";
CM_ SG_ 1109 ARC_OD_DynProp_Obj_08_RR "Dynamic property of object_08
00????????";
CM_ SG_ 1109 ARC_OD_Length_Obj_08_RR "Length of object_08
00??????";
CM_ SG_ 1109 ARC_OD_MaintenanceState_Obj_08_R "Maintenance state of object_08
00????????";
CM_ SG_ 1109 ARC_OD_Width_Obj_08_RR "Width of object_08
00??????";
CM_ SG_ 1109 ARC_OD_RCS_Obj_08_RR "RCS of object_08
00?????????";
CM_ SG_ 1109 ARC_OD_Orientation_Obj_08_RR "Orientation of object_08
00???????";
CM_ SG_ 1109 ARC_OD_LifeCycle_Obj_08_RR "Life cycle of object_08
00????????";
CM_ SG_ 1109 ARC_OD_AabsX_Obj_08_RR "Longitudinal absolution acceleration over ground of object_08
00?????????????";
CM_ SG_ 1109 ARC_OD_DistY_Obj_08_RR "Lateral distance of object_08
00????????";
CM_ SG_ 1109 ARC_OD_ObstacleProb_Obj_08_RR "Obstacle probability of object_08
00?????????";
CM_ SG_ 1109 ARC_OD_VabsY_Obj_08_RR "Lateral absolution velocity over ground of object_08
00????????????";
CM_ SG_ 1109 ARC_OD_AabsY_Obj_08_RR "Lateral absolution acceleration over ground of object_08
00?????????????";
CM_ SG_ 1109 ARC_OD_DistXStd_Obj_08_RR "Longitudinal distance standard deviation of object_08
00???????????";
CM_ SG_ 1109 ARC_OD_DistYStd_Obj_08_RR "Lateral distance standard deviation of object_08
00???????????";
CM_ SG_ 1109 ARC_OD_VabsXStd_Obj_08_RR "Longitudinal absolution velocity standard deviation of object_08
00???????????????";
CM_ SG_ 1109 ARC_OD_VabsYStd_Obj_08_RR "Lateral absolution velocity standard deviation of object_08
00???????????????";
CM_ SG_ 1109 ARC_OD_AabsXStd_Obj_08_RR "Longitudinal absolution acceleration standard deviation of object_08
00????????????????";
CM_ SG_ 1108 ARC_OD_DistX_Obj_06_RR "Longitudinal distance of object_06
00????????";
CM_ SG_ 1108 ARC_OD_Classification_Obj_06_RR "Classification of object_06
00??????";
CM_ SG_ 1108 ARC_OD_AabsYStd_Obj_06_RR "Lateral absolution acceleration standard deviation of object_06
00????????????????";
CM_ SG_ 1108 ARC_OD_ClassConf_Obj_06_RR "Classification confidence of object_06
00?????????";
CM_ SG_ 1108 ARC_OD_ProbOfExist_Obj_06_RR "Existence probability of object_06
00????????";
CM_ SG_ 1108 ARC_OD_VabsX_Obj_06_RR "Longitudinal absolution velocity over ground of object_06
00????????????";
CM_ SG_ 1108 ARC_OD_DynProp_Obj_06_RR "Dynamic property of object_06
00????????";
CM_ SG_ 1108 ARC_OD_Length_Obj_06_RR "Length of object_06
00??????";
CM_ SG_ 1108 ARC_OD_MaintenanceState_Obj_06_R "Maintenance state of object_06
00????????";
CM_ SG_ 1108 ARC_OD_Width_Obj_06_RR "Width of object_06
00??????";
CM_ SG_ 1108 ARC_OD_RCS_Obj_06_RR "RCS of object_06
00?????????";
CM_ SG_ 1108 ARC_OD_Orientation_Obj_06_RR "Orientation of object_06
00???????";
CM_ SG_ 1108 ARC_OD_LifeCycle_Obj_06_RR "Life cycle of object_06
00????????";
CM_ SG_ 1108 ARC_OD_AabsX_Obj_06_RR "Longitudinal absolution acceleration over ground of object_06
00?????????????";
CM_ SG_ 1108 ARC_OD_DistY_Obj_06_RR "Lateral distance of object_06
00????????";
CM_ SG_ 1108 ARC_OD_ObstacleProb_Obj_06_RR "Obstacle probability of object_06
00?????????";
CM_ SG_ 1108 ARC_OD_VabsY_Obj_06_RR "Lateral absolution velocity over ground of object_06
00????????????";
CM_ SG_ 1108 ARC_OD_AabsY_Obj_06_RR "Lateral absolution acceleration over ground of object_06
00?????????????";
CM_ SG_ 1108 ARC_OD_DistXStd_Obj_06_RR "Longitudinal distance standard deviation of object_06
00???????????";
CM_ SG_ 1108 ARC_OD_DistYStd_Obj_06_RR "Lateral distance standard deviation of object_06
00???????????";
CM_ SG_ 1108 ARC_OD_VabsXStd_Obj_06_RR "Longitudinal absolution velocity standard deviation of object_06
00???????????????";
CM_ SG_ 1108 ARC_OD_VabsYStd_Obj_06_RR "Lateral absolution velocity standard deviation of object_06
00???????????????";
CM_ SG_ 1108 ARC_OD_AabsXStd_Obj_06_RR "Longitudinal absolution acceleration standard deviation of object_06
00????????????????";
CM_ SG_ 1107 ARC_OD_DistX_Obj_04_RR "Longitudinal distance of object_04
00????????";
CM_ SG_ 1107 ARC_OD_Classification_Obj_04_RR "Classification of object_04
00??????";
CM_ SG_ 1107 ARC_OD_AabsYStd_Obj_04_RR "Lateral absolution acceleration standard deviation of object_04
00????????????????";
CM_ SG_ 1107 ARC_OD_ClassConf_Obj_04_RR "Classification confidence of object_04
00?????????";
CM_ SG_ 1107 ARC_OD_ProbOfExist_Obj_04_RR "Existence probability of object_04
00????????";
CM_ SG_ 1107 ARC_OD_VabsX_Obj_04_RR "Longitudinal absolution velocity over ground of object_04
00????????????";
CM_ SG_ 1107 ARC_OD_DynProp_Obj_04_RR "Dynamic property of object_04
00????????";
CM_ SG_ 1107 ARC_OD_Length_Obj_04_RR "Length of object_04
00??????";
CM_ SG_ 1107 ARC_OD_MaintenanceState_Obj_04_R "Maintenance state of object_04
00????????";
CM_ SG_ 1107 ARC_OD_Width_Obj_04_RR "Width of object_04
00??????";
CM_ SG_ 1107 ARC_OD_RCS_Obj_04_RR "RCS of object_04
00?????????";
CM_ SG_ 1107 ARC_OD_Orientation_Obj_04_RR "Orientation of object_04
00???????";
CM_ SG_ 1107 ARC_OD_LifeCycle_Obj_04_RR "Life cycle of object_04
00????????";
CM_ SG_ 1107 ARC_OD_AabsX_Obj_04_RR "Longitudinal absolution acceleration over ground of object_04
00?????????????";
CM_ SG_ 1107 ARC_OD_DistY_Obj_04_RR "Lateral distance of object_04
00????????";
CM_ SG_ 1107 ARC_OD_ObstacleProb_Obj_04_RR "Obstacle probability of object_04
00?????????";
CM_ SG_ 1107 ARC_OD_VabsY_Obj_04_RR "Lateral absolution velocity over ground of object_04
00????????????";
CM_ SG_ 1107 ARC_OD_AabsY_Obj_04_RR "Lateral absolution acceleration over ground of object_04
00?????????????";
CM_ SG_ 1107 ARC_OD_DistXStd_Obj_04_RR "Longitudinal distance standard deviation of object_04
00???????????";
CM_ SG_ 1107 ARC_OD_DistYStd_Obj_04_RR "Lateral distance standard deviation of object_04
00???????????";
CM_ SG_ 1107 ARC_OD_VabsXStd_Obj_04_RR "Longitudinal absolution velocity standard deviation of object_04
00???????????????";
CM_ SG_ 1107 ARC_OD_VabsYStd_Obj_04_RR "Lateral absolution velocity standard deviation of object_04
00???????????????";
CM_ SG_ 1107 ARC_OD_AabsXStd_Obj_04_RR "Longitudinal absolution acceleration standard deviation of object_04
00????????????????";
CM_ SG_ 1106 ARC_OD_DistX_Obj_02_RR "111";
CM_ SG_ 1106 ARC_OD_Classification_Obj_02_RR "Classification of object_02
00??????";
CM_ SG_ 1106 ARC_OD_AabsYStd_Obj_02_RR "Lateral absolution acceleration standard deviation of object_02
00????????????????";
CM_ SG_ 1106 ARC_OD_ClassConf_Obj_02_RR "Classification confidence of object_02
00?????????";
CM_ SG_ 1106 ARC_OD_ProbOfExist_Obj_02_RR "Existence probability of object_02
00????????";
CM_ SG_ 1106 ARC_OD_VabsX_Obj_02_RR "Longitudinal absolution velocity over ground of object_02
00????????????";
CM_ SG_ 1106 ARC_OD_DynProp_Obj_02_RR "Dynamic property of object_02
00????????";
CM_ SG_ 1106 ARC_OD_Length_Obj_02_RR "Length of object_02
00??????";
CM_ SG_ 1106 ARC_OD_MaintenanceState_Obj_02_R "Maintenance state of object_02
00????????";
CM_ SG_ 1106 ARC_OD_Width_Obj_02_RR "Width of object_02
00??????";
CM_ SG_ 1106 ARC_OD_RCS_Obj_02_RR "RCS of object_02
00?????????";
CM_ SG_ 1106 ARC_OD_Orientation_Obj_02_RR "Orientation of object_02
00???????";
CM_ SG_ 1106 ARC_OD_LifeCycle_Obj_02_RR "Life cycle of object_02
00????????";
CM_ SG_ 1106 ARC_OD_AabsX_Obj_02_RR "Longitudinal absolution acceleration over ground of object_02
00?????????????";
CM_ SG_ 1106 ARC_OD_DistY_Obj_02_RR "Lateral distance of object_02
00????????";
CM_ SG_ 1106 ARC_OD_ObstacleProb_Obj_02_RR "Obstacle probability of object_02
00?????????";
CM_ SG_ 1106 ARC_OD_VabsY_Obj_02_RR "Lateral absolution velocity over ground of object_02
00????????????";
CM_ SG_ 1106 ARC_OD_AabsY_Obj_02_RR "Lateral absolution acceleration over ground of object_02
00?????????????";
CM_ SG_ 1106 ARC_OD_DistXStd_Obj_02_RR "Longitudinal distance standard deviation of object_02
00???????????";
CM_ SG_ 1106 ARC_OD_DistYStd_Obj_02_RR "Lateral distance standard deviation of object_02
00???????????";
CM_ SG_ 1106 ARC_OD_VabsXStd_Obj_02_RR "Longitudinal absolution velocity standard deviation of object_02
00???????????????";
CM_ SG_ 1106 ARC_OD_VabsYStd_Obj_02_RR "Lateral absolution velocity standard deviation of object_02
00???????????????";
CM_ SG_ 1106 ARC_OD_AabsXStd_Obj_02_RR "Longitudinal absolution acceleration standard deviation of object_02
00????????????????";
CM_ SG_ 1105 ARC_OD_DistX_Obj_00_RR "Longitudinal distance of object_00
00????????";
CM_ SG_ 1105 ARC_OD_Classification_Obj_00_RR "Classification of object_00
";
CM_ SG_ 1105 ARC_OD_AabsYStd_Obj_00_RR "Lateral absolution acceleration standard deviation of object_00
00????????????????";
CM_ SG_ 1105 ARC_OD_ClassConf_Obj_00_RR "Classification confidence of object_00
00?????????";
CM_ SG_ 1105 ARC_OD_ProbOfExist_Obj_00_RR "Existence probability of object_00
00????????";
CM_ SG_ 1105 ARC_OD_VabsX_Obj_00_RR "Longitudinal absolution velocity over ground of object_00
00????????????";
CM_ SG_ 1105 ARC_OD_DynProp_Obj_00_RR "Dynamic property of object_00
00????????";
CM_ SG_ 1105 ARC_OD_Length_Obj_00_RR "Length of object_00
00??????";
CM_ SG_ 1105 ARC_OD_MaintenanceState_Obj_00_R "Maintenance state of object_00
00????????";
CM_ SG_ 1105 ARC_OD_Width_Obj_00_RR "Width of object_00
00??????";
CM_ SG_ 1105 ARC_OD_RCS_Obj_00_RR "RCS of object_00
00?????????";
CM_ SG_ 1105 ARC_OD_Orientation_Obj_00_RR "Orientation of object_00
00???????";
CM_ SG_ 1105 ARC_OD_LifeCycle_Obj_00_RR "Life cycle of object_00
00????????";
CM_ SG_ 1105 ARC_OD_AabsX_Obj_00_RR "Longitudinal absolution acceleration over ground of object_00
00?????????????";
CM_ SG_ 1105 ARC_OD_DistY_Obj_00_RR "Lateral distance of object_00
00????????";
CM_ SG_ 1105 ARC_OD_ObstacleProb_Obj_00_RR "Obstacle probability of object_00
00?????????";
CM_ SG_ 1105 ARC_OD_VabsY_Obj_00_RR "Lateral absolution velocity over ground of object_00
00????????????";
CM_ SG_ 1105 ARC_OD_AabsY_Obj_00_RR "Lateral absolution acceleration over ground of object_00
00?????????????";
CM_ SG_ 1105 ARC_OD_DistXStd_Obj_00_RR "Longitudinal distance standard deviation of object_00
00???????????";
CM_ SG_ 1105 ARC_OD_DistYStd_Obj_00_RR "Lateral distance standard deviation of object_00
00???????????";
CM_ SG_ 1105 ARC_OD_VabsXStd_Obj_00_RR "Longitudinal absolution velocity standard deviation of object_00
00???????????????";
CM_ SG_ 1105 ARC_OD_VabsYStd_Obj_00_RR "Lateral absolution velocity standard deviation of object_00
00???????????????";
CM_ SG_ 1105 ARC_OD_AabsXStd_Obj_00_RR "Longitudinal absolution acceleration standard deviation of object_00
00????????????????";
CM_ SG_ 1616 ARC_OD_TimeStampGlobSec_FL "Synchronized global timestamp when OD-task corresponding RF task is done (second part)
?????,OD?????RF????????(???)";
CM_ SG_ 1616 ARC_OD_CycleCounter_FL "Internal coutner that increments if OD task executes once
??OD?????";
CM_ SG_ 1616 ARC_OD_NumOfObjects_FL "Number of objects
????";
CM_ SG_ 1616 ARC_OD_TaskValidFlag_FL "Flag indicates OD task is valid
OD????????";
CM_ SG_ 1616 ARC_OD_ExtendedCycleFlag_FL "Flag indicates OD task takes two cycles time to execute
???????(?RDI????????????)";
CM_ SG_ 1616 ARC_OD_Latency_FL "Time difference between RF task and OD task (signal processing time)
RF???OD??????(??????)";
CM_ SG_ 1616 ARC_OD_TimeStampGlobNanoSec_FL "Synchronized global timestamp when OD-task corresponding RF task is done  (nannosecond part)
?????,OD?????RF????????(????)";
CM_ SG_ 1616 ARC_OD_TimeStampLocal_FL "Unsynchronized local timestamp when OD-task corresponding RF task is done
??????,OD?????RF??????????";
CM_ SG_ 1616 ARC_OD_MeasCounter_FL "Internal counter that increments if RF task executes once
??RF?????";
CM_ SG_ 1360 ARC_OD_TimeStampGlobSec_FR "Synchronized global timestamp when OD-task corresponding RF task is done (second part)
?????,OD?????RF????????(???)";
CM_ SG_ 1360 ARC_OD_CycleCounter_FR "Internal coutner that increments if OD task executes once
??OD?????";
CM_ SG_ 1360 ARC_OD_NumOfObjects_FR "Number of objects
????";
CM_ SG_ 1360 ARC_OD_TaskValidFlag_FR "Flag indicates OD task is valid
OD????????";
CM_ SG_ 1360 ARC_OD_ExtendedCycleFlag_FR "Flag indicates OD task takes two cycles time to execute
???????(?RDI????????????)";
CM_ SG_ 1360 ARC_OD_Latency_FR "Time difference between RF task and OD task (signal processing time)
RF???OD??????(??????)";
CM_ SG_ 1360 ARC_OD_TimeStampGlobNanoSec_FR "Synchronized global timestamp when OD-task corresponding RF task is done  (nannosecond part)
?????,OD?????RF????????(????)";
CM_ SG_ 1360 ARC_OD_TimeStampLocal_FR "Unsynchronized local timestamp when OD-task corresponding RF task is done
??????,OD?????RF??????????";
CM_ SG_ 1360 ARC_OD_MeasCounter_FR "Internal counter that increments if RF task executes once
??RF?????";
CM_ SG_ 1104 ARC_OD_TimeStampGlobSec_RR "Synchronized global timestamp when OD-task corresponding RF task is done (second part)
?????,OD?????RF????????(???)";
CM_ SG_ 1104 ARC_OD_CycleCounter_RR "Internal coutner that increments if OD task executes once
??OD?????";
CM_ SG_ 1104 ARC_OD_NumOfObjects_RR "Number of objects
????";
CM_ SG_ 1104 ARC_OD_TaskValidFlag_RR "Flag indicates OD task is valid
OD????????";
CM_ SG_ 1104 ARC_OD_ExtendedCycleFlag_RR "Flag indicates OD task takes two cycles time to execute
???????(?RDI????????????)";
CM_ SG_ 1104 ARC_OD_Latency_RR "Time difference between RF task and OD task (signal processing time)
RF???OD??????(??????)";
CM_ SG_ 1104 ARC_OD_TimeStampGlobNanoSec_RR "Synchronized global timestamp when OD-task corresponding RF task is done  (nannosecond part)
?????,OD?????RF????????(????)";
CM_ SG_ 1104 ARC_OD_TimeStampLocal_RR "Unsynchronized local timestamp when OD-task corresponding RF task is done
??????,OD?????RF??????????";
CM_ SG_ 1104 ARC_OD_MeasCounter_RR "Internal counter that increments if RF task executes once
??RF?????";
CM_ SG_ 102 ARC_CFG_Mode_FR "Radar sensor working mode, MODE A by default
?????????,???? MODE A";
CM_ SG_ 102 ARC_CFG_TmeSynEnFl_FR "Time synchronization enabling flag, DISABLED by default
?????????,????";
CM_ SG_ 105 ARC_CFG_Mode_FL "Radar sensor working mode, MODE A by default
?????????,???? MODE A";
CM_ SG_ 105 ARC_CFG_TmeSynEnFl_FL "Time synchronization enabling flag, DISABLED by default
?????????,????";
CM_ SG_ 99 ARC_CFG_Mode_RR "Radar sensor working mode, MODE A by default
?????????,???? MODE A";
CM_ SG_ 99 ARC_CFG_TmeSynEnFl_RR "Time synchronization enabling flag, DISABLED by default
?????????,????";
CM_ SG_ 96 ARC_CFG_Mode_RL "Radar sensor working mode, MODE A by default
?????????,???? MODE A";
CM_ SG_ 96 ARC_CFG_TmeSynEnFl_RL "Time synchronization enabling flag, DISABLED by default
?????????,????";
CM_ SG_ 848 ARC_OD_TimeStampGlobSec_RL "Synchronized global timestamp when OD-task corresponding RF task is done (second part)
?????,OD?????RF????????(???)";
CM_ SG_ 848 ARC_OD_CycleCounter_RL "Internal coutner that increments if OD task executes once
??OD?????";
CM_ SG_ 848 ARC_OD_NumOfObjects_RL "Number of objects
????";
CM_ SG_ 848 ARC_OD_TaskValidFlag_RL "Flag indicates OD task is valid
OD????????";
CM_ SG_ 848 ARC_OD_ExtendedCycleFlag_RL "Flag indicates OD task takes two cycles time to execute
???????(?RDI????????????)";
CM_ SG_ 848 ARC_OD_Latency_RL "Time difference between RF task and OD task (signal processing time)
RF???OD??????(??????)";
CM_ SG_ 848 ARC_OD_TimeStampGlobNanoSec_RL "Synchronized global timestamp when OD-task corresponding RF task is done  (nannosecond part)
?????,OD?????RF????????(????)";
CM_ SG_ 848 ARC_OD_TimeStampLocal_RL "Unsynchronized local timestamp when OD-task corresponding RF task is done
??????,OD?????RF??????????";
CM_ SG_ 848 ARC_OD_MeasCounter_RL "Internal counter that increments if RF task executes once
??RF?????";
CM_ SG_ 849 ARC_OD_DistX_Obj_00_RL "Longitudinal distance of object_00
00????????";
CM_ SG_ 849 ARC_OD_Classification_Obj_00_RL "Classification of object_00
";
CM_ SG_ 849 ARC_OD_AabsYStd_Obj_00_RL "Lateral absolution acceleration standard deviation of object_00
00????????????????";
CM_ SG_ 849 ARC_OD_ClassConf_Obj_00_RL "Classification confidence of object_00
00?????????";
CM_ SG_ 849 ARC_OD_ProbOfExist_Obj_00_RL "Existence probability of object_00
00????????";
CM_ SG_ 849 ARC_OD_VabsX_Obj_00_RL "Longitudinal absolution velocity over ground of object_00
00????????????";
CM_ SG_ 849 ARC_OD_DynProp_Obj_00_RL "Dynamic property of object_00
00????????";
CM_ SG_ 849 ARC_OD_Length_Obj_00_RL "Length of object_00
00??????";
CM_ SG_ 849 ARC_OD_MaintenanceState_Obj_0061 "Maintenance state of object_00
00????????";
CM_ SG_ 849 ARC_OD_Width_Obj_00_RL "Width of object_00
00??????";
CM_ SG_ 849 ARC_OD_RCS_Obj_00_RL "RCS of object_00
00?????????";
CM_ SG_ 849 ARC_OD_Orientation_Obj_00_RL "Orientation of object_00
00???????";
CM_ SG_ 849 ARC_OD_LifeCycle_Obj_00_RL "Life cycle of object_00
00????????";
CM_ SG_ 849 ARC_OD_AabsX_Obj_00_RL "Longitudinal absolution acceleration over ground of object_00
00?????????????";
CM_ SG_ 849 ARC_OD_DistY_Obj_00_RL "Lateral distance of object_00
00????????";
CM_ SG_ 849 ARC_OD_ObstacleProb_Obj_00_RL "Obstacle probability of object_00
00?????????";
CM_ SG_ 849 ARC_OD_VabsY_Obj_00_RL "Lateral absolution velocity over ground of object_00
00????????????";
CM_ SG_ 849 ARC_OD_AabsY_Obj_00_RL "Lateral absolution acceleration over ground of object_00
00?????????????";
CM_ SG_ 849 ARC_OD_DistXStd_Obj_00_RL "Longitudinal distance standard deviation of object_00
00???????????";
CM_ SG_ 849 ARC_OD_DistYStd_Obj_00_RL "Lateral distance standard deviation of object_00
00???????????";
CM_ SG_ 849 ARC_OD_VabsXStd_Obj_00_RL "Longitudinal absolution velocity standard deviation of object_00
00???????????????";
CM_ SG_ 849 ARC_OD_VabsYStd_Obj_00_RL "Lateral absolution velocity standard deviation of object_00
00???????????????";
CM_ SG_ 849 ARC_OD_AabsXStd_Obj_00_RL "Longitudinal absolution acceleration standard deviation of object_00
00????????????????";
CM_ SG_ 850 ARC_OD_DistX_Obj_02_RL "111";
CM_ SG_ 850 ARC_OD_Classification_Obj_02_RL "Classification of object_02
00??????";
CM_ SG_ 850 ARC_OD_AabsYStd_Obj_02_RL "Lateral absolution acceleration standard deviation of object_02
00????????????????";
CM_ SG_ 850 ARC_OD_ClassConf_Obj_02_RL "Classification confidence of object_02
00?????????";
CM_ SG_ 850 ARC_OD_ProbOfExist_Obj_02_RL "Existence probability of object_02
00????????";
CM_ SG_ 850 ARC_OD_VabsX_Obj_02_RL "Longitudinal absolution velocity over ground of object_02
00????????????";
CM_ SG_ 850 ARC_OD_DynProp_Obj_02_RL "Dynamic property of object_02
00????????";
CM_ SG_ 850 ARC_OD_Length_Obj_02_RL "Length of object_02
00??????";
CM_ SG_ 850 ARC_OD_MaintenanceState_Obj_0063 "Maintenance state of object_02
00????????";
CM_ SG_ 850 ARC_OD_Width_Obj_02_RL "Width of object_02
00??????";
CM_ SG_ 850 ARC_OD_RCS_Obj_02_RL "RCS of object_02
00?????????";
CM_ SG_ 850 ARC_OD_Orientation_Obj_02_RL "Orientation of object_02
00???????";
CM_ SG_ 850 ARC_OD_LifeCycle_Obj_02_RL "Life cycle of object_02
00????????";
CM_ SG_ 850 ARC_OD_AabsX_Obj_02_RL "Longitudinal absolution acceleration over ground of object_02
00?????????????";
CM_ SG_ 850 ARC_OD_DistY_Obj_02_RL "Lateral distance of object_02
00????????";
CM_ SG_ 850 ARC_OD_ObstacleProb_Obj_02_RL "Obstacle probability of object_02
00?????????";
CM_ SG_ 850 ARC_OD_VabsY_Obj_02_RL "Lateral absolution velocity over ground of object_02
00????????????";
CM_ SG_ 850 ARC_OD_AabsY_Obj_02_RL "Lateral absolution acceleration over ground of object_02
00?????????????";
CM_ SG_ 850 ARC_OD_DistXStd_Obj_02_RL "Longitudinal distance standard deviation of object_02
00???????????";
CM_ SG_ 850 ARC_OD_DistYStd_Obj_02_RL "Lateral distance standard deviation of object_02
00???????????";
CM_ SG_ 850 ARC_OD_VabsXStd_Obj_02_RL "Longitudinal absolution velocity standard deviation of object_02
00???????????????";
CM_ SG_ 850 ARC_OD_VabsYStd_Obj_02_RL "Lateral absolution velocity standard deviation of object_02
00???????????????";
CM_ SG_ 850 ARC_OD_AabsXStd_Obj_02_RL "Longitudinal absolution acceleration standard deviation of object_02
00????????????????";
CM_ SG_ 851 ARC_OD_DistX_Obj_04_RL "Longitudinal distance of object_04
00????????";
CM_ SG_ 851 ARC_OD_Classification_Obj_04_RL "Classification of object_04
00??????";
CM_ SG_ 851 ARC_OD_AabsYStd_Obj_04_RL "Lateral absolution acceleration standard deviation of object_04
00????????????????";
CM_ SG_ 851 ARC_OD_ClassConf_Obj_04_RL "Classification confidence of object_04
00?????????";
CM_ SG_ 851 ARC_OD_ProbOfExist_Obj_04_RL "Existence probability of object_04
00????????";
CM_ SG_ 851 ARC_OD_VabsX_Obj_04_RL "Longitudinal absolution velocity over ground of object_04
00????????????";
CM_ SG_ 851 ARC_OD_DynProp_Obj_04_RL "Dynamic property of object_04
00????????";
CM_ SG_ 851 ARC_OD_Length_Obj_04_RL "Length of object_04
00??????";
CM_ SG_ 851 ARC_OD_MaintenanceState_Obj_0065 "Maintenance state of object_04
00????????";
CM_ SG_ 851 ARC_OD_Width_Obj_04_RL "Width of object_04
00??????";
CM_ SG_ 851 ARC_OD_RCS_Obj_04_RL "RCS of object_04
00?????????";
CM_ SG_ 851 ARC_OD_Orientation_Obj_04_RL "Orientation of object_04
00???????";
CM_ SG_ 851 ARC_OD_LifeCycle_Obj_04_RL "Life cycle of object_04
00????????";
CM_ SG_ 851 ARC_OD_AabsX_Obj_04_RL "Longitudinal absolution acceleration over ground of object_04
00?????????????";
CM_ SG_ 851 ARC_OD_DistY_Obj_04_RL "Lateral distance of object_04
00????????";
CM_ SG_ 851 ARC_OD_ObstacleProb_Obj_04_RL "Obstacle probability of object_04
00?????????";
CM_ SG_ 851 ARC_OD_VabsY_Obj_04_RL "Lateral absolution velocity over ground of object_04
00????????????";
CM_ SG_ 851 ARC_OD_AabsY_Obj_04_RL "Lateral absolution acceleration over ground of object_04
00?????????????";
CM_ SG_ 851 ARC_OD_DistXStd_Obj_04_RL "Longitudinal distance standard deviation of object_04
00???????????";
CM_ SG_ 851 ARC_OD_DistYStd_Obj_04_RL "Lateral distance standard deviation of object_04
00???????????";
CM_ SG_ 851 ARC_OD_VabsXStd_Obj_04_RL "Longitudinal absolution velocity standard deviation of object_04
00???????????????";
CM_ SG_ 851 ARC_OD_VabsYStd_Obj_04_RL "Lateral absolution velocity standard deviation of object_04
00???????????????";
CM_ SG_ 851 ARC_OD_AabsXStd_Obj_04_RL "Longitudinal absolution acceleration standard deviation of object_04
00????????????????";
CM_ SG_ 852 ARC_OD_DistX_Obj_06_RL "Longitudinal distance of object_06
00????????";
CM_ SG_ 852 ARC_OD_Classification_Obj_06_RL "Classification of object_06
00??????";
CM_ SG_ 852 ARC_OD_AabsYStd_Obj_06_RL "Lateral absolution acceleration standard deviation of object_06
00????????????????";
CM_ SG_ 852 ARC_OD_ClassConf_Obj_06_RL "Classification confidence of object_06
00?????????";
CM_ SG_ 852 ARC_OD_ProbOfExist_Obj_06_RL "Existence probability of object_06
00????????";
CM_ SG_ 852 ARC_OD_VabsX_Obj_06_RL "Longitudinal absolution velocity over ground of object_06
00????????????";
CM_ SG_ 852 ARC_OD_DynProp_Obj_06_RL "Dynamic property of object_06
00????????";
CM_ SG_ 852 ARC_OD_Length_Obj_06_RL "Length of object_06
00??????";
CM_ SG_ 852 ARC_OD_MaintenanceState_Obj_0067 "Maintenance state of object_06
00????????";
CM_ SG_ 852 ARC_OD_Width_Obj_06_RL "Width of object_06
00??????";
CM_ SG_ 852 ARC_OD_RCS_Obj_06_RL "RCS of object_06
00?????????";
CM_ SG_ 852 ARC_OD_Orientation_Obj_06_RL "Orientation of object_06
00???????";
CM_ SG_ 852 ARC_OD_LifeCycle_Obj_06_RL "Life cycle of object_06
00????????";
CM_ SG_ 852 ARC_OD_AabsX_Obj_06_RL "Longitudinal absolution acceleration over ground of object_06
00?????????????";
CM_ SG_ 852 ARC_OD_DistY_Obj_06_RL "Lateral distance of object_06
00????????";
CM_ SG_ 852 ARC_OD_ObstacleProb_Obj_06_RL "Obstacle probability of object_06
00?????????";
CM_ SG_ 852 ARC_OD_VabsY_Obj_06_RL "Lateral absolution velocity over ground of object_06
00????????????";
CM_ SG_ 852 ARC_OD_AabsY_Obj_06_RL "Lateral absolution acceleration over ground of object_06
00?????????????";
CM_ SG_ 852 ARC_OD_DistXStd_Obj_06_RL "Longitudinal distance standard deviation of object_06
00???????????";
CM_ SG_ 852 ARC_OD_DistYStd_Obj_06_RL "Lateral distance standard deviation of object_06
00???????????";
CM_ SG_ 852 ARC_OD_VabsXStd_Obj_06_RL "Longitudinal absolution velocity standard deviation of object_06
00???????????????";
CM_ SG_ 852 ARC_OD_VabsYStd_Obj_06_RL "Lateral absolution velocity standard deviation of object_06
00???????????????";
CM_ SG_ 852 ARC_OD_AabsXStd_Obj_06_RL "Longitudinal absolution acceleration standard deviation of object_06
00????????????????";
CM_ SG_ 853 ARC_OD_DistX_Obj_08_RL "Longitudinal distance of object_08
00????????";
CM_ SG_ 853 ARC_OD_Classification_Obj_08_RL "Classification of object_08
00??????";
CM_ SG_ 853 ARC_OD_AabsYStd_Obj_08_RL "Lateral absolution acceleration standard deviation of object_08
00????????????????";
CM_ SG_ 853 ARC_OD_ClassConf_Obj_08_RL "Classification confidence of object_08
00?????????";
CM_ SG_ 853 ARC_OD_ProbOfExist_Obj_08_RL "Existence probability of object_08
00????????";
CM_ SG_ 853 ARC_OD_VabsX_Obj_08_RL "Longitudinal absolution velocity over ground of object_08
00????????????";
CM_ SG_ 853 ARC_OD_DynProp_Obj_08_RL "Dynamic property of object_08
00????????";
CM_ SG_ 853 ARC_OD_Length_Obj_08_RL "Length of object_08
00??????";
CM_ SG_ 853 ARC_OD_MaintenanceState_Obj_0069 "Maintenance state of object_08
00????????";
CM_ SG_ 853 ARC_OD_Width_Obj_08_RL "Width of object_08
00??????";
CM_ SG_ 853 ARC_OD_RCS_Obj_08_RL "RCS of object_08
00?????????";
CM_ SG_ 853 ARC_OD_Orientation_Obj_08_RL "Orientation of object_08
00???????";
CM_ SG_ 853 ARC_OD_LifeCycle_Obj_08_RL "Life cycle of object_08
00????????";
CM_ SG_ 853 ARC_OD_AabsX_Obj_08_RL "Longitudinal absolution acceleration over ground of object_08
00?????????????";
CM_ SG_ 853 ARC_OD_DistY_Obj_08_RL "Lateral distance of object_08
00????????";
CM_ SG_ 853 ARC_OD_ObstacleProb_Obj_08_RL "Obstacle probability of object_08
00?????????";
CM_ SG_ 853 ARC_OD_VabsY_Obj_08_RL "Lateral absolution velocity over ground of object_08
00????????????";
CM_ SG_ 853 ARC_OD_AabsY_Obj_08_RL "Lateral absolution acceleration over ground of object_08
00?????????????";
CM_ SG_ 853 ARC_OD_DistXStd_Obj_08_RL "Longitudinal distance standard deviation of object_08
00???????????";
CM_ SG_ 853 ARC_OD_DistYStd_Obj_08_RL "Lateral distance standard deviation of object_08
00???????????";
CM_ SG_ 853 ARC_OD_VabsXStd_Obj_08_RL "Longitudinal absolution velocity standard deviation of object_08
00???????????????";
CM_ SG_ 853 ARC_OD_VabsYStd_Obj_08_RL "Lateral absolution velocity standard deviation of object_08
00???????????????";
CM_ SG_ 853 ARC_OD_AabsXStd_Obj_08_RL "Longitudinal absolution acceleration standard deviation of object_08
00????????????????";
CM_ SG_ 854 ARC_OD_DistX_Obj_10_RL "Longitudinal distance of object_10
00????????";
CM_ SG_ 854 ARC_OD_Classification_Obj_10_RL "Classification of object_10
00??????";
CM_ SG_ 854 ARC_OD_AabsYStd_Obj_10_RL "Lateral absolution acceleration standard deviation of object_10
00????????????????";
CM_ SG_ 854 ARC_OD_ClassConf_Obj_10_RL "Classification confidence of object_10
00?????????";
CM_ SG_ 854 ARC_OD_ProbOfExist_Obj_10_RL "Existence probability of object_10
00????????";
CM_ SG_ 854 ARC_OD_VabsX_Obj_10_RL "Longitudinal absolution velocity over ground of object_10
00????????????";
CM_ SG_ 854 ARC_OD_DynProp_Obj_10_RL "Dynamic property of object_10
00????????";
CM_ SG_ 854 ARC_OD_Length_Obj_10_RL "Length of object_10
00??????";
CM_ SG_ 854 ARC_OD_MaintenanceState_Obj_0071 "Maintenance state of object_10
00????????";
CM_ SG_ 854 ARC_OD_Width_Obj_10_RL "Width of object_10
00??????";
CM_ SG_ 854 ARC_OD_RCS_Obj_10_RL "RCS of object_10
00?????????";
CM_ SG_ 854 ARC_OD_Orientation_Obj_10_RL "Orientation of object_10
00???????";
CM_ SG_ 854 ARC_OD_LifeCycle_Obj_10_RL "Life cycle of object_10
00????????";
CM_ SG_ 854 ARC_OD_AabsX_Obj_10_RL "Longitudinal absolution acceleration over ground of object_10
00?????????????";
CM_ SG_ 854 ARC_OD_DistY_Obj_10_RL "Lateral distance of object_10
00????????";
CM_ SG_ 854 ARC_OD_ObstacleProb_Obj_10_RL "Obstacle probability of object_10
00?????????";
CM_ SG_ 854 ARC_OD_VabsY_Obj_10_RL "Lateral absolution velocity over ground of object_10
00????????????";
CM_ SG_ 854 ARC_OD_AabsY_Obj_10_RL "Lateral absolution acceleration over ground of object_10
00?????????????";
CM_ SG_ 854 ARC_OD_DistXStd_Obj_10_RL "Longitudinal distance standard deviation of object_10
00???????????";
CM_ SG_ 854 ARC_OD_DistYStd_Obj_10_RL "Lateral distance standard deviation of object_10
00???????????";
CM_ SG_ 854 ARC_OD_VabsXStd_Obj_10_RL "Longitudinal absolution velocity standard deviation of object_10
00???????????????";
CM_ SG_ 854 ARC_OD_VabsYStd_Obj_10_RL "Lateral absolution velocity standard deviation of object_10
00???????????????";
CM_ SG_ 854 ARC_OD_AabsXStd_Obj_10_RL "Longitudinal absolution acceleration standard deviation of object_10
00????????????????";
CM_ SG_ 855 ARC_OD_DistX_Obj_12_RL "Longitudinal distance of object_12
00????????";
CM_ SG_ 855 ARC_OD_Classification_Obj_12_RL "Classification of object_12
00??????";
CM_ SG_ 855 ARC_OD_AabsYStd_Obj_12_RL "Lateral absolution acceleration standard deviation of object_12
00????????????????";
CM_ SG_ 855 ARC_OD_ClassConf_Obj_12_RL "Classification confidence of object_12
00?????????";
CM_ SG_ 855 ARC_OD_ProbOfExist_Obj_12_RL "Existence probability of object_12
00????????";
CM_ SG_ 855 ARC_OD_VabsX_Obj_12_RL "Longitudinal absolution velocity over ground of object_12
00????????????";
CM_ SG_ 855 ARC_OD_DynProp_Obj_12_RL "Dynamic property of object_12
00????????";
CM_ SG_ 855 ARC_OD_Length_Obj_12_RL "Length of object_12
00??????";
CM_ SG_ 855 ARC_OD_MaintenanceState_Obj_0073 "Maintenance state of object_12
00????????";
CM_ SG_ 855 ARC_OD_Width_Obj_12_RL "Width of object_12
00??????";
CM_ SG_ 855 ARC_OD_RCS_Obj_12_RL "RCS of object_12
00?????????";
CM_ SG_ 855 ARC_OD_Orientation_Obj_12_RL "Orientation of object_12
00???????";
CM_ SG_ 855 ARC_OD_LifeCycle_Obj_12_RL "Life cycle of object_12
00????????";
CM_ SG_ 855 ARC_OD_AabsX_Obj_12_RL "Longitudinal absolution acceleration over ground of object_12
00?????????????";
CM_ SG_ 855 ARC_OD_DistY_Obj_12_RL "Lateral distance of object_12
00????????";
CM_ SG_ 855 ARC_OD_ObstacleProb_Obj_12_RL "Obstacle probability of object_12
00?????????";
CM_ SG_ 855 ARC_OD_VabsY_Obj_12_RL "Lateral absolution velocity over ground of object_12
00????????????";
CM_ SG_ 855 ARC_OD_AabsY_Obj_12_RL "Lateral absolution acceleration over ground of object_12
00?????????????";
CM_ SG_ 855 ARC_OD_DistXStd_Obj_12_RL "Longitudinal distance standard deviation of object_12
00???????????";
CM_ SG_ 855 ARC_OD_DistYStd_Obj_12_RL "Lateral distance standard deviation of object_12
00???????????";
CM_ SG_ 855 ARC_OD_VabsXStd_Obj_12_RL "Longitudinal absolution velocity standard deviation of object_12
00???????????????";
CM_ SG_ 855 ARC_OD_VabsYStd_Obj_12_RL "Lateral absolution velocity standard deviation of object_12
00???????????????";
CM_ SG_ 855 ARC_OD_AabsXStd_Obj_12_RL "Longitudinal absolution acceleration standard deviation of object_12
00????????????????";
CM_ SG_ 856 ARC_OD_DistX_Obj_14_RL "Longitudinal distance of object_14
00????????";
CM_ SG_ 856 ARC_OD_Classification_Obj_14_RL "Classification of object_14
00??????";
CM_ SG_ 856 ARC_OD_AabsYStd_Obj_14_RL "Lateral absolution acceleration standard deviation of object_14
00????????????????";
CM_ SG_ 856 ARC_OD_ClassConf_Obj_14_RL "Classification confidence of object_14
00?????????";
CM_ SG_ 856 ARC_OD_ProbOfExist_Obj_14_RL "Existence probability of object_14
00????????";
CM_ SG_ 856 ARC_OD_VabsX_Obj_14_RL "Longitudinal absolution velocity over ground of object_14
00????????????";
CM_ SG_ 856 ARC_OD_DynProp_Obj_14_RL "Dynamic property of object_14
00????????";
CM_ SG_ 856 ARC_OD_Length_Obj_14_RL "Length of object_14
00??????";
CM_ SG_ 856 ARC_OD_MaintenanceState_Obj_0075 "Maintenance state of object_14
00????????";
CM_ SG_ 856 ARC_OD_Width_Obj_14_RL "Width of object_14
00??????";
CM_ SG_ 856 ARC_OD_RCS_Obj_14_RL "RCS of object_14
00?????????";
CM_ SG_ 856 ARC_OD_Orientation_Obj_14_RL "Orientation of object_14
00???????";
CM_ SG_ 856 ARC_OD_LifeCycle_Obj_14_RL "Life cycle of object_14
00????????";
CM_ SG_ 856 ARC_OD_AabsX_Obj_14_RL "Longitudinal absolution acceleration over ground of object_14
00?????????????";
CM_ SG_ 856 ARC_OD_DistY_Obj_14_RL "Lateral distance of object_14
00????????";
CM_ SG_ 856 ARC_OD_ObstacleProb_Obj_14_RL "Obstacle probability of object_14
00?????????";
CM_ SG_ 856 ARC_OD_VabsY_Obj_14_RL "Lateral absolution velocity over ground of object_14
00????????????";
CM_ SG_ 856 ARC_OD_AabsY_Obj_14_RL "Lateral absolution acceleration over ground of object_14
00?????????????";
CM_ SG_ 856 ARC_OD_DistXStd_Obj_14_RL "Longitudinal distance standard deviation of object_14
00???????????";
CM_ SG_ 856 ARC_OD_DistYStd_Obj_14_RL "Lateral distance standard deviation of object_14
00???????????";
CM_ SG_ 856 ARC_OD_VabsXStd_Obj_14_RL "Longitudinal absolution velocity standard deviation of object_14
00???????????????";
CM_ SG_ 856 ARC_OD_VabsYStd_Obj_14_RL "Lateral absolution velocity standard deviation of object_14
00???????????????";
CM_ SG_ 856 ARC_OD_AabsXStd_Obj_14_RL "Longitudinal absolution acceleration standard deviation of object_14
00????????????????";
CM_ SG_ 857 ARC_OD_DistX_Obj_16_RL "Longitudinal distance of object_16
00????????";
CM_ SG_ 857 ARC_OD_Classification_Obj_16_RL "Classification of object_16
00??????";
CM_ SG_ 857 ARC_OD_AabsYStd_Obj_16_RL "Lateral absolution acceleration standard deviation of object_16
00????????????????";
CM_ SG_ 857 ARC_OD_ClassConf_Obj_16_RL "Classification confidence of object_16
00?????????";
CM_ SG_ 857 ARC_OD_ProbOfExist_Obj_16_RL "Existence probability of object_16
00????????";
CM_ SG_ 857 ARC_OD_VabsX_Obj_16_RL "Longitudinal absolution velocity over ground of object_16
00????????????";
CM_ SG_ 857 ARC_OD_DynProp_Obj_16_RL "Dynamic property of object_16
00????????";
CM_ SG_ 857 ARC_OD_Length_Obj_16_RL "Length of object_16
00??????";
CM_ SG_ 857 ARC_OD_MaintenanceState_Obj_0077 "Maintenance state of object_16
00????????";
CM_ SG_ 857 ARC_OD_Width_Obj_16_RL "Width of object_16
00??????";
CM_ SG_ 857 ARC_OD_RCS_Obj_16_RL "RCS of object_16
00?????????";
CM_ SG_ 857 ARC_OD_Orientation_Obj_16_RL "Orientation of object_16
00???????";
CM_ SG_ 857 ARC_OD_LifeCycle_Obj_16_RL "Life cycle of object_16
00????????";
CM_ SG_ 857 ARC_OD_AabsX_Obj_16_RL "Longitudinal absolution acceleration over ground of object_16
00?????????????";
CM_ SG_ 857 ARC_OD_DistY_Obj_16_RL "Lateral distance of object_16
00????????";
CM_ SG_ 857 ARC_OD_ObstacleProb_Obj_16_RL "Obstacle probability of object_16
00?????????";
CM_ SG_ 857 ARC_OD_VabsY_Obj_16_RL "Lateral absolution velocity over ground of object_16
00????????????";
CM_ SG_ 857 ARC_OD_AabsY_Obj_16_RL "Lateral absolution acceleration over ground of object_16
00?????????????";
CM_ SG_ 857 ARC_OD_DistXStd_Obj_16_RL "Longitudinal distance standard deviation of object_16
00???????????";
CM_ SG_ 857 ARC_OD_DistYStd_Obj_16_RL "Lateral distance standard deviation of object_16
00???????????";
CM_ SG_ 857 ARC_OD_VabsXStd_Obj_16_RL "Longitudinal absolution velocity standard deviation of object_16
00???????????????";
CM_ SG_ 857 ARC_OD_VabsYStd_Obj_16_RL "Lateral absolution velocity standard deviation of object_16
00???????????????";
CM_ SG_ 857 ARC_OD_AabsXStd_Obj_16_RL "Longitudinal absolution acceleration standard deviation of object_16
00????????????????";
CM_ SG_ 858 ARC_OD_DistX_Obj_18_RL "Longitudinal distance of object_18
00????????";
CM_ SG_ 858 ARC_OD_Classification_Obj_18_RL "Classification of object_18
00??????";
CM_ SG_ 858 ARC_OD_AabsYStd_Obj_18_RL "Lateral absolution acceleration standard deviation of object_18
00????????????????";
CM_ SG_ 858 ARC_OD_ClassConf_Obj_18_RL "Classification confidence of object_18
00?????????";
CM_ SG_ 858 ARC_OD_ProbOfExist_Obj_18_RL "Existence probability of object_18
00????????";
CM_ SG_ 858 ARC_OD_VabsX_Obj_18_RL "Longitudinal absolution velocity over ground of object_18
00????????????";
CM_ SG_ 858 ARC_OD_DynProp_Obj_18_RL "Dynamic property of object_18
00????????";
CM_ SG_ 858 ARC_OD_Length_Obj_18_RL "Length of object_18
00??????";
CM_ SG_ 858 ARC_OD_MaintenanceState_Obj_0079 "Maintenance state of object_18
00????????";
CM_ SG_ 858 ARC_OD_Width_Obj_18_RL "Width of object_18
00??????";
CM_ SG_ 858 ARC_OD_RCS_Obj_18_RL "RCS of object_18
00?????????";
CM_ SG_ 858 ARC_OD_Orientation_Obj_18_RL "Orientation of object_18
00???????";
CM_ SG_ 858 ARC_OD_LifeCycle_Obj_18_RL "Life cycle of object_18
00????????";
CM_ SG_ 858 ARC_OD_AabsX_Obj_18_RL "Longitudinal absolution acceleration over ground of object_18
00?????????????";
CM_ SG_ 858 ARC_OD_DistY_Obj_18_RL "Lateral distance of object_18
00????????";
CM_ SG_ 858 ARC_OD_ObstacleProb_Obj_18_RL "Obstacle probability of object_18
00?????????";
CM_ SG_ 858 ARC_OD_VabsY_Obj_18_RL "Lateral absolution velocity over ground of object_18
00????????????";
CM_ SG_ 858 ARC_OD_AabsY_Obj_18_RL "Lateral absolution acceleration over ground of object_18
00?????????????";
CM_ SG_ 858 ARC_OD_DistXStd_Obj_18_RL "Longitudinal distance standard deviation of object_18
00???????????";
CM_ SG_ 858 ARC_OD_DistYStd_Obj_18_RL "Lateral distance standard deviation of object_18
00???????????";
CM_ SG_ 858 ARC_OD_VabsXStd_Obj_18_RL "Longitudinal absolution velocity standard deviation of object_18
00???????????????";
CM_ SG_ 858 ARC_OD_VabsYStd_Obj_18_RL "Lateral absolution velocity standard deviation of object_18
00???????????????";
CM_ SG_ 858 ARC_OD_AabsXStd_Obj_18_RL "Longitudinal absolution acceleration standard deviation of object_18
00????????????????";
CM_ SG_ 859 ARC_OD_DistX_Obj_20_RL "Longitudinal distance of object_20
00????????";
CM_ SG_ 859 ARC_OD_Classification_Obj_20_RL "Classification of object_20
00??????";
CM_ SG_ 859 ARC_OD_AabsYStd_Obj_20_RL "Lateral absolution acceleration standard deviation of object_20
00????????????????";
CM_ SG_ 859 ARC_OD_ClassConf_Obj_20_RL "Classification confidence of object_20
00?????????";
CM_ SG_ 859 ARC_OD_ProbOfExist_Obj_20_RL "Existence probability of object_20
00????????";
CM_ SG_ 859 ARC_OD_VabsX_Obj_20_RL "Longitudinal absolution velocity over ground of object_20
00????????????";
CM_ SG_ 859 ARC_OD_DynProp_Obj_20_RL "Dynamic property of object_20
00????????";
CM_ SG_ 859 ARC_OD_Length_Obj_20_RL "Length of object_20
00??????";
CM_ SG_ 859 ARC_OD_MaintenanceState_Obj_0081 "Maintenance state of object_20
00????????";
CM_ SG_ 859 ARC_OD_Width_Obj_20_RL "Width of object_20
00??????";
CM_ SG_ 859 ARC_OD_RCS_Obj_20_RL "RCS of object_20
00?????????";
CM_ SG_ 859 ARC_OD_Orientation_Obj_20_RL "Orientation of object_20
00???????";
CM_ SG_ 859 ARC_OD_LifeCycle_Obj_20_RL "Life cycle of object_20
00????????";
CM_ SG_ 859 ARC_OD_AabsX_Obj_20_RL "Longitudinal absolution acceleration over ground of object_20
00?????????????";
CM_ SG_ 859 ARC_OD_DistY_Obj_20_RL "Lateral distance of object_20
00????????";
CM_ SG_ 859 ARC_OD_ObstacleProb_Obj_20_RL "Obstacle probability of object_20
00?????????";
CM_ SG_ 859 ARC_OD_VabsY_Obj_20_RL "Lateral absolution velocity over ground of object_20
00????????????";
CM_ SG_ 859 ARC_OD_AabsY_Obj_20_RL "Lateral absolution acceleration over ground of object_20
00?????????????";
CM_ SG_ 859 ARC_OD_DistXStd_Obj_20_RL "Longitudinal distance standard deviation of object_20
00???????????";
CM_ SG_ 859 ARC_OD_DistYStd_Obj_20_RL "Lateral distance standard deviation of object_20
00???????????";
CM_ SG_ 859 ARC_OD_VabsXStd_Obj_20_RL "Longitudinal absolution velocity standard deviation of object_20
00???????????????";
CM_ SG_ 859 ARC_OD_VabsYStd_Obj_20_RL "Lateral absolution velocity standard deviation of object_20
00???????????????";
CM_ SG_ 859 ARC_OD_AabsXStd_Obj_20_RL "Longitudinal absolution acceleration standard deviation of object_20
00????????????????";
BA_DEF_ BO_  "GenMsgCycleTime" INT 0 0;
BA_DEF_ BO_  "GenMsgSendType" ENUM  "Cyclic","NotUsed","Event","NotUsed","NotUsed","NotUsed","NotUsed","IfActive","NoMsgSendType","NotUsed";
BA_DEF_ BO_  "GenMsgStartDelayTime" INT 0 0;
BA_DEF_ BO_  "VFrameFormat" ENUM  "StandardCAN","ExtendedCAN","reserved","reserved","reserved","reserved","reserved","reserved","reserved","reserved","reserved","reserved","reserved","reserved","StandardCAN_FD","ExtendedCAN_FD";
BA_DEF_ SG_  "GenSigInactiveValue" INT 0 0;
BA_DEF_ SG_  "GenSigSendType" ENUM  "Cyclic","OnWrite","OnWriteWithRepetition","OnChange","OnChangeWithRepetition","IfActive","IfActiveWithRepetition","NoSigSendType","NotUsed","NotUsed","NotUsed","NotUsed","NotUsed";
BA_DEF_ SG_  "GenSigStartValue" INT 0 0;
BA_DEF_ SG_  "SystemSignalLongSymbol" STRING ;
BA_DEF_DEF_  "GenMsgCycleTime" 0;
BA_DEF_DEF_  "GenMsgSendType" "Cyclic";
BA_DEF_DEF_  "GenMsgStartDelayTime" 0;
BA_DEF_DEF_  "VFrameFormat" "ExtendedCAN_FD";
BA_DEF_DEF_  "GenSigInactiveValue" 0;
BA_DEF_DEF_  "GenSigSendType" "Cyclic";
BA_DEF_DEF_  "GenSigStartValue" 0;
BA_DEF_DEF_  "SystemSignalLongSymbol" "";
BA_ "GenMsgCycleTime" BO_ 1112 50;
BA_ "VFrameFormat" BO_ 1112 14;
BA_ "GenMsgCycleTime" BO_ 1111 50;
BA_ "VFrameFormat" BO_ 1111 14;
BA_ "GenMsgCycleTime" BO_ 1110 50;
BA_ "VFrameFormat" BO_ 1110 14;
BA_ "GenMsgCycleTime" BO_ 1109 50;
BA_ "VFrameFormat" BO_ 1109 14;
BA_ "GenMsgCycleTime" BO_ 1108 50;
BA_ "VFrameFormat" BO_ 1108 14;
BA_ "GenMsgCycleTime" BO_ 1107 50;
BA_ "VFrameFormat" BO_ 1107 14;
BA_ "GenMsgCycleTime" BO_ 1106 50;
BA_ "VFrameFormat" BO_ 1106 14;
BA_ "GenMsgCycleTime" BO_ 1105 50;
BA_ "VFrameFormat" BO_ 1105 14;
BA_ "GenMsgCycleTime" BO_ 1616 50;
BA_ "VFrameFormat" BO_ 1616 14;
BA_ "GenMsgCycleTime" BO_ 1360 50;
BA_ "VFrameFormat" BO_ 1360 14;
BA_ "GenMsgCycleTime" BO_ 1104 50;
BA_ "VFrameFormat" BO_ 1104 14;
BA_ "GenMsgCycleTime" BO_ 102 500;
BA_ "VFrameFormat" BO_ 102 14;
BA_ "GenMsgCycleTime" BO_ 105 500;
BA_ "VFrameFormat" BO_ 105 14;
BA_ "GenMsgCycleTime" BO_ 99 500;
BA_ "VFrameFormat" BO_ 99 14;
BA_ "GenMsgCycleTime" BO_ 96 500;
BA_ "VFrameFormat" BO_ 96 14;
BA_ "GenMsgCycleTime" BO_ 848 50;
BA_ "VFrameFormat" BO_ 848 14;
BA_ "GenMsgCycleTime" BO_ 849 50;
BA_ "VFrameFormat" BO_ 849 14;
BA_ "GenMsgCycleTime" BO_ 850 50;
BA_ "VFrameFormat" BO_ 850 14;
BA_ "GenMsgCycleTime" BO_ 851 50;
BA_ "VFrameFormat" BO_ 851 14;
BA_ "GenMsgCycleTime" BO_ 852 50;
BA_ "VFrameFormat" BO_ 852 14;
BA_ "GenMsgCycleTime" BO_ 853 50;
BA_ "VFrameFormat" BO_ 853 14;
BA_ "GenMsgCycleTime" BO_ 854 50;
BA_ "VFrameFormat" BO_ 854 14;
BA_ "GenMsgCycleTime" BO_ 855 50;
BA_ "VFrameFormat" BO_ 855 14;
BA_ "GenMsgCycleTime" BO_ 856 50;
BA_ "VFrameFormat" BO_ 856 14;
BA_ "GenMsgCycleTime" BO_ 857 50;
BA_ "VFrameFormat" BO_ 857 14;
BA_ "GenMsgCycleTime" BO_ 858 50;
BA_ "VFrameFormat" BO_ 858 14;
BA_ "GenMsgCycleTime" BO_ 859 50;
BA_ "VFrameFormat" BO_ 859 14;
BA_ "SystemSignalLongSymbol" SG_ 1112 ARC_OD_MaintenanceState_Obj_14_R "ARC_OD_MaintenanceState_Obj_14_RR";
BA_ "SystemSignalLongSymbol" SG_ 1112 ARC_OD_MaintenanceState_Obj_15_R "ARC_OD_MaintenanceState_Obj_15_RR";
BA_ "SystemSignalLongSymbol" SG_ 1111 ARC_OD_MaintenanceState_Obj_12_R "ARC_OD_MaintenanceState_Obj_12_RR";
BA_ "SystemSignalLongSymbol" SG_ 1111 ARC_OD_MaintenanceState_Obj_13_R "ARC_OD_MaintenanceState_Obj_13_RR";
BA_ "SystemSignalLongSymbol" SG_ 1110 ARC_OD_MaintenanceState_Obj_10_R "ARC_OD_MaintenanceState_Obj_10_RR";
BA_ "SystemSignalLongSymbol" SG_ 1110 ARC_OD_MaintenanceState_Obj_11_R "ARC_OD_MaintenanceState_Obj_11_RR";
BA_ "SystemSignalLongSymbol" SG_ 1109 ARC_OD_MaintenanceState_Obj_08_R "ARC_OD_MaintenanceState_Obj_08_RR";
BA_ "SystemSignalLongSymbol" SG_ 1109 ARC_OD_MaintenanceState_Obj_09_R "ARC_OD_MaintenanceState_Obj_09_RR";
BA_ "SystemSignalLongSymbol" SG_ 1108 ARC_OD_MaintenanceState_Obj_06_R "ARC_OD_MaintenanceState_Obj_06_RR";
BA_ "SystemSignalLongSymbol" SG_ 1108 ARC_OD_MaintenanceState_Obj_07_R "ARC_OD_MaintenanceState_Obj_07_RR";
BA_ "SystemSignalLongSymbol" SG_ 1107 ARC_OD_MaintenanceState_Obj_04_R "ARC_OD_MaintenanceState_Obj_04_RR";
BA_ "SystemSignalLongSymbol" SG_ 1107 ARC_OD_MaintenanceState_Obj_05_R "ARC_OD_MaintenanceState_Obj_05_RR";
BA_ "SystemSignalLongSymbol" SG_ 1106 ARC_OD_MaintenanceState_Obj_02_R "ARC_OD_MaintenanceState_Obj_02_RR";
BA_ "SystemSignalLongSymbol" SG_ 1106 ARC_OD_MaintenanceState_Obj_03_R "ARC_OD_MaintenanceState_Obj_03_RR";
BA_ "SystemSignalLongSymbol" SG_ 1105 ARC_OD_MaintenanceState_Obj_00_R "ARC_OD_MaintenanceState_Obj_00_RR";
BA_ "SystemSignalLongSymbol" SG_ 1105 ARC_OD_MaintenanceState_Obj_01_R "ARC_OD_MaintenanceState_Obj_01_RR";
BA_ "SystemSignalLongSymbol" SG_ 849 ARC_OD_MaintenanceState_Obj_0061 "ARC_OD_MaintenanceState_Obj_00_RL";
BA_ "SystemSignalLongSymbol" SG_ 849 ARC_OD_MaintenanceState_Obj_0062 "ARC_OD_MaintenanceState_Obj_01_RL";
BA_ "SystemSignalLongSymbol" SG_ 850 ARC_OD_MaintenanceState_Obj_0063 "ARC_OD_MaintenanceState_Obj_02_RL";
BA_ "SystemSignalLongSymbol" SG_ 850 ARC_OD_MaintenanceState_Obj_0064 "ARC_OD_MaintenanceState_Obj_03_RL";
BA_ "SystemSignalLongSymbol" SG_ 851 ARC_OD_MaintenanceState_Obj_0065 "ARC_OD_MaintenanceState_Obj_04_RL";
BA_ "SystemSignalLongSymbol" SG_ 851 ARC_OD_MaintenanceState_Obj_0066 "ARC_OD_MaintenanceState_Obj_05_RL";
BA_ "SystemSignalLongSymbol" SG_ 852 ARC_OD_MaintenanceState_Obj_0067 "ARC_OD_MaintenanceState_Obj_06_RL";
BA_ "SystemSignalLongSymbol" SG_ 852 ARC_OD_MaintenanceState_Obj_0068 "ARC_OD_MaintenanceState_Obj_07_RL";
BA_ "SystemSignalLongSymbol" SG_ 853 ARC_OD_MaintenanceState_Obj_0069 "ARC_OD_MaintenanceState_Obj_08_RL";
BA_ "SystemSignalLongSymbol" SG_ 853 ARC_OD_MaintenanceState_Obj_0070 "ARC_OD_MaintenanceState_Obj_09_RL";
BA_ "SystemSignalLongSymbol" SG_ 854 ARC_OD_MaintenanceState_Obj_0071 "ARC_OD_MaintenanceState_Obj_10_RL";
BA_ "SystemSignalLongSymbol" SG_ 854 ARC_OD_MaintenanceState_Obj_0072 "ARC_OD_MaintenanceState_Obj_11_RL";
BA_ "SystemSignalLongSymbol" SG_ 855 ARC_OD_MaintenanceState_Obj_0073 "ARC_OD_MaintenanceState_Obj_12_RL";
BA_ "SystemSignalLongSymbol" SG_ 855 ARC_OD_MaintenanceState_Obj_0074 "ARC_OD_MaintenanceState_Obj_13_RL";
BA_ "SystemSignalLongSymbol" SG_ 856 ARC_OD_MaintenanceState_Obj_0075 "ARC_OD_MaintenanceState_Obj_14_RL";
BA_ "SystemSignalLongSymbol" SG_ 856 ARC_OD_MaintenanceState_Obj_0076 "ARC_OD_MaintenanceState_Obj_15_RL";
BA_ "SystemSignalLongSymbol" SG_ 857 ARC_OD_MaintenanceState_Obj_0077 "ARC_OD_MaintenanceState_Obj_16_RL";
BA_ "SystemSignalLongSymbol" SG_ 857 ARC_OD_MaintenanceState_Obj_0078 "ARC_OD_MaintenanceState_Obj_17_RL";
BA_ "SystemSignalLongSymbol" SG_ 858 ARC_OD_MaintenanceState_Obj_0079 "ARC_OD_MaintenanceState_Obj_18_RL";
BA_ "SystemSignalLongSymbol" SG_ 858 ARC_OD_MaintenanceState_Obj_0080 "ARC_OD_MaintenanceState_Obj_19_RL";
BA_ "SystemSignalLongSymbol" SG_ 859 ARC_OD_MaintenanceState_Obj_0081 "ARC_OD_MaintenanceState_Obj_20_RL";
BA_ "SystemSignalLongSymbol" SG_ 859 ARC_OD_MaintenanceState_Obj_0082 "ARC_OD_MaintenanceState_Obj_21_RL";
VAL_ 1112 ARC_OD_Classification_Obj_14_RR 0 "Unknow" 1 "Person" 2 "Bimo" 3 "Car" 4 "Truck" 5 "Barrier" 6 "Reserved" 7 "Reserved" ;
VAL_ 1112 ARC_OD_DynProp_Obj_14_RR 0 "MOVING" 1 "STATIONARY" 2 "ONCOMING" 3 "CROSSING_LEFT2RIGHT" 4 "CROSSING_RIGHT2LEFT" 5 "UNKNOWN" 6 "STOPPED" 7 "RESERVED" ;
VAL_ 1112 ARC_OD_MaintenanceState_Obj_14_R 0 "INVALID" 1 "NEW" 2 "MEASURED" 3 "PREDICTED" ;
VAL_ 1112 ARC_OD_Classification_Obj_15_RR 0 "Unknow" 1 "Person" 2 "Bimo" 3 "Car" 4 "Truck" 5 "Barrier" 6 "Reserved" 7 "Reserved" ;
VAL_ 1112 ARC_OD_DynProp_Obj_15_RR 0 "STATIONAR" 1 "MOVIN" 2 "ONCOMING" 3 "STOPPE" 4 "CROSSING_LEFT2RIGH" 5 "CROSSING_RIGHT2LEF" 6 "RESERVE" 7 "RESERVED" ;
VAL_ 1112 ARC_OD_MaintenanceState_Obj_15_R 0 "INVALID" 1 "NEW" 2 "MEASURED" 3 "PREDICTED" ;
VAL_ 1111 ARC_OD_Classification_Obj_12_RR 0 "Unknow" 1 "Person" 2 "Bimo" 3 "Car" 4 "Truck" 5 "Barrier" 6 "Reserved" 7 "Reserved" ;
VAL_ 1111 ARC_OD_DynProp_Obj_12_RR 0 "MOVING" 1 "STATIONARY" 2 "ONCOMING" 3 "CROSSING_LEFT2RIGHT" 4 "CROSSING_RIGHT2LEFT" 5 "UNKNOWN" 6 "STOPPED" 7 "RESERVED" ;
VAL_ 1111 ARC_OD_MaintenanceState_Obj_12_R 0 "INVALID" 1 "NEW" 2 "MEASURED" 3 "PREDICTED" ;
VAL_ 1111 ARC_OD_Classification_Obj_13_RR 0 "Unknow" 1 "Person" 2 "Bimo" 3 "Car" 4 "Truck" 5 "Barrier" 6 "Reserved" 7 "Reserved" ;
VAL_ 1111 ARC_OD_DynProp_Obj_13_RR 0 "STATIONAR" 1 "MOVIN" 2 "ONCOMING" 3 "STOPPE" 4 "CROSSING_LEFT2RIGH" 5 "CROSSING_RIGHT2LEF" 6 "RESERVE" 7 "RESERVED" ;
VAL_ 1111 ARC_OD_MaintenanceState_Obj_13_R 0 "INVALID" 1 "NEW" 2 "MEASURED" 3 "PREDICTED" ;
VAL_ 1110 ARC_OD_Classification_Obj_10_RR 0 "Unknow" 1 "Person" 2 "Bimo" 3 "Car" 4 "Truck" 5 "Barrier" 6 "Reserved" 7 "Reserved" ;
VAL_ 1110 ARC_OD_DynProp_Obj_10_RR 0 "MOVING" 1 "STATIONARY" 2 "ONCOMING" 3 "CROSSING_LEFT2RIGHT" 4 "CROSSING_RIGHT2LEFT" 5 "UNKNOWN" 6 "STOPPED" 7 "RESERVED" ;
VAL_ 1110 ARC_OD_MaintenanceState_Obj_10_R 0 "INVALID" 1 "NEW" 2 "MEASURED" 3 "PREDICTED" ;
VAL_ 1110 ARC_OD_Classification_Obj_11_RR 0 "Unknow" 1 "Person" 2 "Bimo" 3 "Car" 4 "Truck" 5 "Barrier" 6 "Reserved" 7 "Reserved" ;
VAL_ 1110 ARC_OD_DynProp_Obj_11_RR 0 "STATIONAR" 1 "MOVIN" 2 "ONCOMING" 3 "STOPPE" 4 "CROSSING_LEFT2RIGH" 5 "CROSSING_RIGHT2LEF" 6 "RESERVE" 7 "RESERVED" ;
VAL_ 1110 ARC_OD_MaintenanceState_Obj_11_R 0 "INVALID" 1 "NEW" 2 "MEASURED" 3 "PREDICTED" ;
VAL_ 1109 ARC_OD_Classification_Obj_08_RR 0 "Unknow" 1 "Person" 2 "Bimo" 3 "Car" 4 "Truck" 5 "Barrier" 6 "Reserved" 7 "Reserved" ;
VAL_ 1109 ARC_OD_DynProp_Obj_08_RR 0 "MOVING" 1 "STATIONARY" 2 "ONCOMING" 3 "CROSSING_LEFT2RIGHT" 4 "CROSSING_RIGHT2LEFT" 5 "UNKNOWN" 6 "STOPPED" 7 "RESERVED" ;
VAL_ 1109 ARC_OD_MaintenanceState_Obj_08_R 0 "INVALID" 1 "NEW" 2 "MEASURED" 3 "PREDICTED" ;
VAL_ 1109 ARC_OD_Classification_Obj_09_RR 0 "Unknow" 1 "Person" 2 "Bimo" 3 "Car" 4 "Truck" 5 "Barrier" 6 "Reserved" 7 "Reserved" ;
VAL_ 1109 ARC_OD_DynProp_Obj_09_RR 0 "STATIONAR" 1 "MOVIN" 2 "ONCOMING" 3 "STOPPE" 4 "CROSSING_LEFT2RIGH" 5 "CROSSING_RIGHT2LEF" 6 "RESERVE" 7 "RESERVED" ;
VAL_ 1109 ARC_OD_MaintenanceState_Obj_09_R 0 "INVALID" 1 "NEW" 2 "MEASURED" 3 "PREDICTED" ;
VAL_ 1108 ARC_OD_Classification_Obj_06_RR 0 "Unknow" 1 "Person" 2 "Bimo" 3 "Car" 4 "Truck" 5 "Barrier" 6 "Reserved" 7 "Reserved" ;
VAL_ 1108 ARC_OD_DynProp_Obj_06_RR 0 "MOVING" 1 "STATIONARY" 2 "ONCOMING" 3 "CROSSING_LEFT2RIGHT" 4 "CROSSING_RIGHT2LEFT" 5 "UNKNOWN" 6 "STOPPED" 7 "RESERVED" ;
VAL_ 1108 ARC_OD_MaintenanceState_Obj_06_R 0 "INVALID" 1 "NEW" 2 "MEASURED" 3 "PREDICTED" ;
VAL_ 1108 ARC_OD_Classification_Obj_07_RR 0 "Unknow" 1 "Person" 2 "Bimo" 3 "Car" 4 "Truck" 5 "Barrier" 6 "Reserved" 7 "Reserved" ;
VAL_ 1108 ARC_OD_DynProp_Obj_07_RR 0 "STATIONAR" 1 "MOVIN" 2 "ONCOMING" 3 "STOPPE" 4 "CROSSING_LEFT2RIGH" 5 "CROSSING_RIGHT2LEF" 6 "RESERVE" 7 "RESERVED" ;
VAL_ 1108 ARC_OD_MaintenanceState_Obj_07_R 0 "INVALID" 1 "NEW" 2 "MEASURED" 3 "PREDICTED" ;
VAL_ 1107 ARC_OD_Classification_Obj_04_RR 0 "Unknow" 1 "Person" 2 "Bimo" 3 "Car" 4 "Truck" 5 "Barrier" 6 "Reserved" 7 "Reserved" ;
VAL_ 1107 ARC_OD_DynProp_Obj_04_RR 0 "MOVING" 1 "STATIONARY" 2 "ONCOMING" 3 "CROSSING_LEFT2RIGHT" 4 "CROSSING_RIGHT2LEFT" 5 "UNKNOWN" 6 "STOPPED" 7 "RESERVED" ;
VAL_ 1107 ARC_OD_MaintenanceState_Obj_04_R 0 "INVALID" 1 "NEW" 2 "MEASURED" 3 "PREDICTED" ;
VAL_ 1107 ARC_OD_Classification_Obj_05_RR 0 "Unknow" 1 "Person" 2 "Bimo" 3 "Car" 4 "Truck" 5 "Barrier" 6 "Reserved" 7 "Reserved" ;
VAL_ 1107 ARC_OD_DynProp_Obj_05_RR 0 "STATIONAR" 1 "MOVIN" 2 "ONCOMING" 3 "STOPPE" 4 "CROSSING_LEFT2RIGH" 5 "CROSSING_RIGHT2LEF" 6 "RESERVE" 7 "RESERVED" ;
VAL_ 1107 ARC_OD_MaintenanceState_Obj_05_R 0 "INVALID" 1 "NEW" 2 "MEASURED" 3 "PREDICTED" ;
VAL_ 1106 ARC_OD_Classification_Obj_02_RR 0 "Unknow" 1 "Person" 2 "Bimo" 3 "Car" 4 "Truck" 5 "Barrier" 6 "Reserved" 7 "Reserved" ;
VAL_ 1106 ARC_OD_DynProp_Obj_02_RR 0 "MOVING" 1 "STATIONARY" 2 "ONCOMING" 3 "CROSSING_LEFT2RIGHT" 4 "CROSSING_RIGHT2LEFT" 5 "UNKNOWN" 6 "STOPPED" 7 "RESERVED" ;
VAL_ 1106 ARC_OD_MaintenanceState_Obj_02_R 0 "INVALID" 1 "NEW" 2 "MEASURED" 3 "PREDICTED" ;
VAL_ 1106 ARC_OD_Classification_Obj_03_RR 0 "Unknow" 1 "Person" 2 "Bimo" 3 "Car" 4 "Truck" 5 "Barrier" 6 "Reserved" 7 "Reserved" ;
VAL_ 1106 ARC_OD_DynProp_Obj_03_RR 0 "STATIONAR" 1 "MOVIN" 2 "ONCOMING" 3 "STOPPE" 4 "CROSSING_LEFT2RIGH" 5 "CROSSING_RIGHT2LEF" 6 "RESERVE" 7 "RESERVED" ;
VAL_ 1106 ARC_OD_MaintenanceState_Obj_03_R 0 "INVALID" 1 "NEW" 2 "MEASURED" 3 "PREDICTED" ;
VAL_ 1105 ARC_OD_Classification_Obj_00_RR 0 "Unknow" 1 "Person" 2 "Bimo" 3 "Car" 4 "Truck" 5 "Barrier" 6 "Reserved" 7 "Reserved" ;
VAL_ 1105 ARC_OD_DynProp_Obj_00_RR 0 "MOVING" 1 "STATIONARY" 2 "ONCOMING" 3 "CROSSING_LEFT2RIGHT" 4 "CROSSING_RIGHT2LEFT" 5 "UNKNOWN" 6 "STOPPED" 7 "RESERVED" ;
VAL_ 1105 ARC_OD_MaintenanceState_Obj_00_R 0 "INVALID" 1 "NEW" 2 "MEASURED" 3 "PREDICTED" ;
VAL_ 1105 ARC_OD_Classification_Obj_01_RR 0 "Unknow" 1 "Person" 2 "Bimo" 3 "Car" 4 "Truck" 5 "Barrier" 6 "Reserved" 7 "Reserved" ;
VAL_ 1105 ARC_OD_DynProp_Obj_01_RR 0 "STATIONAR" 1 "MOVIN" 2 "ONCOMING" 3 "STOPPE" 4 "CROSSING_LEFT2RIGH" 5 "CROSSING_RIGHT2LEF" 6 "RESERVE" 7 "RESERVED" ;
VAL_ 1105 ARC_OD_MaintenanceState_Obj_01_R 0 "INVALID" 1 "NEW" 2 "MEASURED" 3 "PREDICTED" ;
VAL_ 1616 ARC_OD_TaskValidFlag_FL 0 "INVALI" 1 "VALI" ;
VAL_ 1616 ARC_OD_ExtendedCycleFlag_FL 0 "FALS" 1 "TRU" ;
VAL_ 1360 ARC_OD_TaskValidFlag_FR 0 "INVALI" 1 "VALI" ;
VAL_ 1360 ARC_OD_ExtendedCycleFlag_FR 0 "FALS" 1 "TRU" ;
VAL_ 1104 ARC_OD_TaskValidFlag_RR 0 "INVALI" 1 "VALI" ;
VAL_ 1104 ARC_OD_ExtendedCycleFlag_RR 0 "FALS" 1 "TRU" ;
VAL_ 102 ARC_ERROR_STATE_FR 1 "ERROR" 0 "NO ERROR" ;
VAL_ 102 ARC_CFG_Mode_FR 1 "MODE A" 2 "MODE B" 4 "MODE C" 8 "RESERVE" 16 "RESERVE" 64 "RESERVE" 128 "REAR" ;
VAL_ 102 ARC_CFG_TmeSynEnFl_FR 0 "DISABLE" 1 "ENABLE" ;
VAL_ 105 ARC_ERROR_STATE_FL 1 "ERROR" 0 "NO ERROR" ;
VAL_ 105 ARC_CFG_Mode_FL 1 "MODE A" 2 "MODE B" 4 "MODE C" 8 "RESERVE" 16 "RESERVE" 64 "RESERVE" 128 "REAR" ;
VAL_ 105 ARC_CFG_TmeSynEnFl_FL 0 "DISABLE" 1 "ENABLE" ;
VAL_ 99 ARC_ERROR_STATE_RR 1 "ERROR" 0 "NO ERROR" ;
VAL_ 99 ARC_CFG_Mode_RR 1 "MODE A" 2 "MODE B" 4 "MODE C" 8 "RESERVE" 16 "RESERVE" 64 "RESERVE" 128 "REAR" ;
VAL_ 99 ARC_CFG_TmeSynEnFl_RR 0 "DISABLE" 1 "ENABLE" ;
VAL_ 96 ARC_ERROR_STATE_RL 1 "ERROR" 0 "NO ERROR" ;
VAL_ 96 ARC_CFG_Mode_RL 1 "MODE A" 2 "MODE B" 4 "MODE C" 8 "RESERVE" 16 "RESERVE" 64 "RESERVE" 128 "REAR" ;
VAL_ 96 ARC_CFG_TmeSynEnFl_RL 0 "DISABLE" 1 "ENABLE" ;
VAL_ 848 ARC_OD_TaskValidFlag_RL 0 "INVALI" 1 "VALI" ;
VAL_ 848 ARC_OD_ExtendedCycleFlag_RL 0 "FALS" 1 "TRU" ;
VAL_ 849 ARC_OD_Classification_Obj_00_RL 0 "Unknow" 1 "Person" 2 "Bimo" 3 "Car" 4 "Truck" 5 "Barrier" 6 "Reserved" 7 "Reserved" ;
VAL_ 849 ARC_OD_DynProp_Obj_00_RL 0 "MOVING" 1 "STATIONARY" 2 "ONCOMING" 3 "CROSSING_LEFT2RIGHT" 4 "CROSSING_RIGHT2LEFT" 5 "UNKNOWN" 6 "STOPPED" 7 "RESERVED" ;
VAL_ 849 ARC_OD_MaintenanceState_Obj_0061 0 "INVALID" 1 "NEW" 2 "MEASURED" 3 "PREDICTED" ;
VAL_ 849 ARC_OD_Classification_Obj_01_RL 0 "Unknow" 1 "Person" 2 "Bimo" 3 "Car" 4 "Truck" 5 "Barrier" 6 "Reserved" 7 "Reserved" ;
VAL_ 849 ARC_OD_DynProp_Obj_01_RL 0 "STATIONAR" 1 "MOVIN" 2 "ONCOMING" 3 "STOPPE" 4 "CROSSING_LEFT2RIGH" 5 "CROSSING_RIGHT2LEF" 6 "RESERVE" 7 "RESERVED" ;
VAL_ 849 ARC_OD_MaintenanceState_Obj_0062 0 "INVALID" 1 "NEW" 2 "MEASURED" 3 "PREDICTED" ;
VAL_ 850 ARC_OD_Classification_Obj_02_RL 0 "Unknow" 1 "Person" 2 "Bimo" 3 "Car" 4 "Truck" 5 "Barrier" 6 "Reserved" 7 "Reserved" ;
VAL_ 850 ARC_OD_DynProp_Obj_02_RL 0 "MOVING" 1 "STATIONARY" 2 "ONCOMING" 3 "CROSSING_LEFT2RIGHT" 4 "CROSSING_RIGHT2LEFT" 5 "UNKNOWN" 6 "STOPPED" 7 "RESERVED" ;
VAL_ 850 ARC_OD_MaintenanceState_Obj_0063 0 "INVALID" 1 "NEW" 2 "MEASURED" 3 "PREDICTED" ;
VAL_ 850 ARC_OD_Classification_Obj_03_RL 0 "Unknow" 1 "Person" 2 "Bimo" 3 "Car" 4 "Truck" 5 "Barrier" 6 "Reserved" 7 "Reserved" ;
VAL_ 850 ARC_OD_DynProp_Obj_03_RL 0 "STATIONAR" 1 "MOVIN" 2 "ONCOMING" 3 "STOPPE" 4 "CROSSING_LEFT2RIGH" 5 "CROSSING_RIGHT2LEF" 6 "RESERVE" 7 "RESERVED" ;
VAL_ 850 ARC_OD_MaintenanceState_Obj_0064 0 "INVALID" 1 "NEW" 2 "MEASURED" 3 "PREDICTED" ;
VAL_ 851 ARC_OD_Classification_Obj_04_RL 0 "Unknow" 1 "Person" 2 "Bimo" 3 "Car" 4 "Truck" 5 "Barrier" 6 "Reserved" 7 "Reserved" ;
VAL_ 851 ARC_OD_DynProp_Obj_04_RL 0 "MOVING" 1 "STATIONARY" 2 "ONCOMING" 3 "CROSSING_LEFT2RIGHT" 4 "CROSSING_RIGHT2LEFT" 5 "UNKNOWN" 6 "STOPPED" 7 "RESERVED" ;
VAL_ 851 ARC_OD_MaintenanceState_Obj_0065 0 "INVALID" 1 "NEW" 2 "MEASURED" 3 "PREDICTED" ;
VAL_ 851 ARC_OD_Classification_Obj_05_RL 0 "Unknow" 1 "Person" 2 "Bimo" 3 "Car" 4 "Truck" 5 "Barrier" 6 "Reserved" 7 "Reserved" ;
VAL_ 851 ARC_OD_DynProp_Obj_05_RL 0 "STATIONAR" 1 "MOVIN" 2 "ONCOMING" 3 "STOPPE" 4 "CROSSING_LEFT2RIGH" 5 "CROSSING_RIGHT2LEF" 6 "RESERVE" 7 "RESERVED" ;
VAL_ 851 ARC_OD_MaintenanceState_Obj_0066 0 "INVALID" 1 "NEW" 2 "MEASURED" 3 "PREDICTED" ;
VAL_ 852 ARC_OD_Classification_Obj_06_RL 0 "Unknow" 1 "Person" 2 "Bimo" 3 "Car" 4 "Truck" 5 "Barrier" 6 "Reserved" 7 "Reserved" ;
VAL_ 852 ARC_OD_DynProp_Obj_06_RL 0 "MOVING" 1 "STATIONARY" 2 "ONCOMING" 3 "CROSSING_LEFT2RIGHT" 4 "CROSSING_RIGHT2LEFT" 5 "UNKNOWN" 6 "STOPPED" 7 "RESERVED" ;
VAL_ 852 ARC_OD_MaintenanceState_Obj_0067 0 "INVALID" 1 "NEW" 2 "MEASURED" 3 "PREDICTED" ;
VAL_ 852 ARC_OD_Classification_Obj_07_RL 0 "Unknow" 1 "Person" 2 "Bimo" 3 "Car" 4 "Truck" 5 "Barrier" 6 "Reserved" 7 "Reserved" ;
VAL_ 852 ARC_OD_DynProp_Obj_07_RL 0 "STATIONAR" 1 "MOVIN" 2 "ONCOMING" 3 "STOPPE" 4 "CROSSING_LEFT2RIGH" 5 "CROSSING_RIGHT2LEF" 6 "RESERVE" 7 "RESERVED" ;
VAL_ 852 ARC_OD_MaintenanceState_Obj_0068 0 "INVALID" 1 "NEW" 2 "MEASURED" 3 "PREDICTED" ;
VAL_ 853 ARC_OD_Classification_Obj_08_RL 0 "Unknow" 1 "Person" 2 "Bimo" 3 "Car" 4 "Truck" 5 "Barrier" 6 "Reserved" 7 "Reserved" ;
VAL_ 853 ARC_OD_DynProp_Obj_08_RL 0 "MOVING" 1 "STATIONARY" 2 "ONCOMING" 3 "CROSSING_LEFT2RIGHT" 4 "CROSSING_RIGHT2LEFT" 5 "UNKNOWN" 6 "STOPPED" 7 "RESERVED" ;
VAL_ 853 ARC_OD_MaintenanceState_Obj_0069 0 "INVALID" 1 "NEW" 2 "MEASURED" 3 "PREDICTED" ;
VAL_ 853 ARC_OD_Classification_Obj_09_RL 0 "Unknow" 1 "Person" 2 "Bimo" 3 "Car" 4 "Truck" 5 "Barrier" 6 "Reserved" 7 "Reserved" ;
VAL_ 853 ARC_OD_DynProp_Obj_09_RL 0 "STATIONAR" 1 "MOVIN" 2 "ONCOMING" 3 "STOPPE" 4 "CROSSING_LEFT2RIGH" 5 "CROSSING_RIGHT2LEF" 6 "RESERVE" 7 "RESERVED" ;
VAL_ 853 ARC_OD_MaintenanceState_Obj_0070 0 "INVALID" 1 "NEW" 2 "MEASURED" 3 "PREDICTED" ;
VAL_ 854 ARC_OD_Classification_Obj_10_RL 0 "Unknow" 1 "Person" 2 "Bimo" 3 "Car" 4 "Truck" 5 "Barrier" 6 "Reserved" 7 "Reserved" ;
VAL_ 854 ARC_OD_DynProp_Obj_10_RL 0 "MOVING" 1 "STATIONARY" 2 "ONCOMING" 3 "CROSSING_LEFT2RIGHT" 4 "CROSSING_RIGHT2LEFT" 5 "UNKNOWN" 6 "STOPPED" 7 "RESERVED" ;
VAL_ 854 ARC_OD_MaintenanceState_Obj_0071 0 "INVALID" 1 "NEW" 2 "MEASURED" 3 "PREDICTED" ;
VAL_ 854 ARC_OD_Classification_Obj_11_RL 0 "Unknow" 1 "Person" 2 "Bimo" 3 "Car" 4 "Truck" 5 "Barrier" 6 "Reserved" 7 "Reserved" ;
VAL_ 854 ARC_OD_DynProp_Obj_11_RL 0 "STATIONAR" 1 "MOVIN" 2 "ONCOMING" 3 "STOPPE" 4 "CROSSING_LEFT2RIGH" 5 "CROSSING_RIGHT2LEF" 6 "RESERVE" 7 "RESERVED" ;
VAL_ 854 ARC_OD_MaintenanceState_Obj_0072 0 "INVALID" 1 "NEW" 2 "MEASURED" 3 "PREDICTED" ;
VAL_ 855 ARC_OD_Classification_Obj_12_RL 0 "Unknow" 1 "Person" 2 "Bimo" 3 "Car" 4 "Truck" 5 "Barrier" 6 "Reserved" 7 "Reserved" ;
VAL_ 855 ARC_OD_DynProp_Obj_12_RL 0 "MOVING" 1 "STATIONARY" 2 "ONCOMING" 3 "CROSSING_LEFT2RIGHT" 4 "CROSSING_RIGHT2LEFT" 5 "UNKNOWN" 6 "STOPPED" 7 "RESERVED" ;
VAL_ 855 ARC_OD_MaintenanceState_Obj_0073 0 "INVALID" 1 "NEW" 2 "MEASURED" 3 "PREDICTED" ;
VAL_ 855 ARC_OD_Classification_Obj_13_RL 0 "Unknow" 1 "Person" 2 "Bimo" 3 "Car" 4 "Truck" 5 "Barrier" 6 "Reserved" 7 "Reserved" ;
VAL_ 855 ARC_OD_DynProp_Obj_13_RL 0 "STATIONAR" 1 "MOVIN" 2 "ONCOMING" 3 "STOPPE" 4 "CROSSING_LEFT2RIGH" 5 "CROSSING_RIGHT2LEF" 6 "RESERVE" 7 "RESERVED" ;
VAL_ 855 ARC_OD_MaintenanceState_Obj_0074 0 "INVALID" 1 "NEW" 2 "MEASURED" 3 "PREDICTED" ;
VAL_ 856 ARC_OD_Classification_Obj_14_RL 0 "Unknow" 1 "Person" 2 "Bimo" 3 "Car" 4 "Truck" 5 "Barrier" 6 "Reserved" 7 "Reserved" ;
VAL_ 856 ARC_OD_DynProp_Obj_14_RL 0 "MOVING" 1 "STATIONARY" 2 "ONCOMING" 3 "CROSSING_LEFT2RIGHT" 4 "CROSSING_RIGHT2LEFT" 5 "UNKNOWN" 6 "STOPPED" 7 "RESERVED" ;
VAL_ 856 ARC_OD_MaintenanceState_Obj_0075 0 "INVALID" 1 "NEW" 2 "MEASURED" 3 "PREDICTED" ;
VAL_ 856 ARC_OD_Classification_Obj_15_RL 0 "Unknow" 1 "Person" 2 "Bimo" 3 "Car" 4 "Truck" 5 "Barrier" 6 "Reserved" 7 "Reserved" ;
VAL_ 856 ARC_OD_DynProp_Obj_15_RL 0 "STATIONAR" 1 "MOVIN" 2 "ONCOMING" 3 "STOPPE" 4 "CROSSING_LEFT2RIGH" 5 "CROSSING_RIGHT2LEF" 6 "RESERVE" 7 "RESERVED" ;
VAL_ 856 ARC_OD_MaintenanceState_Obj_0076 0 "INVALID" 1 "NEW" 2 "MEASURED" 3 "PREDICTED" ;
VAL_ 857 ARC_OD_Classification_Obj_16_RL 0 "Unknow" 1 "Person" 2 "Bimo" 3 "Car" 4 "Truck" 5 "Barrier" 6 "Reserved" 7 "Reserved" ;
VAL_ 857 ARC_OD_DynProp_Obj_16_RL 0 "MOVING" 1 "STATIONARY" 2 "ONCOMING" 3 "CROSSING_LEFT2RIGHT" 4 "CROSSING_RIGHT2LEFT" 5 "UNKNOWN" 6 "STOPPED" 7 "RESERVED" ;
VAL_ 857 ARC_OD_MaintenanceState_Obj_0077 0 "INVALID" 1 "NEW" 2 "MEASURED" 3 "PREDICTED" ;
VAL_ 857 ARC_OD_Classification_Obj_17_RL 0 "Unknow" 1 "Person" 2 "Bimo" 3 "Car" 4 "Truck" 5 "Barrier" 6 "Reserved" 7 "Reserved" ;
VAL_ 857 ARC_OD_DynProp_Obj_17_RL 0 "STATIONAR" 1 "MOVIN" 2 "ONCOMING" 3 "STOPPE" 4 "CROSSING_LEFT2RIGH" 5 "CROSSING_RIGHT2LEF" 6 "RESERVE" 7 "RESERVED" ;
VAL_ 857 ARC_OD_MaintenanceState_Obj_0078 0 "INVALID" 1 "NEW" 2 "MEASURED" 3 "PREDICTED" ;
VAL_ 858 ARC_OD_Classification_Obj_18_RL 0 "Unknow" 1 "Person" 2 "Bimo" 3 "Car" 4 "Truck" 5 "Barrier" 6 "Reserved" 7 "Reserved" ;
VAL_ 858 ARC_OD_DynProp_Obj_18_RL 0 "MOVING" 1 "STATIONARY" 2 "ONCOMING" 3 "CROSSING_LEFT2RIGHT" 4 "CROSSING_RIGHT2LEFT" 5 "UNKNOWN" 6 "STOPPED" 7 "RESERVED" ;
VAL_ 858 ARC_OD_MaintenanceState_Obj_0079 0 "INVALID" 1 "NEW" 2 "MEASURED" 3 "PREDICTED" ;
VAL_ 858 ARC_OD_Classification_Obj_19_RL 0 "Unknow" 1 "Person" 2 "Bimo" 3 "Car" 4 "Truck" 5 "Barrier" 6 "Reserved" 7 "Reserved" ;
VAL_ 858 ARC_OD_DynProp_Obj_19_RL 0 "STATIONAR" 1 "MOVIN" 2 "ONCOMING" 3 "STOPPE" 4 "CROSSING_LEFT2RIGH" 5 "CROSSING_RIGHT2LEF" 6 "RESERVE" 7 "RESERVED" ;
VAL_ 858 ARC_OD_MaintenanceState_Obj_0080 0 "INVALID" 1 "NEW" 2 "MEASURED" 3 "PREDICTED" ;
VAL_ 859 ARC_OD_Classification_Obj_20_RL 0 "Unknow" 1 "Person" 2 "Bimo" 3 "Car" 4 "Truck" 5 "Barrier" 6 "Reserved" 7 "Reserved" ;
VAL_ 859 ARC_OD_DynProp_Obj_20_RL 0 "MOVING" 1 "STATIONARY" 2 "ONCOMING" 3 "CROSSING_LEFT2RIGHT" 4 "CROSSING_RIGHT2LEFT" 5 "UNKNOWN" 6 "STOPPED" 7 "RESERVED" ;
VAL_ 859 ARC_OD_MaintenanceState_Obj_0081 0 "INVALID" 1 "NEW" 2 "MEASURED" 3 "PREDICTED" ;
VAL_ 859 ARC_OD_Classification_Obj_21_RL 0 "Unknow" 1 "Person" 2 "Bimo" 3 "Car" 4 "Truck" 5 "Barrier" 6 "Reserved" 7 "Reserved" ;
VAL_ 859 ARC_OD_DynProp_Obj_21_RL 0 "STATIONAR" 1 "MOVIN" 2 "ONCOMING" 3 "STOPPE" 4 "CROSSING_LEFT2RIGH" 5 "CROSSING_RIGHT2LEF" 6 "RESERVE" 7 "RESERVED" ;
VAL_ 859 ARC_OD_MaintenanceState_Obj_0082 0 "INVALID" 1 "NEW" 2 "MEASURED" 3 "PREDICTED" ;
SIG_GROUP_ 1112 Signal_Group_ARC_OD_14_15 1 : DistHeight_Obj_15_RR DistHeight_Obj_14_RR ARC_OD_DistX_Obj_14_RR ARC_OD_Classification_Obj_14_RR ARC_OD_AabsYStd_Obj_14_RR ARC_OD_ClassConf_Obj_14_RR ARC_OD_ProbOfExist_Obj_14_RR ARC_OD_VabsX_Obj_14_RR ARC_OD_DynProp_Obj_14_RR ARC_OD_Length_Obj_14_RR ARC_OD_MaintenanceState_Obj_14_R ARC_OD_Width_Obj_14_RR ARC_OD_RCS_Obj_14_RR ARC_OD_Orientation_Obj_14_RR ARC_OD_LifeCycle_Obj_14_RR ARC_OD_DistX_Obj_15_RR ARC_OD_VabsX_Obj_15_RR ARC_OD_AabsX_Obj_15_RR ARC_OD_AabsX_Obj_14_RR ARC_OD_DistY_Obj_15_RR ARC_OD_VabsY_Obj_15_RR ARC_OD_AabsY_Obj_15_RR ARC_OD_DistXStd_Obj_15_RR ARC_OD_DistYStd_Obj_15_RR ARC_OD_VabsXStd_Obj_15_RR ARC_OD_VabsYStd_Obj_15_RR ARC_OD_AabsXStd_Obj_15_RR ARC_OD_Classification_Obj_15_RR ARC_OD_AabsYStd_Obj_15_RR ARC_OD_ClassConf_Obj_15_RR ARC_OD_DistY_Obj_14_RR ARC_OD_ProbOfExist_Obj_15_RR ARC_OD_DynProp_Obj_15_RR ARC_OD_Length_Obj_15_RR ARC_OD_MaintenanceState_Obj_15_R ARC_OD_Width_Obj_15_RR ARC_OD_RCS_Obj_15_RR ARC_OD_Orientation_Obj_15_RR ARC_OD_LifeCycle_Obj_15_RR ARC_OD_ObstacleProb_Obj_14_RR ARC_OD_ObstacleProb_Obj_15_RR ARC_OD_VabsY_Obj_14_RR ARC_OD_ID_14_RR ARC_OD_ID_15_RR ARC_OD_MsgCounter_Obj_14_15_RR ARC_OD_CRC8_Obj_14_15_RR ARC_OD_AabsY_Obj_14_RR ARC_OD_DistXStd_Obj_14_RR ARC_OD_DistYStd_Obj_14_RR ARC_OD_VabsXStd_Obj_14_RR ARC_OD_VabsYStd_Obj_14_RR ARC_OD_AabsXStd_Obj_14_RR;
SIG_GROUP_ 1111 Signal_Group_ARC_OD_12_13 1 : DistHeight_Obj_13_RR DistHeight_Obj_12_RR ARC_OD_DistX_Obj_12_RR ARC_OD_Classification_Obj_12_RR ARC_OD_AabsYStd_Obj_12_RR ARC_OD_ClassConf_Obj_12_RR ARC_OD_ProbOfExist_Obj_12_RR ARC_OD_VabsX_Obj_12_RR ARC_OD_DynProp_Obj_12_RR ARC_OD_Length_Obj_12_RR ARC_OD_MaintenanceState_Obj_12_R ARC_OD_Width_Obj_12_RR ARC_OD_RCS_Obj_12_RR ARC_OD_Orientation_Obj_12_RR ARC_OD_LifeCycle_Obj_12_RR ARC_OD_DistX_Obj_13_RR ARC_OD_VabsX_Obj_13_RR ARC_OD_AabsX_Obj_13_RR ARC_OD_AabsX_Obj_12_RR ARC_OD_DistY_Obj_13_RR ARC_OD_VabsY_Obj_13_RR ARC_OD_AabsY_Obj_13_RR ARC_OD_DistXStd_Obj_13_RR ARC_OD_DistYStd_Obj_13_RR ARC_OD_VabsXStd_Obj_13_RR ARC_OD_VabsYStd_Obj_13_RR ARC_OD_AabsXStd_Obj_13_RR ARC_OD_Classification_Obj_13_RR ARC_OD_AabsYStd_Obj_13_RR ARC_OD_ClassConf_Obj_13_RR ARC_OD_DistY_Obj_12_RR ARC_OD_ProbOfExist_Obj_13_RR ARC_OD_DynProp_Obj_13_RR ARC_OD_Length_Obj_13_RR ARC_OD_MaintenanceState_Obj_13_R ARC_OD_Width_Obj_13_RR ARC_OD_RCS_Obj_13_RR ARC_OD_Orientation_Obj_13_RR ARC_OD_LifeCycle_Obj_13_RR ARC_OD_ObstacleProb_Obj_12_RR ARC_OD_ObstacleProb_Obj_13_RR ARC_OD_VabsY_Obj_12_RR ARC_OD_ID_12_RR ARC_OD_ID_13_RR ARC_OD_MsgCounter_Obj_12_13_RR ARC_OD_CRC8_Obj_12_13_RR ARC_OD_AabsY_Obj_12_RR ARC_OD_DistXStd_Obj_12_RR ARC_OD_DistYStd_Obj_12_RR ARC_OD_VabsXStd_Obj_12_RR ARC_OD_VabsYStd_Obj_12_RR ARC_OD_AabsXStd_Obj_12_RR;
SIG_GROUP_ 1110 Signal_Group_ARC_OD_10_11 1 : DistHeight_Obj_11_RR DistHeight_Obj_10_RR ARC_OD_DistX_Obj_10_RR ARC_OD_Classification_Obj_10_RR ARC_OD_AabsYStd_Obj_10_RR ARC_OD_ClassConf_Obj_10_RR ARC_OD_ProbOfExist_Obj_10_RR ARC_OD_VabsX_Obj_10_RR ARC_OD_DynProp_Obj_10_RR ARC_OD_Length_Obj_10_RR ARC_OD_MaintenanceState_Obj_10_R ARC_OD_Width_Obj_10_RR ARC_OD_RCS_Obj_10_RR ARC_OD_Orientation_Obj_10_RR ARC_OD_LifeCycle_Obj_10_RR ARC_OD_DistX_Obj_11_RR ARC_OD_VabsX_Obj_11_RR ARC_OD_AabsX_Obj_11_RR ARC_OD_AabsX_Obj_10_RR ARC_OD_DistY_Obj_11_RR ARC_OD_VabsY_Obj_11_RR ARC_OD_AabsY_Obj_11_RR ARC_OD_DistXStd_Obj_11_RR ARC_OD_DistYStd_Obj_11_RR ARC_OD_VabsXStd_Obj_11_RR ARC_OD_VabsYStd_Obj_11_RR ARC_OD_AabsXStd_Obj_11_RR ARC_OD_Classification_Obj_11_RR ARC_OD_AabsYStd_Obj_11_RR ARC_OD_ClassConf_Obj_11_RR ARC_OD_DistY_Obj_10_RR ARC_OD_ProbOfExist_Obj_11_RR ARC_OD_DynProp_Obj_11_RR ARC_OD_Length_Obj_11_RR ARC_OD_MaintenanceState_Obj_11_R ARC_OD_Width_Obj_11_RR ARC_OD_RCS_Obj_11_RR ARC_OD_Orientation_Obj_11_RR ARC_OD_LifeCycle_Obj_11_RR ARC_OD_ObstacleProb_Obj_10_RR ARC_OD_ObstacleProb_Obj_11_RR ARC_OD_VabsY_Obj_10_RR ARC_OD_ID_10_RR ARC_OD_ID_11_RR ARC_OD_MsgCounter_Obj_10_11_RR ARC_OD_CRC8_Obj_10_11_RR ARC_OD_AabsY_Obj_10_RR ARC_OD_DistXStd_Obj_10_RR ARC_OD_DistYStd_Obj_10_RR ARC_OD_VabsXStd_Obj_10_RR ARC_OD_VabsYStd_Obj_10_RR ARC_OD_AabsXStd_Obj_10_RR;
SIG_GROUP_ 1109 Signal_Group_ARC_OD_08_09 1 : DistHeight_Obj_09_RR DistHeight_Obj_08_RR ARC_OD_DistX_Obj_08_RR ARC_OD_Classification_Obj_08_RR ARC_OD_AabsYStd_Obj_08_RR ARC_OD_ClassConf_Obj_08_RR ARC_OD_ProbOfExist_Obj_08_RR ARC_OD_VabsX_Obj_08_RR ARC_OD_DynProp_Obj_08_RR ARC_OD_Length_Obj_08_RR ARC_OD_MaintenanceState_Obj_08_R ARC_OD_Width_Obj_08_RR ARC_OD_RCS_Obj_08_RR ARC_OD_Orientation_Obj_08_RR ARC_OD_LifeCycle_Obj_08_RR ARC_OD_DistX_Obj_09_RR ARC_OD_VabsX_Obj_09_RR ARC_OD_AabsX_Obj_09_RR ARC_OD_AabsX_Obj_08_RR ARC_OD_DistY_Obj_09_RR ARC_OD_VabsY_Obj_09_RR ARC_OD_AabsY_Obj_09_RR ARC_OD_DistXStd_Obj_09_RR ARC_OD_DistYStd_Obj_09_RR ARC_OD_VabsXStd_Obj_09_RR ARC_OD_VabsYStd_Obj_09_RR ARC_OD_AabsXStd_Obj_09_RR ARC_OD_Classification_Obj_09_RR ARC_OD_AabsYStd_Obj_09_RR ARC_OD_ClassConf_Obj_09_RR ARC_OD_DistY_Obj_08_RR ARC_OD_ProbOfExist_Obj_09_RR ARC_OD_DynProp_Obj_09_RR ARC_OD_Length_Obj_09_RR ARC_OD_MaintenanceState_Obj_09_R ARC_OD_Width_Obj_09_RR ARC_OD_RCS_Obj_09_RR ARC_OD_Orientation_Obj_09_RR ARC_OD_LifeCycle_Obj_09_RR ARC_OD_ObstacleProb_Obj_08_RR ARC_OD_ObstacleProb_Obj_09_RR ARC_OD_VabsY_Obj_08_RR ARC_OD_ID_08_RR ARC_OD_ID_09_RR ARC_OD_MsgCounter_Obj_08_09_RR ARC_OD_CRC8_Obj_08_09_RR ARC_OD_AabsY_Obj_08_RR ARC_OD_DistXStd_Obj_08_RR ARC_OD_DistYStd_Obj_08_RR ARC_OD_VabsXStd_Obj_08_RR ARC_OD_VabsYStd_Obj_08_RR ARC_OD_AabsXStd_Obj_08_RR;
SIG_GROUP_ 1108 Signal_Group_ARC_OD_06_07 1 : DistHeight_Obj_07_RR DistHeight_Obj_06_RR ARC_OD_DistX_Obj_06_RR ARC_OD_Classification_Obj_06_RR ARC_OD_AabsYStd_Obj_06_RR ARC_OD_ClassConf_Obj_06_RR ARC_OD_ProbOfExist_Obj_06_RR ARC_OD_VabsX_Obj_06_RR ARC_OD_DynProp_Obj_06_RR ARC_OD_Length_Obj_06_RR ARC_OD_MaintenanceState_Obj_06_R ARC_OD_Width_Obj_06_RR ARC_OD_RCS_Obj_06_RR ARC_OD_Orientation_Obj_06_RR ARC_OD_LifeCycle_Obj_06_RR ARC_OD_DistX_Obj_07_RR ARC_OD_VabsX_Obj_07_RR ARC_OD_AabsX_Obj_07_RR ARC_OD_AabsX_Obj_06_RR ARC_OD_DistY_Obj_07_RR ARC_OD_VabsY_Obj_07_RR ARC_OD_AabsY_Obj_07_RR ARC_OD_DistXStd_Obj_07_RR ARC_OD_DistYStd_Obj_07_RR ARC_OD_VabsXStd_Obj_07_RR ARC_OD_VabsYStd_Obj_07_RR ARC_OD_AabsXStd_Obj_07_RR ARC_OD_Classification_Obj_07_RR ARC_OD_AabsYStd_Obj_07_RR ARC_OD_ClassConf_Obj_07_RR ARC_OD_DistY_Obj_06_RR ARC_OD_ProbOfExist_Obj_07_RR ARC_OD_DynProp_Obj_07_RR ARC_OD_Length_Obj_07_RR ARC_OD_MaintenanceState_Obj_07_R ARC_OD_Width_Obj_07_RR ARC_OD_RCS_Obj_07_RR ARC_OD_Orientation_Obj_07_RR ARC_OD_LifeCycle_Obj_07_RR ARC_OD_ObstacleProb_Obj_06_RR ARC_OD_ObstacleProb_Obj_07_RR ARC_OD_VabsY_Obj_06_RR ARC_OD_ID_06_RR ARC_OD_ID_07_RR ARC_OD_MsgCounter_Obj_06_07_RR ARC_OD_CRC8_Obj_06_07_RR ARC_OD_AabsY_Obj_06_RR ARC_OD_DistXStd_Obj_06_RR ARC_OD_DistYStd_Obj_06_RR ARC_OD_VabsXStd_Obj_06_RR ARC_OD_VabsYStd_Obj_06_RR ARC_OD_AabsXStd_Obj_06_RR;
SIG_GROUP_ 1107 Signal_Group_ARC_OD_04_05 1 : DistHeight_Obj_04_RR DistHeight_Obj_05_RR ARC_OD_DistX_Obj_04_RR ARC_OD_Classification_Obj_04_RR ARC_OD_AabsYStd_Obj_04_RR ARC_OD_ClassConf_Obj_04_RR ARC_OD_ProbOfExist_Obj_04_RR ARC_OD_VabsX_Obj_04_RR ARC_OD_DynProp_Obj_04_RR ARC_OD_Length_Obj_04_RR ARC_OD_MaintenanceState_Obj_04_R ARC_OD_Width_Obj_04_RR ARC_OD_RCS_Obj_04_RR ARC_OD_Orientation_Obj_04_RR ARC_OD_LifeCycle_Obj_04_RR ARC_OD_DistX_Obj_05_RR ARC_OD_VabsX_Obj_05_RR ARC_OD_AabsX_Obj_05_RR ARC_OD_AabsX_Obj_04_RR ARC_OD_DistY_Obj_05_RR ARC_OD_VabsY_Obj_05_RR ARC_OD_AabsY_Obj_05_RR ARC_OD_DistXStd_Obj_05_RR ARC_OD_DistYStd_Obj_05_RR ARC_OD_VabsXStd_Obj_05_RR ARC_OD_VabsYStd_Obj_05_RR ARC_OD_AabsXStd_Obj_05_RR ARC_OD_Classification_Obj_05_RR ARC_OD_AabsYStd_Obj_05_RR ARC_OD_ClassConf_Obj_05_RR ARC_OD_DistY_Obj_04_RR ARC_OD_ProbOfExist_Obj_05_RR ARC_OD_DynProp_Obj_05_RR ARC_OD_Length_Obj_05_RR ARC_OD_MaintenanceState_Obj_05_R ARC_OD_Width_Obj_05_RR ARC_OD_RCS_Obj_05_RR ARC_OD_Orientation_Obj_05_RR ARC_OD_LifeCycle_Obj_05_RR ARC_OD_ObstacleProb_Obj_04_RR ARC_OD_ObstacleProb_Obj_05_RR ARC_OD_VabsY_Obj_04_RR ARC_OD_ID_04_RR ARC_OD_ID_05_RR ARC_OD_MsgCounter_Obj_04_05_RR ARC_OD_CRC8_Obj_04_05_RR ARC_OD_AabsY_Obj_04_RR ARC_OD_DistXStd_Obj_04_RR ARC_OD_DistYStd_Obj_04_RR ARC_OD_VabsXStd_Obj_04_RR ARC_OD_VabsYStd_Obj_04_RR ARC_OD_AabsXStd_Obj_04_RR;
SIG_GROUP_ 1106 Signal_Group_ARC_OD_02_03 1 : DistHeight_Obj_02_RR DistHeight_Obj_03_RR ARC_OD_DistX_Obj_02_RR ARC_OD_Classification_Obj_02_RR ARC_OD_AabsYStd_Obj_02_RR ARC_OD_ClassConf_Obj_02_RR ARC_OD_ProbOfExist_Obj_02_RR ARC_OD_VabsX_Obj_02_RR ARC_OD_DynProp_Obj_02_RR ARC_OD_Length_Obj_02_RR ARC_OD_MaintenanceState_Obj_02_R ARC_OD_Width_Obj_02_RR ARC_OD_RCS_Obj_02_RR ARC_OD_Orientation_Obj_02_RR ARC_OD_LifeCycle_Obj_02_RR ARC_OD_DistX_Obj_03_RR ARC_OD_VabsX_Obj_03_RR ARC_OD_AabsX_Obj_03_RR ARC_OD_AabsX_Obj_02_RR ARC_OD_DistY_Obj_03_RR ARC_OD_VabsY_Obj_03_RR ARC_OD_AabsY_Obj_03_RR ARC_OD_DistXStd_Obj_03_RR ARC_OD_DistYStd_Obj_03_RR ARC_OD_VabsXStd_Obj_03_RR ARC_OD_VabsYStd_Obj_03_RR ARC_OD_AabsXStd_Obj_03_RR ARC_OD_Classification_Obj_03_RR ARC_OD_AabsYStd_Obj_03_RR ARC_OD_ClassConf_Obj_03_RR ARC_OD_DistY_Obj_02_RR ARC_OD_ProbOfExist_Obj_03_RR ARC_OD_DynProp_Obj_03_RR ARC_OD_Length_Obj_03_RR ARC_OD_MaintenanceState_Obj_03_R ARC_OD_Width_Obj_03_RR ARC_OD_RCS_Obj_03_RR ARC_OD_Orientation_Obj_03_RR ARC_OD_LifeCycle_Obj_03_RR ARC_OD_ObstacleProb_Obj_02_RR ARC_OD_ObstacleProb_Obj_03_RR ARC_OD_VabsY_Obj_02_RR ARC_OD_ID_02_RR ARC_OD_ID_03_RR ARC_OD_MsgCounter_Obj_02_03_RR ARC_OD_CRC8_Obj_02_03_RR ARC_OD_AabsY_Obj_02_RR ARC_OD_DistXStd_Obj_02_RR ARC_OD_DistYStd_Obj_02_RR ARC_OD_VabsXStd_Obj_02_RR ARC_OD_VabsYStd_Obj_02_RR ARC_OD_AabsXStd_Obj_02_RR;
SIG_GROUP_ 1105 Signal_Group_ARC_OD_00_01 1 : DistHeight_Obj_01_RR DistHeight_Obj_00_RR ARC_OD_DistX_Obj_00_RR ARC_OD_Classification_Obj_00_RR ARC_OD_AabsYStd_Obj_00_RR ARC_OD_ClassConf_Obj_00_RR ARC_OD_ProbOfExist_Obj_00_RR ARC_OD_VabsX_Obj_00_RR ARC_OD_DynProp_Obj_00_RR ARC_OD_Length_Obj_00_RR ARC_OD_MaintenanceState_Obj_00_R ARC_OD_Width_Obj_00_RR ARC_OD_RCS_Obj_00_RR ARC_OD_Orientation_Obj_00_RR ARC_OD_LifeCycle_Obj_00_RR ARC_OD_DistX_Obj_01_RR ARC_OD_VabsX_Obj_01_RR ARC_OD_AabsX_Obj_01_RR ARC_OD_AabsX_Obj_00_RR ARC_OD_DistY_Obj_01_RR ARC_OD_VabsY_Obj_01_RR ARC_OD_AabsY_Obj_01_RR ARC_OD_DistXStd_Obj_01_RR ARC_OD_DistYStd_Obj_01_RR ARC_OD_VabsXStd_Obj_01_RR ARC_OD_VabsYStd_Obj_01_RR ARC_OD_AabsXStd_Obj_01_RR ARC_OD_Classification_Obj_01_RR ARC_OD_AabsYStd_Obj_01_RR ARC_OD_ClassConf_Obj_01_RR ARC_OD_DistY_Obj_00_RR ARC_OD_ProbOfExist_Obj_01_RR ARC_OD_DynProp_Obj_01_RR ARC_OD_Length_Obj_01_RR ARC_OD_MaintenanceState_Obj_01_R ARC_OD_Width_Obj_01_RR ARC_OD_RCS_Obj_01_RR ARC_OD_Orientation_Obj_01_RR ARC_OD_LifeCycle_Obj_01_RR ARC_OD_ObstacleProb_Obj_00_RR ARC_OD_ObstacleProb_Obj_01_RR ARC_OD_VabsY_Obj_00_RR ARC_OD_ID_00_RR ARC_OD_ID_01_RR ARC_OD_MsgCounter_Obj_00_01_RR ARC_OD_CRC8_Obj_00_01_RR ARC_OD_AabsY_Obj_00_RR ARC_OD_DistXStd_Obj_00_RR ARC_OD_DistYStd_Obj_00_RR ARC_OD_VabsXStd_Obj_00_RR ARC_OD_VabsYStd_Obj_00_RR ARC_OD_AabsXStd_Obj_00_RR;
SIG_GROUP_ 1616 Signal_Group_ARC_OD_Header 1 : ARC_OD_TimeStampGlobSec_FL ARC_OD_CycleCounter_FL ARC_OD_NumOfObjects_FL ARC_OD_TaskValidFlag_FL ARC_OD_ExtendedCycleFlag_FL ARC_OD_Latency_FL ARC_OD_MsgCounter_Header_FL ARC_OD_CRC8_Header_FL ARC_OD_TimeStampGlobNanoSec_FL ARC_OD_TimeStampLocal_FL ARC_OD_MeasCounter_FL;
SIG_GROUP_ 1360 Signal_Group_ARC_OD_Header 1 : ARC_OD_TimeStampGlobSec_FR ARC_OD_CycleCounter_FR ARC_OD_NumOfObjects_FR ARC_OD_TaskValidFlag_FR ARC_OD_ExtendedCycleFlag_FR ARC_OD_Latency_FR ARC_OD_MsgCounter_Header_FR ARC_OD_CRC8_Header_FR ARC_OD_TimeStampGlobNanoSec_FR ARC_OD_TimeStampLocal_FR ARC_OD_MeasCounter_FR;
SIG_GROUP_ 1104 Signal_Group_ARC_OD_Header 1 : ARC_OD_TimeStampGlobSec_RR ARC_OD_CycleCounter_RR ARC_OD_NumOfObjects_RR ARC_OD_TaskValidFlag_RR ARC_OD_ExtendedCycleFlag_RR ARC_OD_Latency_RR ARC_OD_MsgCounter_Header_RR ARC_OD_CRC8_Header_RR ARC_OD_TimeStampGlobNanoSec_RR ARC_OD_TimeStampLocal_RR ARC_OD_MeasCounter_RR;
SIG_GROUP_ 102 Signal_Group_ARC_CONFIG_STATE 1 : ARC_ERROR_STATE_FR ARC_CFG_Mode_FR ARC_CFG_TmeSynEnFl_FR ARC_CONFIG_STATE_FR_RC ARC_CONFIG_STATE_FR_CRC;
SIG_GROUP_ 105 Signal_Group_ARC_CONFIG_STATE 1 : ARC_ERROR_STATE_FL ARC_CFG_Mode_FL ARC_CFG_TmeSynEnFl_FL ARC_CONFIG_STATE_FL_RC ARC_CONFIG_STATE_FL_CRC;
SIG_GROUP_ 99 Signal_Group_ARC_CONFIG_STATE 1 : ARC_ERROR_STATE_RR ARC_CFG_Mode_RR ARC_CFG_TmeSynEnFl_RR ARC_CONFIG_STATE_RR_RC ARC_CONFIG_STATE_RR_CRC;
SIG_GROUP_ 96 Signal_Group_ARC_CONFIG_STATE 1 : ARC_ERROR_STATE_RL ARC_CFG_Mode_RL ARC_CFG_TmeSynEnFl_RL ARC_CONFIG_STATE_RL_RC ARC_CONFIG_STATE_RL_CRC;
SIG_GROUP_ 848 Signal_Group_ARC_OD_Header 1 : ARC_OD_TimeStampGlobSec_RL ARC_OD_CycleCounter_RL ARC_OD_NumOfObjects_RL ARC_OD_TaskValidFlag_RL ARC_OD_ExtendedCycleFlag_RL ARC_OD_Latency_RL ARC_OD_MsgCounter_Header_RL ARC_OD_CRC8_Header_RL ARC_OD_TimeStampGlobNanoSec_RL ARC_OD_TimeStampLocal_RL ARC_OD_MeasCounter_RL;
SIG_GROUP_ 849 Signal_Group_ARC_OD_00_01 1 : DistHeight_Obj_01_RL DistHeight_Obj_00_RL ARC_OD_DistX_Obj_00_RL ARC_OD_Classification_Obj_00_RL ARC_OD_AabsYStd_Obj_00_RL ARC_OD_ClassConf_Obj_00_RL ARC_OD_ProbOfExist_Obj_00_RL ARC_OD_VabsX_Obj_00_RL ARC_OD_DynProp_Obj_00_RL ARC_OD_Length_Obj_00_RL ARC_OD_MaintenanceState_Obj_0061 ARC_OD_Width_Obj_00_RL ARC_OD_RCS_Obj_00_RL ARC_OD_Orientation_Obj_00_RL ARC_OD_LifeCycle_Obj_00_RL ARC_OD_DistX_Obj_01_RL ARC_OD_VabsX_Obj_01_RL ARC_OD_AabsX_Obj_01_RL ARC_OD_AabsX_Obj_00_RL ARC_OD_DistY_Obj_01_RL ARC_OD_VabsY_Obj_01_RL ARC_OD_AabsY_Obj_01_RL ARC_OD_DistXStd_Obj_01_RL ARC_OD_DistYStd_Obj_01_RL ARC_OD_VabsXStd_Obj_01_RL ARC_OD_VabsYStd_Obj_01_RL ARC_OD_AabsXStd_Obj_01_RL ARC_OD_Classification_Obj_01_RL ARC_OD_AabsYStd_Obj_01_RL ARC_OD_ClassConf_Obj_01_RL ARC_OD_DistY_Obj_00_RL ARC_OD_ProbOfExist_Obj_01_RL ARC_OD_DynProp_Obj_01_RL ARC_OD_Length_Obj_01_RL ARC_OD_MaintenanceState_Obj_0062 ARC_OD_Width_Obj_01_RL ARC_OD_RCS_Obj_01_RL ARC_OD_Orientation_Obj_01_RL ARC_OD_LifeCycle_Obj_01_RL ARC_OD_ObstacleProb_Obj_00_RL ARC_OD_ObstacleProb_Obj_01_RL ARC_OD_VabsY_Obj_00_RL ARC_OD_ID_00_RL ARC_OD_ID_01_RL ARC_OD_MsgCounter_Obj_00_01_RL ARC_OD_CRC8_Obj_00_01_RL ARC_OD_AabsY_Obj_00_RL ARC_OD_DistXStd_Obj_00_RL ARC_OD_DistYStd_Obj_00_RL ARC_OD_VabsXStd_Obj_00_RL ARC_OD_VabsYStd_Obj_00_RL ARC_OD_AabsXStd_Obj_00_RL;
SIG_GROUP_ 850 Signal_Group_ARC_OD_02_03 1 : DistHeight_Obj_02_RL DistHeight_Obj_03_RL ARC_OD_DistX_Obj_02_RL ARC_OD_Classification_Obj_02_RL ARC_OD_AabsYStd_Obj_02_RL ARC_OD_ClassConf_Obj_02_RL ARC_OD_ProbOfExist_Obj_02_RL ARC_OD_VabsX_Obj_02_RL ARC_OD_DynProp_Obj_02_RL ARC_OD_Length_Obj_02_RL ARC_OD_MaintenanceState_Obj_0063 ARC_OD_Width_Obj_02_RL ARC_OD_RCS_Obj_02_RL ARC_OD_Orientation_Obj_02_RL ARC_OD_LifeCycle_Obj_02_RL ARC_OD_DistX_Obj_03_RL ARC_OD_VabsX_Obj_03_RL ARC_OD_AabsX_Obj_03_RL ARC_OD_AabsX_Obj_02_RL ARC_OD_DistY_Obj_03_RL ARC_OD_VabsY_Obj_03_RL ARC_OD_AabsY_Obj_03_RL ARC_OD_DistXStd_Obj_03_RL ARC_OD_DistYStd_Obj_03_RL ARC_OD_VabsXStd_Obj_03_RL ARC_OD_VabsYStd_Obj_03_RL ARC_OD_AabsXStd_Obj_03_RL ARC_OD_Classification_Obj_03_RL ARC_OD_AabsYStd_Obj_03_RL ARC_OD_ClassConf_Obj_03_RL ARC_OD_DistY_Obj_02_RL ARC_OD_ProbOfExist_Obj_03_RL ARC_OD_DynProp_Obj_03_RL ARC_OD_Length_Obj_03_RL ARC_OD_MaintenanceState_Obj_0064 ARC_OD_Width_Obj_03_RL ARC_OD_RCS_Obj_03_RL ARC_OD_Orientation_Obj_03_RL ARC_OD_LifeCycle_Obj_03_RL ARC_OD_ObstacleProb_Obj_02_RL ARC_OD_ObstacleProb_Obj_03_RL ARC_OD_VabsY_Obj_02_RL ARC_OD_ID_02_RL ARC_OD_ID_03_RL ARC_OD_MsgCounter_Obj_02_03_RL ARC_OD_CRC8_Obj_02_03_RL ARC_OD_AabsY_Obj_02_RL ARC_OD_DistXStd_Obj_02_RL ARC_OD_DistYStd_Obj_02_RL ARC_OD_VabsXStd_Obj_02_RL ARC_OD_VabsYStd_Obj_02_RL ARC_OD_AabsXStd_Obj_02_RL;
SIG_GROUP_ 851 Signal_Group_ARC_OD_04_05 1 : DistHeight_Obj_04_RL DistHeight_Obj_05_RL ARC_OD_DistX_Obj_04_RL ARC_OD_Classification_Obj_04_RL ARC_OD_AabsYStd_Obj_04_RL ARC_OD_ClassConf_Obj_04_RL ARC_OD_ProbOfExist_Obj_04_RL ARC_OD_VabsX_Obj_04_RL ARC_OD_DynProp_Obj_04_RL ARC_OD_Length_Obj_04_RL ARC_OD_MaintenanceState_Obj_0065 ARC_OD_Width_Obj_04_RL ARC_OD_RCS_Obj_04_RL ARC_OD_Orientation_Obj_04_RL ARC_OD_LifeCycle_Obj_04_RL ARC_OD_DistX_Obj_05_RL ARC_OD_VabsX_Obj_05_RL ARC_OD_AabsX_Obj_05_RL ARC_OD_AabsX_Obj_04_RL ARC_OD_DistY_Obj_05_RL ARC_OD_VabsY_Obj_05_RL ARC_OD_AabsY_Obj_05_RL ARC_OD_DistXStd_Obj_05_RL ARC_OD_DistYStd_Obj_05_RL ARC_OD_VabsXStd_Obj_05_RL ARC_OD_VabsYStd_Obj_05_RL ARC_OD_AabsXStd_Obj_05_RL ARC_OD_Classification_Obj_05_RL ARC_OD_AabsYStd_Obj_05_RL ARC_OD_ClassConf_Obj_05_RL ARC_OD_DistY_Obj_04_RL ARC_OD_ProbOfExist_Obj_05_RL ARC_OD_DynProp_Obj_05_RL ARC_OD_Length_Obj_05_RL ARC_OD_MaintenanceState_Obj_0066 ARC_OD_Width_Obj_05_RL ARC_OD_RCS_Obj_05_RL ARC_OD_Orientation_Obj_05_RL ARC_OD_LifeCycle_Obj_05_RL ARC_OD_ObstacleProb_Obj_04_RL ARC_OD_ObstacleProb_Obj_05_RL ARC_OD_VabsY_Obj_04_RL ARC_OD_ID_04_RL ARC_OD_ID_05_RL ARC_OD_MsgCounter_Obj_04_05_RL ARC_OD_CRC8_Obj_04_05_RL ARC_OD_AabsY_Obj_04_RL ARC_OD_DistXStd_Obj_04_RL ARC_OD_DistYStd_Obj_04_RL ARC_OD_VabsXStd_Obj_04_RL ARC_OD_VabsYStd_Obj_04_RL ARC_OD_AabsXStd_Obj_04_RL;
SIG_GROUP_ 852 Signal_Group_ARC_OD_06_07 1 : DistHeight_Obj_07_RL DistHeight_Obj_06_RL ARC_OD_DistX_Obj_06_RL ARC_OD_Classification_Obj_06_RL ARC_OD_AabsYStd_Obj_06_RL ARC_OD_ClassConf_Obj_06_RL ARC_OD_ProbOfExist_Obj_06_RL ARC_OD_VabsX_Obj_06_RL ARC_OD_DynProp_Obj_06_RL ARC_OD_Length_Obj_06_RL ARC_OD_MaintenanceState_Obj_0067 ARC_OD_Width_Obj_06_RL ARC_OD_RCS_Obj_06_RL ARC_OD_Orientation_Obj_06_RL ARC_OD_LifeCycle_Obj_06_RL ARC_OD_DistX_Obj_07_RL ARC_OD_VabsX_Obj_07_RL ARC_OD_AabsX_Obj_07_RL ARC_OD_AabsX_Obj_06_RL ARC_OD_DistY_Obj_07_RL ARC_OD_VabsY_Obj_07_RL ARC_OD_AabsY_Obj_07_RL ARC_OD_DistXStd_Obj_07_RL ARC_OD_DistYStd_Obj_07_RL ARC_OD_VabsXStd_Obj_07_RL ARC_OD_VabsYStd_Obj_07_RL ARC_OD_AabsXStd_Obj_07_RL ARC_OD_Classification_Obj_07_RL ARC_OD_AabsYStd_Obj_07_RL ARC_OD_ClassConf_Obj_07_RL ARC_OD_DistY_Obj_06_RL ARC_OD_ProbOfExist_Obj_07_RL ARC_OD_DynProp_Obj_07_RL ARC_OD_Length_Obj_07_RL ARC_OD_MaintenanceState_Obj_0068 ARC_OD_Width_Obj_07_RL ARC_OD_RCS_Obj_07_RL ARC_OD_Orientation_Obj_07_RL ARC_OD_LifeCycle_Obj_07_RL ARC_OD_ObstacleProb_Obj_06_RL ARC_OD_ObstacleProb_Obj_07_RL ARC_OD_VabsY_Obj_06_RL ARC_OD_ID_06_RL ARC_OD_ID_07_RL ARC_OD_MsgCounter_Obj_06_07_RL ARC_OD_CRC8_Obj_06_07_RL ARC_OD_AabsY_Obj_06_RL ARC_OD_DistXStd_Obj_06_RL ARC_OD_DistYStd_Obj_06_RL ARC_OD_VabsXStd_Obj_06_RL ARC_OD_VabsYStd_Obj_06_RL ARC_OD_AabsXStd_Obj_06_RL;
SIG_GROUP_ 853 Signal_Group_ARC_OD_08_09 1 : DistHeight_Obj_09_RL DistHeight_Obj_08_RL ARC_OD_DistX_Obj_08_RL ARC_OD_Classification_Obj_08_RL ARC_OD_AabsYStd_Obj_08_RL ARC_OD_ClassConf_Obj_08_RL ARC_OD_ProbOfExist_Obj_08_RL ARC_OD_VabsX_Obj_08_RL ARC_OD_DynProp_Obj_08_RL ARC_OD_Length_Obj_08_RL ARC_OD_MaintenanceState_Obj_0069 ARC_OD_Width_Obj_08_RL ARC_OD_RCS_Obj_08_RL ARC_OD_Orientation_Obj_08_RL ARC_OD_LifeCycle_Obj_08_RL ARC_OD_DistX_Obj_09_RL ARC_OD_VabsX_Obj_09_RL ARC_OD_AabsX_Obj_09_RL ARC_OD_AabsX_Obj_08_RL ARC_OD_DistY_Obj_09_RL ARC_OD_VabsY_Obj_09_RL ARC_OD_AabsY_Obj_09_RL ARC_OD_DistXStd_Obj_09_RL ARC_OD_DistYStd_Obj_09_RL ARC_OD_VabsXStd_Obj_09_RL ARC_OD_VabsYStd_Obj_09_RL ARC_OD_AabsXStd_Obj_09_RL ARC_OD_Classification_Obj_09_RL ARC_OD_AabsYStd_Obj_09_RL ARC_OD_ClassConf_Obj_09_RL ARC_OD_DistY_Obj_08_RL ARC_OD_ProbOfExist_Obj_09_RL ARC_OD_DynProp_Obj_09_RL ARC_OD_Length_Obj_09_RL ARC_OD_MaintenanceState_Obj_0070 ARC_OD_Width_Obj_09_RL ARC_OD_RCS_Obj_09_RL ARC_OD_Orientation_Obj_09_RL ARC_OD_LifeCycle_Obj_09_RL ARC_OD_ObstacleProb_Obj_08_RL ARC_OD_ObstacleProb_Obj_09_RL ARC_OD_VabsY_Obj_08_RL ARC_OD_ID_08_RL ARC_OD_ID_09_RL ARC_OD_MsgCounter_Obj_08_09_RL ARC_OD_CRC8_Obj_08_09_RL ARC_OD_AabsY_Obj_08_RL ARC_OD_DistXStd_Obj_08_RL ARC_OD_DistYStd_Obj_08_RL ARC_OD_VabsXStd_Obj_08_RL ARC_OD_VabsYStd_Obj_08_RL ARC_OD_AabsXStd_Obj_08_RL;
SIG_GROUP_ 854 Signal_Group_ARC_OD_10_11 1 : DistHeight_Obj_11_RL DistHeight_Obj_10_RL ARC_OD_DistX_Obj_10_RL ARC_OD_Classification_Obj_10_RL ARC_OD_AabsYStd_Obj_10_RL ARC_OD_ClassConf_Obj_10_RL ARC_OD_ProbOfExist_Obj_10_RL ARC_OD_VabsX_Obj_10_RL ARC_OD_DynProp_Obj_10_RL ARC_OD_Length_Obj_10_RL ARC_OD_MaintenanceState_Obj_0071 ARC_OD_Width_Obj_10_RL ARC_OD_RCS_Obj_10_RL ARC_OD_Orientation_Obj_10_RL ARC_OD_LifeCycle_Obj_10_RL ARC_OD_DistX_Obj_11_RL ARC_OD_VabsX_Obj_11_RL ARC_OD_AabsX_Obj_11_RL ARC_OD_AabsX_Obj_10_RL ARC_OD_DistY_Obj_11_RL ARC_OD_VabsY_Obj_11_RL ARC_OD_AabsY_Obj_11_RL ARC_OD_DistXStd_Obj_11_RL ARC_OD_DistYStd_Obj_11_RL ARC_OD_VabsXStd_Obj_11_RL ARC_OD_VabsYStd_Obj_11_RL ARC_OD_AabsXStd_Obj_11_RL ARC_OD_Classification_Obj_11_RL ARC_OD_AabsYStd_Obj_11_RL ARC_OD_ClassConf_Obj_11_RL ARC_OD_DistY_Obj_10_RL ARC_OD_ProbOfExist_Obj_11_RL ARC_OD_DynProp_Obj_11_RL ARC_OD_Length_Obj_11_RL ARC_OD_MaintenanceState_Obj_0072 ARC_OD_Width_Obj_11_RL ARC_OD_RCS_Obj_11_RL ARC_OD_Orientation_Obj_11_RL ARC_OD_LifeCycle_Obj_11_RL ARC_OD_ObstacleProb_Obj_10_RL ARC_OD_ObstacleProb_Obj_11_RL ARC_OD_VabsY_Obj_10_RL ARC_OD_ID_10_RL ARC_OD_ID_11_RL ARC_OD_MsgCounter_Obj_10_11_RL ARC_OD_CRC8_Obj_10_11_RL ARC_OD_AabsY_Obj_10_RL ARC_OD_DistXStd_Obj_10_RL ARC_OD_DistYStd_Obj_10_RL ARC_OD_VabsXStd_Obj_10_RL ARC_OD_VabsYStd_Obj_10_RL ARC_OD_AabsXStd_Obj_10_RL;
SIG_GROUP_ 855 Signal_Group_ARC_OD_12_13 1 : DistHeight_Obj_13_RL DistHeight_Obj_12_RL ARC_OD_DistX_Obj_12_RL ARC_OD_Classification_Obj_12_RL ARC_OD_AabsYStd_Obj_12_RL ARC_OD_ClassConf_Obj_12_RL ARC_OD_ProbOfExist_Obj_12_RL ARC_OD_VabsX_Obj_12_RL ARC_OD_DynProp_Obj_12_RL ARC_OD_Length_Obj_12_RL ARC_OD_MaintenanceState_Obj_0073 ARC_OD_Width_Obj_12_RL ARC_OD_RCS_Obj_12_RL ARC_OD_Orientation_Obj_12_RL ARC_OD_LifeCycle_Obj_12_RL ARC_OD_DistX_Obj_13_RL ARC_OD_VabsX_Obj_13_RL ARC_OD_AabsX_Obj_13_RL ARC_OD_AabsX_Obj_12_RL ARC_OD_DistY_Obj_13_RL ARC_OD_VabsY_Obj_13_RL ARC_OD_AabsY_Obj_13_RL ARC_OD_DistXStd_Obj_13_RL ARC_OD_DistYStd_Obj_13_RL ARC_OD_VabsXStd_Obj_13_RL ARC_OD_VabsYStd_Obj_13_RL ARC_OD_AabsXStd_Obj_13_RL ARC_OD_Classification_Obj_13_RL ARC_OD_AabsYStd_Obj_13_RL ARC_OD_ClassConf_Obj_13_RL ARC_OD_DistY_Obj_12_RL ARC_OD_ProbOfExist_Obj_13_RL ARC_OD_DynProp_Obj_13_RL ARC_OD_Length_Obj_13_RL ARC_OD_MaintenanceState_Obj_0074 ARC_OD_Width_Obj_13_RL ARC_OD_RCS_Obj_13_RL ARC_OD_Orientation_Obj_13_RL ARC_OD_LifeCycle_Obj_13_RL ARC_OD_ObstacleProb_Obj_12_RL ARC_OD_ObstacleProb_Obj_13_RL ARC_OD_VabsY_Obj_12_RL ARC_OD_ID_12_RL ARC_OD_ID_13_RL ARC_OD_MsgCounter_Obj_12_13_RL ARC_OD_CRC8_Obj_12_13_RL ARC_OD_AabsY_Obj_12_RL ARC_OD_DistXStd_Obj_12_RL ARC_OD_DistYStd_Obj_12_RL ARC_OD_VabsXStd_Obj_12_RL ARC_OD_VabsYStd_Obj_12_RL ARC_OD_AabsXStd_Obj_12_RL;
SIG_GROUP_ 856 Signal_Group_ARC_OD_14_15 1 : DistHeight_Obj_15_RL DistHeight_Obj_14_RL ARC_OD_DistX_Obj_14_RL ARC_OD_Classification_Obj_14_RL ARC_OD_AabsYStd_Obj_14_RL ARC_OD_ClassConf_Obj_14_RL ARC_OD_ProbOfExist_Obj_14_RL ARC_OD_VabsX_Obj_14_RL ARC_OD_DynProp_Obj_14_RL ARC_OD_Length_Obj_14_RL ARC_OD_MaintenanceState_Obj_0075 ARC_OD_Width_Obj_14_RL ARC_OD_RCS_Obj_14_RL ARC_OD_Orientation_Obj_14_RL ARC_OD_LifeCycle_Obj_14_RL ARC_OD_DistX_Obj_15_RL ARC_OD_VabsX_Obj_15_RL ARC_OD_AabsX_Obj_15_RL ARC_OD_AabsX_Obj_14_RL ARC_OD_DistY_Obj_15_RL ARC_OD_VabsY_Obj_15_RL ARC_OD_AabsY_Obj_15_RL ARC_OD_DistXStd_Obj_15_RL ARC_OD_DistYStd_Obj_15_RL ARC_OD_VabsXStd_Obj_15_RL ARC_OD_VabsYStd_Obj_15_RL ARC_OD_AabsXStd_Obj_15_RL ARC_OD_Classification_Obj_15_RL ARC_OD_AabsYStd_Obj_15_RL ARC_OD_ClassConf_Obj_15_RL ARC_OD_DistY_Obj_14_RL ARC_OD_ProbOfExist_Obj_15_RL ARC_OD_DynProp_Obj_15_RL ARC_OD_Length_Obj_15_RL ARC_OD_MaintenanceState_Obj_0076 ARC_OD_Width_Obj_15_RL ARC_OD_RCS_Obj_15_RL ARC_OD_Orientation_Obj_15_RL ARC_OD_LifeCycle_Obj_15_RL ARC_OD_ObstacleProb_Obj_14_RL ARC_OD_ObstacleProb_Obj_15_RL ARC_OD_VabsY_Obj_14_RL ARC_OD_ID_14_RL ARC_OD_ID_15_RL ARC_OD_MsgCounter_Obj_14_15_RL ARC_OD_CRC8_Obj_14_15_RL ARC_OD_AabsY_Obj_14_RL ARC_OD_DistXStd_Obj_14_RL ARC_OD_DistYStd_Obj_14_RL ARC_OD_VabsXStd_Obj_14_RL ARC_OD_VabsYStd_Obj_14_RL ARC_OD_AabsXStd_Obj_14_RL;
SIG_GROUP_ 857 Signal_Group_ARC_OD_16_17 1 : DistHeight_Obj_17_RL DistHeight_Obj_16_RL ARC_OD_DistX_Obj_16_RL ARC_OD_Classification_Obj_16_RL ARC_OD_AabsYStd_Obj_16_RL ARC_OD_ClassConf_Obj_16_RL ARC_OD_ProbOfExist_Obj_16_RL ARC_OD_VabsX_Obj_16_RL ARC_OD_DynProp_Obj_16_RL ARC_OD_Length_Obj_16_RL ARC_OD_MaintenanceState_Obj_0077 ARC_OD_Width_Obj_16_RL ARC_OD_RCS_Obj_16_RL ARC_OD_Orientation_Obj_16_RL ARC_OD_LifeCycle_Obj_16_RL ARC_OD_DistX_Obj_17_RL ARC_OD_VabsX_Obj_17_RL ARC_OD_AabsX_Obj_17_RL ARC_OD_AabsX_Obj_16_RL ARC_OD_DistY_Obj_17_RL ARC_OD_VabsY_Obj_17_RL ARC_OD_AabsY_Obj_17_RL ARC_OD_DistXStd_Obj_17_RL ARC_OD_DistYStd_Obj_17_RL ARC_OD_VabsXStd_Obj_17_RL ARC_OD_VabsYStd_Obj_17_RL ARC_OD_AabsXStd_Obj_17_RL ARC_OD_Classification_Obj_17_RL ARC_OD_AabsYStd_Obj_17_RL ARC_OD_ClassConf_Obj_17_RL ARC_OD_DistY_Obj_16_RL ARC_OD_ProbOfExist_Obj_17_RL ARC_OD_DynProp_Obj_17_RL ARC_OD_Length_Obj_17_RL ARC_OD_MaintenanceState_Obj_0078 ARC_OD_Width_Obj_17_RL ARC_OD_RCS_Obj_17_RL ARC_OD_Orientation_Obj_17_RL ARC_OD_LifeCycle_Obj_17_RL ARC_OD_ObstacleProb_Obj_16_RL ARC_OD_ObstacleProb_Obj_17_RL ARC_OD_VabsY_Obj_16_RL ARC_OD_ID_16_RL ARC_OD_ID_17_RL ARC_OD_MsgCounter_Obj_16_17_RL ARC_OD_CRC8_Obj_16_17_RL ARC_OD_AabsY_Obj_16_RL ARC_OD_DistXStd_Obj_16_RL ARC_OD_DistYStd_Obj_16_RL ARC_OD_VabsXStd_Obj_16_RL ARC_OD_VabsYStd_Obj_16_RL ARC_OD_AabsXStd_Obj_16_RL;
SIG_GROUP_ 858 Signal_Group_ARC_OD_18_19 1 : DistHeight_Obj_19_RL DistHeight_Obj_18_RL ARC_OD_DistX_Obj_18_RL ARC_OD_Classification_Obj_18_RL ARC_OD_AabsYStd_Obj_18_RL ARC_OD_ClassConf_Obj_18_RL ARC_OD_ProbOfExist_Obj_18_RL ARC_OD_VabsX_Obj_18_RL ARC_OD_DynProp_Obj_18_RL ARC_OD_Length_Obj_18_RL ARC_OD_MaintenanceState_Obj_0079 ARC_OD_Width_Obj_18_RL ARC_OD_RCS_Obj_18_RL ARC_OD_Orientation_Obj_18_RL ARC_OD_LifeCycle_Obj_18_RL ARC_OD_DistX_Obj_19_RL ARC_OD_VabsX_Obj_19_RL ARC_OD_AabsX_Obj_19_RL ARC_OD_AabsX_Obj_18_RL ARC_OD_DistY_Obj_19_RL ARC_OD_VabsY_Obj_19_RL ARC_OD_AabsY_Obj_19_RL ARC_OD_DistXStd_Obj_19_RL ARC_OD_DistYStd_Obj_19_RL ARC_OD_VabsXStd_Obj_19_RL ARC_OD_VabsYStd_Obj_19_RL ARC_OD_AabsXStd_Obj_19_RL ARC_OD_Classification_Obj_19_RL ARC_OD_AabsYStd_Obj_19_RL ARC_OD_ClassConf_Obj_19_RL ARC_OD_DistY_Obj_18_RL ARC_OD_ProbOfExist_Obj_19_RL ARC_OD_DynProp_Obj_19_RL ARC_OD_Length_Obj_19_RL ARC_OD_MaintenanceState_Obj_0080 ARC_OD_Width_Obj_19_RL ARC_OD_RCS_Obj_19_RL ARC_OD_Orientation_Obj_19_RL ARC_OD_LifeCycle_Obj_19_RL ARC_OD_ObstacleProb_Obj_18_RL ARC_OD_ObstacleProb_Obj_19_RL ARC_OD_VabsY_Obj_18_RL ARC_OD_ID_18_RL ARC_OD_ID_19_RL ARC_OD_MsgCounter_Obj_18_19_RL ARC_OD_CRC8_Obj_18_19_RL ARC_OD_AabsY_Obj_18_RL ARC_OD_DistXStd_Obj_18_RL ARC_OD_DistYStd_Obj_18_RL ARC_OD_VabsXStd_Obj_18_RL ARC_OD_VabsYStd_Obj_18_RL ARC_OD_AabsXStd_Obj_18_RL;
SIG_GROUP_ 859 Signal_Group_ARC_OD_20_21 1 : ARC_OD_AabsXStd_Obj_20_RL ARC_OD_VabsYStd_Obj_20_RL ARC_OD_VabsXStd_Obj_20_RL ARC_OD_DistYStd_Obj_20_RL ARC_OD_DistXStd_Obj_20_RL ARC_OD_AabsY_Obj_20_RL ARC_OD_CRC8_Obj_20_21_RL ARC_OD_MsgCounter_Obj_20_21_RL ARC_OD_ID_21_RL ARC_OD_ID_20_RL ARC_OD_VabsY_Obj_20_RL ARC_OD_ObstacleProb_Obj_21_RL ARC_OD_ObstacleProb_Obj_20_RL ARC_OD_LifeCycle_Obj_21_RL ARC_OD_Orientation_Obj_21_RL ARC_OD_RCS_Obj_21_RL ARC_OD_Width_Obj_21_RL ARC_OD_MaintenanceState_Obj_0082 ARC_OD_Length_Obj_21_RL ARC_OD_DynProp_Obj_21_RL ARC_OD_ProbOfExist_Obj_21_RL ARC_OD_DistY_Obj_20_RL ARC_OD_ClassConf_Obj_21_RL ARC_OD_AabsYStd_Obj_21_RL ARC_OD_Classification_Obj_21_RL ARC_OD_AabsXStd_Obj_21_RL ARC_OD_VabsYStd_Obj_21_RL ARC_OD_VabsXStd_Obj_21_RL ARC_OD_DistYStd_Obj_21_RL ARC_OD_DistXStd_Obj_21_RL ARC_OD_AabsY_Obj_21_RL ARC_OD_VabsY_Obj_21_RL ARC_OD_DistY_Obj_21_RL ARC_OD_AabsX_Obj_20_RL ARC_OD_AabsX_Obj_21_RL ARC_OD_VabsX_Obj_21_RL ARC_OD_DistX_Obj_21_RL ARC_OD_LifeCycle_Obj_20_RL ARC_OD_Orientation_Obj_20_RL ARC_OD_RCS_Obj_20_RL ARC_OD_Width_Obj_20_RL ARC_OD_MaintenanceState_Obj_0081 ARC_OD_Length_Obj_20_RL ARC_OD_DynProp_Obj_20_RL ARC_OD_VabsX_Obj_20_RL ARC_OD_ProbOfExist_Obj_20_RL ARC_OD_ClassConf_Obj_20_RL ARC_OD_AabsYStd_Obj_20_RL ARC_OD_Classification_Obj_20_RL ARC_OD_DistX_Obj_20_RL DistHeight_Obj_20_RL DistHeight_Obj_21_RL;
