VERSION "created by canmatrix"

NS_ :

BS_:

BU_: ARC ADC

BO_ 1372 ARC_OD_22_23_FR: 64 ARC
 SG_ DistHeight_Obj_23_FR : 487|8@0+ (0.2,-10) [-10|41] "m" ADC
 SG_ DistHeight_Obj_22_FR : 479|8@0+ (0.2,-10) [-10|41] "m" ADC
 SG_ ARC_OD_DistX_Obj_22_FR : 7|12@0+ (0.1,-152) [-152|257.5] "m" ADC
 SG_ ARC_OD_Classification_Obj_22_FR : 98|3@0+ (1,0) [0|7] "" ADC
 SG_ ARC_OD_AabsYStd_Obj_22_FR : 111|8@0+ (0.25,0) [0|63.75] "m/s^2" ADC
 SG_ ARC_OD_ClassConf_Obj_22_FR : 119|7@0+ (1,0) [0|127] "%" ADC
 SG_ ARC_OD_ProbOfExist_Obj_22_FR : 112|7@0+ (1,0) [0|127] "%" ADC
 SG_ ARC_OD_VabsX_Obj_22_FR : 11|11@0+ (0.125,-128) [-128|127.875] "m/s" ADC
 SG_ ARC_OD_DynProp_Obj_22_FR : 130|3@0+ (1,0) [0|7] "" ADC
 SG_ ARC_OD_Length_Obj_22_FR : 136|7@0+ (0.2,0) [0|25.4] "m" ADC
 SG_ ARC_OD_MaintenanceState_Obj_0037 : 145|2@0+ (1,0) [0|3] "" ADC
 SG_ ARC_OD_Width_Obj_22_FR : 159|7@0+ (0.2,0) [0|25.4] "m" ADC
 SG_ ARC_OD_RCS_Obj_22_FR : 152|9@0+ (0.2,-51.1) [-51.1|51.1] "dBsm" ADC
 SG_ ARC_OD_Orientation_Obj_22_FR : 175|10@0+ (0.01,-5.11) [-5.11|5.12] "rad" ADC
 SG_ ARC_OD_LifeCycle_Obj_22_FR : 207|16@0+ (1,0) [0|65535] "" ADC
 SG_ ARC_OD_DistX_Obj_23_FR : 223|12@0+ (0.1,-152) [-152|257.5] "m" ADC
 SG_ ARC_OD_VabsX_Obj_23_FR : 227|11@0+ (0.125,-128) [-128|127.875] "m/s" ADC
 SG_ ARC_OD_AabsX_Obj_23_FR : 232|9@0+ (0.125,-31.875) [-31.875|32] "m/s^2" ADC
 SG_ ARC_OD_AabsX_Obj_22_FR : 16|9@0+ (0.125,-31.875) [-31.875|32] "m/s^2" ADC
 SG_ ARC_OD_DistY_Obj_23_FR : 255|12@0+ (0.0875,-179.113) [-179.113|179.2] "m" ADC
 SG_ ARC_OD_VabsY_Obj_23_FR : 259|11@0+ (0.125,-128) [-128|127.875] "m/s" ADC
 SG_ ARC_OD_AabsY_Obj_23_FR : 264|9@0+ (0.125,-31.875) [-31.875|32] "m/s^2" ADC
 SG_ ARC_OD_DistXStd_Obj_23_FR : 287|8@0+ (0.05,0) [0|12.75] "m" ADC
 SG_ ARC_OD_DistYStd_Obj_23_FR : 295|8@0+ (0.1,0) [0|25.5] "m" ADC
 SG_ ARC_OD_VabsXStd_Obj_23_FR : 303|7@0+ (0.1,0) [0|12.7] "m/s" ADC
 SG_ ARC_OD_VabsYStd_Obj_23_FR : 296|7@0+ (0.2,0) [0|25.4] "m/s" ADC
 SG_ ARC_OD_AabsXStd_Obj_23_FR : 305|7@0+ (0.25,0) [0|31.75] "m/s^2" ADC
 SG_ ARC_OD_Classification_Obj_23_FR : 314|3@0+ (1,0) [0|7] "" ADC
 SG_ ARC_OD_AabsYStd_Obj_23_FR : 327|8@0+ (0.25,0) [0|63.75] "m/s^2" ADC
 SG_ ARC_OD_ClassConf_Obj_23_FR : 335|7@0+ (1,0) [0|127] "%" ADC
 SG_ ARC_OD_DistY_Obj_22_FR : 39|12@0+ (0.0875,-179.113) [-179.113|179.2] "m" ADC
 SG_ ARC_OD_ProbOfExist_Obj_23_FR : 328|7@0+ (1,0) [0|127] "%" ADC
 SG_ ARC_OD_DynProp_Obj_23_FR : 346|3@0+ (1,0) [0|7] "" ADC
 SG_ ARC_OD_Length_Obj_23_FR : 352|7@0+ (0.2,0) [0|25.4] "m" ADC
 SG_ ARC_OD_MaintenanceState_Obj_0038 : 361|2@0+ (1,0) [0|3] "" ADC
 SG_ ARC_OD_Width_Obj_23_FR : 375|7@0+ (0.2,0) [0|25.4] "m" ADC
 SG_ ARC_OD_RCS_Obj_23_FR : 368|9@0+ (0.2,-51.1) [-51.1|51.1] "dBsm" ADC
 SG_ ARC_OD_Orientation_Obj_23_FR : 391|10@0+ (0.01,-5.11) [-5.11|5.12] "rad" ADC
 SG_ ARC_OD_LifeCycle_Obj_23_FR : 423|16@0+ (1,0) [0|65535] "" ADC
 SG_ ARC_OD_ObstacleProb_Obj_22_FR : 447|7@0+ (1,0) [0|127] "%" ADC
 SG_ ARC_OD_ObstacleProb_Obj_23_FR : 455|7@0+ (1,0) [0|127] "%" ADC
 SG_ ARC_OD_VabsY_Obj_22_FR : 43|11@0+ (0.125,-128) [-128|127.875] "m/s" ADC
 SG_ ARC_OD_ID_22_FR : 463|8@0+ (1,0) [0|255] "" ADC
 SG_ ARC_OD_ID_23_FR : 471|8@0+ (1,0) [0|255] "" ADC
 SG_ ARC_OD_MsgCounter_Obj_22_23_FR : 491|4@0+ (1,0) [0|15] "" ADC
 SG_ ARC_OD_CRC8_Obj_22_23_FR : 511|8@0+ (1,0) [0|256] "" ADC
 SG_ ARC_OD_AabsY_Obj_22_FR : 48|9@0+ (0.125,-31.875) [-31.875|32] "m/s^2" ADC
 SG_ ARC_OD_DistXStd_Obj_22_FR : 71|8@0+ (0.05,0) [0|12.75] "m" ADC
 SG_ ARC_OD_DistYStd_Obj_22_FR : 79|8@0+ (0.1,0) [0|25.5] "m" ADC
 SG_ ARC_OD_VabsXStd_Obj_22_FR : 87|7@0+ (0.1,0) [0|12.7] "m/s" ADC
 SG_ ARC_OD_VabsYStd_Obj_22_FR : 80|7@0+ (0.2,0) [0|25.4] "m/s" ADC
 SG_ ARC_OD_AabsXStd_Obj_22_FR : 89|7@0+ (0.25,0) [0|31.75] "m/s^2" ADC

BO_ 1371 ARC_OD_20_21_FR: 64 ARC
 SG_ DistHeight_Obj_21_FR : 487|8@0+ (0.2,-10) [-10|41] "m" ADC
 SG_ DistHeight_Obj_20_FR : 479|8@0+ (0.2,-10) [-10|41] "m" ADC
 SG_ ARC_OD_DistX_Obj_20_FR : 7|12@0+ (0.1,-152) [-152|257.5] "m" ADC
 SG_ ARC_OD_Classification_Obj_20_FR : 98|3@0+ (1,0) [0|7] "" ADC
 SG_ ARC_OD_AabsYStd_Obj_20_FR : 111|8@0+ (0.25,0) [0|63.75] "m/s^2" ADC
 SG_ ARC_OD_ClassConf_Obj_20_FR : 119|7@0+ (1,0) [0|127] "%" ADC
 SG_ ARC_OD_ProbOfExist_Obj_20_FR : 112|7@0+ (1,0) [0|127] "%" ADC
 SG_ ARC_OD_VabsX_Obj_20_FR : 11|11@0+ (0.125,-128) [-128|127.875] "m/s" ADC
 SG_ ARC_OD_DynProp_Obj_20_FR : 130|3@0+ (1,0) [0|7] "" ADC
 SG_ ARC_OD_Length_Obj_20_FR : 136|7@0+ (0.2,0) [0|25.4] "m" ADC
 SG_ ARC_OD_MaintenanceState_Obj_0039 : 145|2@0+ (1,0) [0|3] "" ADC
 SG_ ARC_OD_Width_Obj_20_FR : 159|7@0+ (0.2,0) [0|25.4] "m" ADC
 SG_ ARC_OD_RCS_Obj_20_FR : 152|9@0+ (0.2,-51.1) [-51.1|51.1] "dBsm" ADC
 SG_ ARC_OD_Orientation_Obj_20_FR : 175|10@0+ (0.01,-5.11) [-5.11|5.12] "rad" ADC
 SG_ ARC_OD_LifeCycle_Obj_20_FR : 207|16@0+ (1,0) [0|65535] "" ADC
 SG_ ARC_OD_DistX_Obj_21_FR : 223|12@0+ (0.1,-152) [-152|257.5] "m" ADC
 SG_ ARC_OD_VabsX_Obj_21_FR : 227|11@0+ (0.125,-128) [-128|127.875] "m/s" ADC
 SG_ ARC_OD_AabsX_Obj_21_FR : 232|9@0+ (0.125,-31.875) [-31.875|32] "m/s^2" ADC
 SG_ ARC_OD_AabsX_Obj_20_FR : 16|9@0+ (0.125,-31.875) [-31.875|32] "m/s^2" ADC
 SG_ ARC_OD_DistY_Obj_21_FR : 255|12@0+ (0.0875,-179.113) [-179.113|179.2] "m" ADC
 SG_ ARC_OD_VabsY_Obj_21_FR : 259|11@0+ (0.125,-128) [-128|127.875] "m/s" ADC
 SG_ ARC_OD_AabsY_Obj_21_FR : 264|9@0+ (0.125,-31.875) [-31.875|32] "m/s^2" ADC
 SG_ ARC_OD_DistXStd_Obj_21_FR : 287|8@0+ (0.05,0) [0|12.75] "m" ADC
 SG_ ARC_OD_DistYStd_Obj_21_FR : 295|8@0+ (0.1,0) [0|25.5] "m" ADC
 SG_ ARC_OD_VabsXStd_Obj_21_FR : 303|7@0+ (0.1,0) [0|12.7] "m/s" ADC
 SG_ ARC_OD_VabsYStd_Obj_21_FR : 296|7@0+ (0.2,0) [0|25.4] "m/s" ADC
 SG_ ARC_OD_AabsXStd_Obj_21_FR : 305|7@0+ (0.25,0) [0|31.75] "m/s^2" ADC
 SG_ ARC_OD_Classification_Obj_21_FR : 314|3@0+ (1,0) [0|7] "" ADC
 SG_ ARC_OD_AabsYStd_Obj_21_FR : 327|8@0+ (0.25,0) [0|63.75] "m/s^2" ADC
 SG_ ARC_OD_ClassConf_Obj_21_FR : 335|7@0+ (1,0) [0|127] "%" ADC
 SG_ ARC_OD_DistY_Obj_20_FR : 39|12@0+ (0.0875,-179.113) [-179.113|179.2] "m" ADC
 SG_ ARC_OD_ProbOfExist_Obj_21_FR : 328|7@0+ (1,0) [0|127] "%" ADC
 SG_ ARC_OD_DynProp_Obj_21_FR : 346|3@0+ (1,0) [0|7] "" ADC
 SG_ ARC_OD_Length_Obj_21_FR : 352|7@0+ (0.2,0) [0|25.4] "m" ADC
 SG_ ARC_OD_MaintenanceState_Obj_0040 : 361|2@0+ (1,0) [0|3] "" ADC
 SG_ ARC_OD_Width_Obj_21_FR : 375|7@0+ (0.2,0) [0|25.4] "m" ADC
 SG_ ARC_OD_RCS_Obj_21_FR : 368|9@0+ (0.2,-51.1) [-51.1|51.1] "dBsm" ADC
 SG_ ARC_OD_Orientation_Obj_21_FR : 391|10@0+ (0.01,-5.11) [-5.11|5.12] "rad" ADC
 SG_ ARC_OD_LifeCycle_Obj_21_FR : 423|16@0+ (1,0) [0|65535] "" ADC
 SG_ ARC_OD_ObstacleProb_Obj_20_FR : 447|7@0+ (1,0) [0|127] "%" ADC
 SG_ ARC_OD_ObstacleProb_Obj_21_FR : 455|7@0+ (1,0) [0|127] "%" ADC
 SG_ ARC_OD_VabsY_Obj_20_FR : 43|11@0+ (0.125,-128) [-128|127.875] "m/s" ADC
 SG_ ARC_OD_ID_20_FR : 463|8@0+ (1,0) [0|255] "" ADC
 SG_ ARC_OD_ID_21_FR : 471|8@0+ (1,0) [0|255] "" ADC
 SG_ ARC_OD_MsgCounter_Obj_20_21_FR : 491|4@0+ (1,0) [0|15] "" ADC
 SG_ ARC_OD_CRC8_Obj_20_21_FR : 511|8@0+ (1,0) [0|256] "" ADC
 SG_ ARC_OD_AabsY_Obj_20_FR : 48|9@0+ (0.125,-31.875) [-31.875|32] "m/s^2" ADC
 SG_ ARC_OD_DistXStd_Obj_20_FR : 71|8@0+ (0.05,0) [0|12.75] "m" ADC
 SG_ ARC_OD_DistYStd_Obj_20_FR : 79|8@0+ (0.1,0) [0|25.5] "m" ADC
 SG_ ARC_OD_VabsXStd_Obj_20_FR : 87|7@0+ (0.1,0) [0|12.7] "m/s" ADC
 SG_ ARC_OD_VabsYStd_Obj_20_FR : 80|7@0+ (0.2,0) [0|25.4] "m/s" ADC
 SG_ ARC_OD_AabsXStd_Obj_20_FR : 89|7@0+ (0.25,0) [0|31.75] "m/s^2" ADC

BO_ 1370 ARC_OD_18_19_FR: 64 ARC
 SG_ DistHeight_Obj_19_FR : 487|8@0+ (0.2,-10) [-10|41] "m" ADC
 SG_ DistHeight_Obj_18_FR : 479|8@0+ (0.2,-10) [-10|41] "m" ADC
 SG_ ARC_OD_DistX_Obj_18_FR : 7|12@0+ (0.1,-152) [-152|257.5] "m" ADC
 SG_ ARC_OD_Classification_Obj_18_FR : 98|3@0+ (1,0) [0|7] "" ADC
 SG_ ARC_OD_AabsYStd_Obj_18_FR : 111|8@0+ (0.25,0) [0|63.75] "m/s^2" ADC
 SG_ ARC_OD_ClassConf_Obj_18_FR : 119|7@0+ (1,0) [0|127] "%" ADC
 SG_ ARC_OD_ProbOfExist_Obj_18_FR : 112|7@0+ (1,0) [0|127] "%" ADC
 SG_ ARC_OD_VabsX_Obj_18_FR : 11|11@0+ (0.125,-128) [-128|127.875] "m/s" ADC
 SG_ ARC_OD_DynProp_Obj_18_FR : 130|3@0+ (1,0) [0|7] "" ADC
 SG_ ARC_OD_Length_Obj_18_FR : 136|7@0+ (0.2,0) [0|25.4] "m" ADC
 SG_ ARC_OD_MaintenanceState_Obj_0041 : 145|2@0+ (1,0) [0|3] "" ADC
 SG_ ARC_OD_Width_Obj_18_FR : 159|7@0+ (0.2,0) [0|25.4] "m" ADC
 SG_ ARC_OD_RCS_Obj_18_FR : 152|9@0+ (0.2,-51.1) [-51.1|51.1] "dBsm" ADC
 SG_ ARC_OD_Orientation_Obj_18_FR : 175|10@0+ (0.01,-5.11) [-5.11|5.12] "rad" ADC
 SG_ ARC_OD_LifeCycle_Obj_18_FR : 207|16@0+ (1,0) [0|65535] "" ADC
 SG_ ARC_OD_DistX_Obj_19_FR : 223|12@0+ (0.1,-152) [-152|257.5] "m" ADC
 SG_ ARC_OD_VabsX_Obj_19_FR : 227|11@0+ (0.125,-128) [-128|127.875] "m/s" ADC
 SG_ ARC_OD_AabsX_Obj_19_FR : 232|9@0+ (0.125,-31.875) [-31.875|32] "m/s^2" ADC
 SG_ ARC_OD_AabsX_Obj_18_FR : 16|9@0+ (0.125,-31.875) [-31.875|32] "m/s^2" ADC
 SG_ ARC_OD_DistY_Obj_19_FR : 255|12@0+ (0.0875,-179.113) [-179.113|179.2] "m" ADC
 SG_ ARC_OD_VabsY_Obj_19_FR : 259|11@0+ (0.125,-128) [-128|127.875] "m/s" ADC
 SG_ ARC_OD_AabsY_Obj_19_FR : 264|9@0+ (0.125,-31.875) [-31.875|32] "m/s^2" ADC
 SG_ ARC_OD_DistXStd_Obj_19_FR : 287|8@0+ (0.05,0) [0|12.75] "m" ADC
 SG_ ARC_OD_DistYStd_Obj_19_FR : 295|8@0+ (0.1,0) [0|25.5] "m" ADC
 SG_ ARC_OD_VabsXStd_Obj_19_FR : 303|7@0+ (0.1,0) [0|12.7] "m/s" ADC
 SG_ ARC_OD_VabsYStd_Obj_19_FR : 296|7@0+ (0.2,0) [0|25.4] "m/s" ADC
 SG_ ARC_OD_AabsXStd_Obj_19_FR : 305|7@0+ (0.25,0) [0|31.75] "m/s^2" ADC
 SG_ ARC_OD_Classification_Obj_19_FR : 314|3@0+ (1,0) [0|7] "" ADC
 SG_ ARC_OD_AabsYStd_Obj_19_FR : 327|8@0+ (0.25,0) [0|63.75] "m/s^2" ADC
 SG_ ARC_OD_ClassConf_Obj_19_FR : 335|7@0+ (1,0) [0|127] "%" ADC
 SG_ ARC_OD_DistY_Obj_18_FR : 39|12@0+ (0.0875,-179.113) [-179.113|179.2] "m" ADC
 SG_ ARC_OD_ProbOfExist_Obj_19_FR : 328|7@0+ (1,0) [0|127] "%" ADC
 SG_ ARC_OD_DynProp_Obj_19_FR : 346|3@0+ (1,0) [0|7] "" ADC
 SG_ ARC_OD_Length_Obj_19_FR : 352|7@0+ (0.2,0) [0|25.4] "m" ADC
 SG_ ARC_OD_MaintenanceState_Obj_0042 : 361|2@0+ (1,0) [0|3] "" ADC
 SG_ ARC_OD_Width_Obj_19_FR : 375|7@0+ (0.2,0) [0|25.4] "m" ADC
 SG_ ARC_OD_RCS_Obj_19_FR : 368|9@0+ (0.2,-51.1) [-51.1|51.1] "dBsm" ADC
 SG_ ARC_OD_Orientation_Obj_19_FR : 391|10@0+ (0.01,-5.11) [-5.11|5.12] "rad" ADC
 SG_ ARC_OD_LifeCycle_Obj_19_FR : 423|16@0+ (1,0) [0|65535] "" ADC
 SG_ ARC_OD_ObstacleProb_Obj_18_FR : 447|7@0+ (1,0) [0|127] "%" ADC
 SG_ ARC_OD_ObstacleProb_Obj_19_FR : 455|7@0+ (1,0) [0|127] "%" ADC
 SG_ ARC_OD_VabsY_Obj_18_FR : 43|11@0+ (0.125,-128) [-128|127.875] "m/s" ADC
 SG_ ARC_OD_ID_18_FR : 463|8@0+ (1,0) [0|255] "" ADC
 SG_ ARC_OD_ID_19_FR : 471|8@0+ (1,0) [0|255] "" ADC
 SG_ ARC_OD_MsgCounter_Obj_18_19_FR : 491|4@0+ (1,0) [0|15] "" ADC
 SG_ ARC_OD_CRC8_Obj_18_19_FR : 511|8@0+ (1,0) [0|256] "" ADC
 SG_ ARC_OD_AabsY_Obj_18_FR : 48|9@0+ (0.125,-31.875) [-31.875|32] "m/s^2" ADC
 SG_ ARC_OD_DistXStd_Obj_18_FR : 71|8@0+ (0.05,0) [0|12.75] "m" ADC
 SG_ ARC_OD_DistYStd_Obj_18_FR : 79|8@0+ (0.1,0) [0|25.5] "m" ADC
 SG_ ARC_OD_VabsXStd_Obj_18_FR : 87|7@0+ (0.1,0) [0|12.7] "m/s" ADC
 SG_ ARC_OD_VabsYStd_Obj_18_FR : 80|7@0+ (0.2,0) [0|25.4] "m/s" ADC
 SG_ ARC_OD_AabsXStd_Obj_18_FR : 89|7@0+ (0.25,0) [0|31.75] "m/s^2" ADC

BO_ 1369 ARC_OD_16_17_FR: 64 ARC
 SG_ DistHeight_Obj_17_FR : 487|8@0+ (0.2,-10) [-10|41] "m" ADC
 SG_ DistHeight_Obj_16_FR : 479|8@0+ (0.2,-10) [-10|41] "m" ADC
 SG_ ARC_OD_DistX_Obj_16_FR : 7|12@0+ (0.1,-152) [-152|257.5] "m" ADC
 SG_ ARC_OD_Classification_Obj_16_FR : 98|3@0+ (1,0) [0|7] "" ADC
 SG_ ARC_OD_AabsYStd_Obj_16_FR : 111|8@0+ (0.25,0) [0|63.75] "m/s^2" ADC
 SG_ ARC_OD_ClassConf_Obj_16_FR : 119|7@0+ (1,0) [0|127] "%" ADC
 SG_ ARC_OD_ProbOfExist_Obj_16_FR : 112|7@0+ (1,0) [0|127] "%" ADC
 SG_ ARC_OD_VabsX_Obj_16_FR : 11|11@0+ (0.125,-128) [-128|127.875] "m/s" ADC
 SG_ ARC_OD_DynProp_Obj_16_FR : 130|3@0+ (1,0) [0|7] "" ADC
 SG_ ARC_OD_Length_Obj_16_FR : 136|7@0+ (0.2,0) [0|25.4] "m" ADC
 SG_ ARC_OD_MaintenanceState_Obj_0043 : 145|2@0+ (1,0) [0|3] "" ADC
 SG_ ARC_OD_Width_Obj_16_FR : 159|7@0+ (0.2,0) [0|25.4] "m" ADC
 SG_ ARC_OD_RCS_Obj_16_FR : 152|9@0+ (0.2,-51.1) [-51.1|51.1] "dBsm" ADC
 SG_ ARC_OD_Orientation_Obj_16_FR : 175|10@0+ (0.01,-5.11) [-5.11|5.12] "rad" ADC
 SG_ ARC_OD_LifeCycle_Obj_16_FR : 207|16@0+ (1,0) [0|65535] "" ADC
 SG_ ARC_OD_DistX_Obj_17_FR : 223|12@0+ (0.1,-152) [-152|257.5] "m" ADC
 SG_ ARC_OD_VabsX_Obj_17_FR : 227|11@0+ (0.125,-128) [-128|127.875] "m/s" ADC
 SG_ ARC_OD_AabsX_Obj_17_FR : 232|9@0+ (0.125,-31.875) [-31.875|32] "m/s^2" ADC
 SG_ ARC_OD_AabsX_Obj_16_FR : 16|9@0+ (0.125,-31.875) [-31.875|32] "m/s^2" ADC
 SG_ ARC_OD_DistY_Obj_17_FR : 255|12@0+ (0.0875,-179.113) [-179.113|179.2] "m" ADC
 SG_ ARC_OD_VabsY_Obj_17_FR : 259|11@0+ (0.125,-128) [-128|127.875] "m/s" ADC
 SG_ ARC_OD_AabsY_Obj_17_FR : 264|9@0+ (0.125,-31.875) [-31.875|32] "m/s^2" ADC
 SG_ ARC_OD_DistXStd_Obj_17_FR : 287|8@0+ (0.05,0) [0|12.75] "m" ADC
 SG_ ARC_OD_DistYStd_Obj_17_FR : 295|8@0+ (0.1,0) [0|25.5] "m" ADC
 SG_ ARC_OD_VabsXStd_Obj_17_FR : 303|7@0+ (0.1,0) [0|12.7] "m/s" ADC
 SG_ ARC_OD_VabsYStd_Obj_17_FR : 296|7@0+ (0.2,0) [0|25.4] "m/s" ADC
 SG_ ARC_OD_AabsXStd_Obj_17_FR : 305|7@0+ (0.25,0) [0|31.75] "m/s^2" ADC
 SG_ ARC_OD_Classification_Obj_17_FR : 314|3@0+ (1,0) [0|7] "" ADC
 SG_ ARC_OD_AabsYStd_Obj_17_FR : 327|8@0+ (0.25,0) [0|63.75] "m/s^2" ADC
 SG_ ARC_OD_ClassConf_Obj_17_FR : 335|7@0+ (1,0) [0|127] "%" ADC
 SG_ ARC_OD_DistY_Obj_16_FR : 39|12@0+ (0.0875,-179.113) [-179.113|179.2] "m" ADC
 SG_ ARC_OD_ProbOfExist_Obj_17_FR : 328|7@0+ (1,0) [0|127] "%" ADC
 SG_ ARC_OD_DynProp_Obj_17_FR : 346|3@0+ (1,0) [0|7] "" ADC
 SG_ ARC_OD_Length_Obj_17_FR : 352|7@0+ (0.2,0) [0|25.4] "m" ADC
 SG_ ARC_OD_MaintenanceState_Obj_0044 : 361|2@0+ (1,0) [0|3] "" ADC
 SG_ ARC_OD_Width_Obj_17_FR : 375|7@0+ (0.2,0) [0|25.4] "m" ADC
 SG_ ARC_OD_RCS_Obj_17_FR : 368|9@0+ (0.2,-51.1) [-51.1|51.1] "dBsm" ADC
 SG_ ARC_OD_Orientation_Obj_17_FR : 391|10@0+ (0.01,-5.11) [-5.11|5.12] "rad" ADC
 SG_ ARC_OD_LifeCycle_Obj_17_FR : 423|16@0+ (1,0) [0|65535] "" ADC
 SG_ ARC_OD_ObstacleProb_Obj_16_FR : 447|7@0+ (1,0) [0|127] "%" ADC
 SG_ ARC_OD_ObstacleProb_Obj_17_FR : 455|7@0+ (1,0) [0|127] "%" ADC
 SG_ ARC_OD_VabsY_Obj_16_FR : 43|11@0+ (0.125,-128) [-128|127.875] "m/s" ADC
 SG_ ARC_OD_ID_16_FR : 463|8@0+ (1,0) [0|255] "" ADC
 SG_ ARC_OD_ID_17_FR : 471|8@0+ (1,0) [0|255] "" ADC
 SG_ ARC_OD_MsgCounter_Obj_16_17_FR : 491|4@0+ (1,0) [0|15] "" ADC
 SG_ ARC_OD_CRC8_Obj_16_17_FR : 511|8@0+ (1,0) [0|256] "" ADC
 SG_ ARC_OD_AabsY_Obj_16_FR : 48|9@0+ (0.125,-31.875) [-31.875|32] "m/s^2" ADC
 SG_ ARC_OD_DistXStd_Obj_16_FR : 71|8@0+ (0.05,0) [0|12.75] "m" ADC
 SG_ ARC_OD_DistYStd_Obj_16_FR : 79|8@0+ (0.1,0) [0|25.5] "m" ADC
 SG_ ARC_OD_VabsXStd_Obj_16_FR : 87|7@0+ (0.1,0) [0|12.7] "m/s" ADC
 SG_ ARC_OD_VabsYStd_Obj_16_FR : 80|7@0+ (0.2,0) [0|25.4] "m/s" ADC
 SG_ ARC_OD_AabsXStd_Obj_16_FR : 89|7@0+ (0.25,0) [0|31.75] "m/s^2" ADC

BO_ 1368 ARC_OD_14_15_FR: 64 ARC
 SG_ DistHeight_Obj_15_FR : 487|8@0+ (0.2,-10) [-10|41] "m" ADC
 SG_ DistHeight_Obj_14_FR : 479|8@0+ (0.2,-10) [-10|41] "m" ADC
 SG_ ARC_OD_DistX_Obj_14_FR : 7|12@0+ (0.1,-152) [-152|257.5] "m" ADC
 SG_ ARC_OD_Classification_Obj_14_FR : 98|3@0+ (1,0) [0|7] "" ADC
 SG_ ARC_OD_AabsYStd_Obj_14_FR : 111|8@0+ (0.25,0) [0|63.75] "m/s^2" ADC
 SG_ ARC_OD_ClassConf_Obj_14_FR : 119|7@0+ (1,0) [0|127] "%" ADC
 SG_ ARC_OD_ProbOfExist_Obj_14_FR : 112|7@0+ (1,0) [0|127] "%" ADC
 SG_ ARC_OD_VabsX_Obj_14_FR : 11|11@0+ (0.125,-128) [-128|127.875] "m/s" ADC
 SG_ ARC_OD_DynProp_Obj_14_FR : 130|3@0+ (1,0) [0|7] "" ADC
 SG_ ARC_OD_Length_Obj_14_FR : 136|7@0+ (0.2,0) [0|25.4] "m" ADC
 SG_ ARC_OD_MaintenanceState_Obj_0045 : 145|2@0+ (1,0) [0|3] "" ADC
 SG_ ARC_OD_Width_Obj_14_FR : 159|7@0+ (0.2,0) [0|25.4] "m" ADC
 SG_ ARC_OD_RCS_Obj_14_FR : 152|9@0+ (0.2,-51.1) [-51.1|51.1] "dBsm" ADC
 SG_ ARC_OD_Orientation_Obj_14_FR : 175|10@0+ (0.01,-5.11) [-5.11|5.12] "rad" ADC
 SG_ ARC_OD_LifeCycle_Obj_14_FR : 207|16@0+ (1,0) [0|65535] "" ADC
 SG_ ARC_OD_DistX_Obj_15_FR : 223|12@0+ (0.1,-152) [-152|257.5] "m" ADC
 SG_ ARC_OD_VabsX_Obj_15_FR : 227|11@0+ (0.125,-128) [-128|127.875] "m/s" ADC
 SG_ ARC_OD_AabsX_Obj_15_FR : 232|9@0+ (0.125,-31.875) [-31.875|32] "m/s^2" ADC
 SG_ ARC_OD_AabsX_Obj_14_FR : 16|9@0+ (0.125,-31.875) [-31.875|32] "m/s^2" ADC
 SG_ ARC_OD_DistY_Obj_15_FR : 255|12@0+ (0.0875,-179.113) [-179.113|179.2] "m" ADC
 SG_ ARC_OD_VabsY_Obj_15_FR : 259|11@0+ (0.125,-128) [-128|127.875] "m/s" ADC
 SG_ ARC_OD_AabsY_Obj_15_FR : 264|9@0+ (0.125,-31.875) [-31.875|32] "m/s^2" ADC
 SG_ ARC_OD_DistXStd_Obj_15_FR : 287|8@0+ (0.05,0) [0|12.75] "m" ADC
 SG_ ARC_OD_DistYStd_Obj_15_FR : 295|8@0+ (0.1,0) [0|25.5] "m" ADC
 SG_ ARC_OD_VabsXStd_Obj_15_FR : 303|7@0+ (0.1,0) [0|12.7] "m/s" ADC
 SG_ ARC_OD_VabsYStd_Obj_15_FR : 296|7@0+ (0.2,0) [0|25.4] "m/s" ADC
 SG_ ARC_OD_AabsXStd_Obj_15_FR : 305|7@0+ (0.25,0) [0|31.75] "m/s^2" ADC
 SG_ ARC_OD_Classification_Obj_15_FR : 314|3@0+ (1,0) [0|7] "" ADC
 SG_ ARC_OD_AabsYStd_Obj_15_FR : 327|8@0+ (0.25,0) [0|63.75] "m/s^2" ADC
 SG_ ARC_OD_ClassConf_Obj_15_FR : 335|7@0+ (1,0) [0|127] "%" ADC
 SG_ ARC_OD_DistY_Obj_14_FR : 39|12@0+ (0.0875,-179.113) [-179.113|179.2] "m" ADC
 SG_ ARC_OD_ProbOfExist_Obj_15_FR : 328|7@0+ (1,0) [0|127] "%" ADC
 SG_ ARC_OD_DynProp_Obj_15_FR : 346|3@0+ (1,0) [0|7] "" ADC
 SG_ ARC_OD_Length_Obj_15_FR : 352|7@0+ (0.2,0) [0|25.4] "m" ADC
 SG_ ARC_OD_MaintenanceState_Obj_0046 : 361|2@0+ (1,0) [0|3] "" ADC
 SG_ ARC_OD_Width_Obj_15_FR : 375|7@0+ (0.2,0) [0|25.4] "m" ADC
 SG_ ARC_OD_RCS_Obj_15_FR : 368|9@0+ (0.2,-51.1) [-51.1|51.1] "dBsm" ADC
 SG_ ARC_OD_Orientation_Obj_15_FR : 391|10@0+ (0.01,-5.11) [-5.11|5.12] "rad" ADC
 SG_ ARC_OD_LifeCycle_Obj_15_FR : 423|16@0+ (1,0) [0|65535] "" ADC
 SG_ ARC_OD_ObstacleProb_Obj_14_FR : 447|7@0+ (1,0) [0|127] "%" ADC
 SG_ ARC_OD_ObstacleProb_Obj_15_FR : 455|7@0+ (1,0) [0|127] "%" ADC
 SG_ ARC_OD_VabsY_Obj_14_FR : 43|11@0+ (0.125,-128) [-128|127.875] "m/s" ADC
 SG_ ARC_OD_ID_14_FR : 463|8@0+ (1,0) [0|255] "" ADC
 SG_ ARC_OD_ID_15_FR : 471|8@0+ (1,0) [0|255] "" ADC
 SG_ ARC_OD_MsgCounter_Obj_14_15_FR : 491|4@0+ (1,0) [0|15] "" ADC
 SG_ ARC_OD_CRC8_Obj_14_15_FR : 511|8@0+ (1,0) [0|256] "" ADC
 SG_ ARC_OD_AabsY_Obj_14_FR : 48|9@0+ (0.125,-31.875) [-31.875|32] "m/s^2" ADC
 SG_ ARC_OD_DistXStd_Obj_14_FR : 71|8@0+ (0.05,0) [0|12.75] "m" ADC
 SG_ ARC_OD_DistYStd_Obj_14_FR : 79|8@0+ (0.1,0) [0|25.5] "m" ADC
 SG_ ARC_OD_VabsXStd_Obj_14_FR : 87|7@0+ (0.1,0) [0|12.7] "m/s" ADC
 SG_ ARC_OD_VabsYStd_Obj_14_FR : 80|7@0+ (0.2,0) [0|25.4] "m/s" ADC
 SG_ ARC_OD_AabsXStd_Obj_14_FR : 89|7@0+ (0.25,0) [0|31.75] "m/s^2" ADC

BO_ 1367 ARC_OD_12_13_FR: 64 ARC
 SG_ DistHeight_Obj_13_FR : 487|8@0+ (0.2,-10) [-10|41] "m" ADC
 SG_ DistHeight_Obj_12_FR : 479|8@0+ (0.2,-10) [-10|41] "m" ADC
 SG_ ARC_OD_DistX_Obj_12_FR : 7|12@0+ (0.1,-152) [-152|257.5] "m" ADC
 SG_ ARC_OD_Classification_Obj_12_FR : 98|3@0+ (1,0) [0|7] "" ADC
 SG_ ARC_OD_AabsYStd_Obj_12_FR : 111|8@0+ (0.25,0) [0|63.75] "m/s^2" ADC
 SG_ ARC_OD_ClassConf_Obj_12_FR : 119|7@0+ (1,0) [0|127] "%" ADC
 SG_ ARC_OD_ProbOfExist_Obj_12_FR : 112|7@0+ (1,0) [0|127] "%" ADC
 SG_ ARC_OD_VabsX_Obj_12_FR : 11|11@0+ (0.125,-128) [-128|127.875] "m/s" ADC
 SG_ ARC_OD_DynProp_Obj_12_FR : 130|3@0+ (1,0) [0|7] "" ADC
 SG_ ARC_OD_Length_Obj_12_FR : 136|7@0+ (0.2,0) [0|25.4] "m" ADC
 SG_ ARC_OD_MaintenanceState_Obj_0047 : 145|2@0+ (1,0) [0|3] "" ADC
 SG_ ARC_OD_Width_Obj_12_FR : 159|7@0+ (0.2,0) [0|25.4] "m" ADC
 SG_ ARC_OD_RCS_Obj_12_FR : 152|9@0+ (0.2,-51.1) [-51.1|51.1] "dBsm" ADC
 SG_ ARC_OD_Orientation_Obj_12_FR : 175|10@0+ (0.01,-5.11) [-5.11|5.12] "rad" ADC
 SG_ ARC_OD_LifeCycle_Obj_12_FR : 207|16@0+ (1,0) [0|65535] "" ADC
 SG_ ARC_OD_DistX_Obj_13_FR : 223|12@0+ (0.1,-152) [-152|257.5] "m" ADC
 SG_ ARC_OD_VabsX_Obj_13_FR : 227|11@0+ (0.125,-128) [-128|127.875] "m/s" ADC
 SG_ ARC_OD_AabsX_Obj_13_FR : 232|9@0+ (0.125,-31.875) [-31.875|32] "m/s^2" ADC
 SG_ ARC_OD_AabsX_Obj_12_FR : 16|9@0+ (0.125,-31.875) [-31.875|32] "m/s^2" ADC
 SG_ ARC_OD_DistY_Obj_13_FR : 255|12@0+ (0.0875,-179.113) [-179.113|179.2] "m" ADC
 SG_ ARC_OD_VabsY_Obj_13_FR : 259|11@0+ (0.125,-128) [-128|127.875] "m/s" ADC
 SG_ ARC_OD_AabsY_Obj_13_FR : 264|9@0+ (0.125,-31.875) [-31.875|32] "m/s^2" ADC
 SG_ ARC_OD_DistXStd_Obj_13_FR : 287|8@0+ (0.05,0) [0|12.75] "m" ADC
 SG_ ARC_OD_DistYStd_Obj_13_FR : 295|8@0+ (0.1,0) [0|25.5] "m" ADC
 SG_ ARC_OD_VabsXStd_Obj_13_FR : 303|7@0+ (0.1,0) [0|12.7] "m/s" ADC
 SG_ ARC_OD_VabsYStd_Obj_13_FR : 296|7@0+ (0.2,0) [0|25.4] "m/s" ADC
 SG_ ARC_OD_AabsXStd_Obj_13_FR : 305|7@0+ (0.25,0) [0|31.75] "m/s^2" ADC
 SG_ ARC_OD_Classification_Obj_13_FR : 314|3@0+ (1,0) [0|7] "" ADC
 SG_ ARC_OD_AabsYStd_Obj_13_FR : 327|8@0+ (0.25,0) [0|63.75] "m/s^2" ADC
 SG_ ARC_OD_ClassConf_Obj_13_FR : 335|7@0+ (1,0) [0|127] "%" ADC
 SG_ ARC_OD_DistY_Obj_12_FR : 39|12@0+ (0.0875,-179.113) [-179.113|179.2] "m" ADC
 SG_ ARC_OD_ProbOfExist_Obj_13_FR : 328|7@0+ (1,0) [0|127] "%" ADC
 SG_ ARC_OD_DynProp_Obj_13_FR : 346|3@0+ (1,0) [0|7] "" ADC
 SG_ ARC_OD_Length_Obj_13_FR : 352|7@0+ (0.2,0) [0|25.4] "m" ADC
 SG_ ARC_OD_MaintenanceState_Obj_0048 : 361|2@0+ (1,0) [0|3] "" ADC
 SG_ ARC_OD_Width_Obj_13_FR : 375|7@0+ (0.2,0) [0|25.4] "m" ADC
 SG_ ARC_OD_RCS_Obj_13_FR : 368|9@0+ (0.2,-51.1) [-51.1|51.1] "dBsm" ADC
 SG_ ARC_OD_Orientation_Obj_13_FR : 391|10@0+ (0.01,-5.11) [-5.11|5.12] "rad" ADC
 SG_ ARC_OD_LifeCycle_Obj_13_FR : 423|16@0+ (1,0) [0|65535] "" ADC
 SG_ ARC_OD_ObstacleProb_Obj_12_FR : 447|7@0+ (1,0) [0|127] "%" ADC
 SG_ ARC_OD_ObstacleProb_Obj_13_FR : 455|7@0+ (1,0) [0|127] "%" ADC
 SG_ ARC_OD_VabsY_Obj_12_FR : 43|11@0+ (0.125,-128) [-128|127.875] "m/s" ADC
 SG_ ARC_OD_ID_12_FR : 463|8@0+ (1,0) [0|255] "" ADC
 SG_ ARC_OD_ID_13_FR : 471|8@0+ (1,0) [0|255] "" ADC
 SG_ ARC_OD_MsgCounter_Obj_12_13_FR : 491|4@0+ (1,0) [0|15] "" ADC
 SG_ ARC_OD_CRC8_Obj_12_13_FR : 511|8@0+ (1,0) [0|256] "" ADC
 SG_ ARC_OD_AabsY_Obj_12_FR : 48|9@0+ (0.125,-31.875) [-31.875|32] "m/s^2" ADC
 SG_ ARC_OD_DistXStd_Obj_12_FR : 71|8@0+ (0.05,0) [0|12.75] "m" ADC
 SG_ ARC_OD_DistYStd_Obj_12_FR : 79|8@0+ (0.1,0) [0|25.5] "m" ADC
 SG_ ARC_OD_VabsXStd_Obj_12_FR : 87|7@0+ (0.1,0) [0|12.7] "m/s" ADC
 SG_ ARC_OD_VabsYStd_Obj_12_FR : 80|7@0+ (0.2,0) [0|25.4] "m/s" ADC
 SG_ ARC_OD_AabsXStd_Obj_12_FR : 89|7@0+ (0.25,0) [0|31.75] "m/s^2" ADC

BO_ 1366 ARC_OD_10_11_FR: 64 ARC
 SG_ DistHeight_Obj_11_FR : 487|8@0+ (0.2,-10) [-10|41] "m" ADC
 SG_ DistHeight_Obj_10_FR : 479|8@0+ (0.2,-10) [-10|41] "m" ADC
 SG_ ARC_OD_DistX_Obj_10_FR : 7|12@0+ (0.1,-152) [-152|257.5] "m" ADC
 SG_ ARC_OD_Classification_Obj_10_FR : 98|3@0+ (1,0) [0|7] "" ADC
 SG_ ARC_OD_AabsYStd_Obj_10_FR : 111|8@0+ (0.25,0) [0|63.75] "m/s^2" ADC
 SG_ ARC_OD_ClassConf_Obj_10_FR : 119|7@0+ (1,0) [0|127] "%" ADC
 SG_ ARC_OD_ProbOfExist_Obj_10_FR : 112|7@0+ (1,0) [0|127] "%" ADC
 SG_ ARC_OD_VabsX_Obj_10_FR : 11|11@0+ (0.125,-128) [-128|127.875] "m/s" ADC
 SG_ ARC_OD_DynProp_Obj_10_FR : 130|3@0+ (1,0) [0|7] "" ADC
 SG_ ARC_OD_Length_Obj_10_FR : 136|7@0+ (0.2,0) [0|25.4] "m" ADC
 SG_ ARC_OD_MaintenanceState_Obj_0049 : 145|2@0+ (1,0) [0|3] "" ADC
 SG_ ARC_OD_Width_Obj_10_FR : 159|7@0+ (0.2,0) [0|25.4] "m" ADC
 SG_ ARC_OD_RCS_Obj_10_FR : 152|9@0+ (0.2,-51.1) [-51.1|51.1] "dBsm" ADC
 SG_ ARC_OD_Orientation_Obj_10_FR : 175|10@0+ (0.01,-5.11) [-5.11|5.12] "rad" ADC
 SG_ ARC_OD_LifeCycle_Obj_10_FR : 207|16@0+ (1,0) [0|65535] "" ADC
 SG_ ARC_OD_DistX_Obj_11_FR : 223|12@0+ (0.1,-152) [-152|257.5] "m" ADC
 SG_ ARC_OD_VabsX_Obj_11_FR : 227|11@0+ (0.125,-128) [-128|127.875] "m/s" ADC
 SG_ ARC_OD_AabsX_Obj_11_FR : 232|9@0+ (0.125,-31.875) [-31.875|32] "m/s^2" ADC
 SG_ ARC_OD_AabsX_Obj_10_FR : 16|9@0+ (0.125,-31.875) [-31.875|32] "m/s^2" ADC
 SG_ ARC_OD_DistY_Obj_11_FR : 255|12@0+ (0.0875,-179.113) [-179.113|179.2] "m" ADC
 SG_ ARC_OD_VabsY_Obj_11_FR : 259|11@0+ (0.125,-128) [-128|127.875] "m/s" ADC
 SG_ ARC_OD_AabsY_Obj_11_FR : 264|9@0+ (0.125,-31.875) [-31.875|32] "m/s^2" ADC
 SG_ ARC_OD_DistXStd_Obj_11_FR : 287|8@0+ (0.05,0) [0|12.75] "m" ADC
 SG_ ARC_OD_DistYStd_Obj_11_FR : 295|8@0+ (0.1,0) [0|25.5] "m" ADC
 SG_ ARC_OD_VabsXStd_Obj_11_FR : 303|7@0+ (0.1,0) [0|12.7] "m/s" ADC
 SG_ ARC_OD_VabsYStd_Obj_11_FR : 296|7@0+ (0.2,0) [0|25.4] "m/s" ADC
 SG_ ARC_OD_AabsXStd_Obj_11_FR : 305|7@0+ (0.25,0) [0|31.75] "m/s^2" ADC
 SG_ ARC_OD_Classification_Obj_11_FR : 314|3@0+ (1,0) [0|7] "" ADC
 SG_ ARC_OD_AabsYStd_Obj_11_FR : 327|8@0+ (0.25,0) [0|63.75] "m/s^2" ADC
 SG_ ARC_OD_ClassConf_Obj_11_FR : 335|7@0+ (1,0) [0|127] "%" ADC
 SG_ ARC_OD_DistY_Obj_10_FR : 39|12@0+ (0.0875,-179.113) [-179.113|179.2] "m" ADC
 SG_ ARC_OD_ProbOfExist_Obj_11_FR : 328|7@0+ (1,0) [0|127] "%" ADC
 SG_ ARC_OD_DynProp_Obj_11_FR : 346|3@0+ (1,0) [0|7] "" ADC
 SG_ ARC_OD_Length_Obj_11_FR : 352|7@0+ (0.2,0) [0|25.4] "m" ADC
 SG_ ARC_OD_MaintenanceState_Obj_0050 : 361|2@0+ (1,0) [0|3] "" ADC
 SG_ ARC_OD_Width_Obj_11_FR : 375|7@0+ (0.2,0) [0|25.4] "m" ADC
 SG_ ARC_OD_RCS_Obj_11_FR : 368|9@0+ (0.2,-51.1) [-51.1|51.1] "dBsm" ADC
 SG_ ARC_OD_Orientation_Obj_11_FR : 391|10@0+ (0.01,-5.11) [-5.11|5.12] "rad" ADC
 SG_ ARC_OD_LifeCycle_Obj_11_FR : 423|16@0+ (1,0) [0|65535] "" ADC
 SG_ ARC_OD_ObstacleProb_Obj_10_FR : 447|7@0+ (1,0) [0|127] "%" ADC
 SG_ ARC_OD_ObstacleProb_Obj_11_FR : 455|7@0+ (1,0) [0|127] "%" ADC
 SG_ ARC_OD_VabsY_Obj_10_FR : 43|11@0+ (0.125,-128) [-128|127.875] "m/s" ADC
 SG_ ARC_OD_ID_10_FR : 463|8@0+ (1,0) [0|255] "" ADC
 SG_ ARC_OD_ID_11_FR : 471|8@0+ (1,0) [0|255] "" ADC
 SG_ ARC_OD_MsgCounter_Obj_10_11_FR : 491|4@0+ (1,0) [0|15] "" ADC
 SG_ ARC_OD_CRC8_Obj_10_11_FR : 511|8@0+ (1,0) [0|256] "" ADC
 SG_ ARC_OD_AabsY_Obj_10_FR : 48|9@0+ (0.125,-31.875) [-31.875|32] "m/s^2" ADC
 SG_ ARC_OD_DistXStd_Obj_10_FR : 71|8@0+ (0.05,0) [0|12.75] "m" ADC
 SG_ ARC_OD_DistYStd_Obj_10_FR : 79|8@0+ (0.1,0) [0|25.5] "m" ADC
 SG_ ARC_OD_VabsXStd_Obj_10_FR : 87|7@0+ (0.1,0) [0|12.7] "m/s" ADC
 SG_ ARC_OD_VabsYStd_Obj_10_FR : 80|7@0+ (0.2,0) [0|25.4] "m/s" ADC
 SG_ ARC_OD_AabsXStd_Obj_10_FR : 89|7@0+ (0.25,0) [0|31.75] "m/s^2" ADC

BO_ 1365 ARC_OD_08_09_FR: 64 ARC
 SG_ DistHeight_Obj_09_FR : 487|8@0+ (0.2,-10) [-10|41] "m" ADC
 SG_ DistHeight_Obj_08_FR : 479|8@0+ (0.2,-10) [-10|41] "m" ADC
 SG_ ARC_OD_DistX_Obj_08_FR : 7|12@0+ (0.1,-152) [-152|257.5] "m" ADC
 SG_ ARC_OD_Classification_Obj_08_FR : 98|3@0+ (1,0) [0|7] "" ADC
 SG_ ARC_OD_AabsYStd_Obj_08_FR : 111|8@0+ (0.25,0) [0|63.75] "m/s^2" ADC
 SG_ ARC_OD_ClassConf_Obj_08_FR : 119|7@0+ (1,0) [0|127] "%" ADC
 SG_ ARC_OD_ProbOfExist_Obj_08_FR : 112|7@0+ (1,0) [0|127] "%" ADC
 SG_ ARC_OD_VabsX_Obj_08_FR : 11|11@0+ (0.125,-128) [-128|127.875] "m/s" ADC
 SG_ ARC_OD_DynProp_Obj_08_FR : 130|3@0+ (1,0) [0|7] "" ADC
 SG_ ARC_OD_Length_Obj_08_FR : 136|7@0+ (0.2,0) [0|25.4] "m" ADC
 SG_ ARC_OD_MaintenanceState_Obj_0051 : 145|2@0+ (1,0) [0|3] "" ADC
 SG_ ARC_OD_Width_Obj_08_FR : 159|7@0+ (0.2,0) [0|25.4] "m" ADC
 SG_ ARC_OD_RCS_Obj_08_FR : 152|9@0+ (0.2,-51.1) [-51.1|51.1] "dBsm" ADC
 SG_ ARC_OD_Orientation_Obj_08_FR : 175|10@0+ (0.01,-5.11) [-5.11|5.12] "rad" ADC
 SG_ ARC_OD_LifeCycle_Obj_08_FR : 207|16@0+ (1,0) [0|65535] "" ADC
 SG_ ARC_OD_DistX_Obj_09_FR : 223|12@0+ (0.1,-152) [-152|257.5] "m" ADC
 SG_ ARC_OD_VabsX_Obj_09_FR : 227|11@0+ (0.125,-128) [-128|127.875] "m/s" ADC
 SG_ ARC_OD_AabsX_Obj_09_FR : 232|9@0+ (0.125,-31.875) [-31.875|32] "m/s^2" ADC
 SG_ ARC_OD_AabsX_Obj_08_FR : 16|9@0+ (0.125,-31.875) [-31.875|32] "m/s^2" ADC
 SG_ ARC_OD_DistY_Obj_09_FR : 255|12@0+ (0.0875,-179.113) [-179.113|179.2] "m" ADC
 SG_ ARC_OD_VabsY_Obj_09_FR : 259|11@0+ (0.125,-128) [-128|127.875] "m/s" ADC
 SG_ ARC_OD_AabsY_Obj_09_FR : 264|9@0+ (0.125,-31.875) [-31.875|32] "m/s^2" ADC
 SG_ ARC_OD_DistXStd_Obj_09_FR : 287|8@0+ (0.05,0) [0|12.75] "m" ADC
 SG_ ARC_OD_DistYStd_Obj_09_FR : 295|8@0+ (0.1,0) [0|25.5] "m" ADC
 SG_ ARC_OD_VabsXStd_Obj_09_FR : 303|7@0+ (0.1,0) [0|12.7] "m/s" ADC
 SG_ ARC_OD_VabsYStd_Obj_09_FR : 296|7@0+ (0.2,0) [0|25.4] "m/s" ADC
 SG_ ARC_OD_AabsXStd_Obj_09_FR : 305|7@0+ (0.25,0) [0|31.75] "m/s^2" ADC
 SG_ ARC_OD_Classification_Obj_09_FR : 314|3@0+ (1,0) [0|7] "" ADC
 SG_ ARC_OD_AabsYStd_Obj_09_FR : 327|8@0+ (0.25,0) [0|63.75] "m/s^2" ADC
 SG_ ARC_OD_ClassConf_Obj_09_FR : 335|7@0+ (1,0) [0|127] "%" ADC
 SG_ ARC_OD_DistY_Obj_08_FR : 39|12@0+ (0.0875,-179.113) [-179.113|179.2] "m" ADC
 SG_ ARC_OD_ProbOfExist_Obj_09_FR : 328|7@0+ (1,0) [0|127] "%" ADC
 SG_ ARC_OD_DynProp_Obj_09_FR : 346|3@0+ (1,0) [0|7] "" ADC
 SG_ ARC_OD_Length_Obj_09_FR : 352|7@0+ (0.2,0) [0|25.4] "m" ADC
 SG_ ARC_OD_MaintenanceState_Obj_0052 : 361|2@0+ (1,0) [0|3] "" ADC
 SG_ ARC_OD_Width_Obj_09_FR : 375|7@0+ (0.2,0) [0|25.4] "m" ADC
 SG_ ARC_OD_RCS_Obj_09_FR : 368|9@0+ (0.2,-51.1) [-51.1|51.1] "dBsm" ADC
 SG_ ARC_OD_Orientation_Obj_09_FR : 391|10@0+ (0.01,-5.11) [-5.11|5.12] "rad" ADC
 SG_ ARC_OD_LifeCycle_Obj_09_FR : 423|16@0+ (1,0) [0|65535] "" ADC
 SG_ ARC_OD_ObstacleProb_Obj_08_FR : 447|7@0+ (1,0) [0|127] "%" ADC
 SG_ ARC_OD_ObstacleProb_Obj_09_FR : 455|7@0+ (1,0) [0|127] "%" ADC
 SG_ ARC_OD_VabsY_Obj_08_FR : 43|11@0+ (0.125,-128) [-128|127.875] "m/s" ADC
 SG_ ARC_OD_ID_08_FR : 463|8@0+ (1,0) [0|255] "" ADC
 SG_ ARC_OD_ID_09_FR : 471|8@0+ (1,0) [0|255] "" ADC
 SG_ ARC_OD_MsgCounter_Obj_08_09_FR : 491|4@0+ (1,0) [0|15] "" ADC
 SG_ ARC_OD_CRC8_Obj_08_09_FR : 511|8@0+ (1,0) [0|256] "" ADC
 SG_ ARC_OD_AabsY_Obj_08_FR : 48|9@0+ (0.125,-31.875) [-31.875|32] "m/s^2" ADC
 SG_ ARC_OD_DistXStd_Obj_08_FR : 71|8@0+ (0.05,0) [0|12.75] "m" ADC
 SG_ ARC_OD_DistYStd_Obj_08_FR : 79|8@0+ (0.1,0) [0|25.5] "m" ADC
 SG_ ARC_OD_VabsXStd_Obj_08_FR : 87|7@0+ (0.1,0) [0|12.7] "m/s" ADC
 SG_ ARC_OD_VabsYStd_Obj_08_FR : 80|7@0+ (0.2,0) [0|25.4] "m/s" ADC
 SG_ ARC_OD_AabsXStd_Obj_08_FR : 89|7@0+ (0.25,0) [0|31.75] "m/s^2" ADC

BO_ 1364 ARC_OD_06_07_FR: 64 ARC
 SG_ DistHeight_Obj_07_FR : 487|8@0+ (0.2,-10) [-10|41] "m" ADC
 SG_ DistHeight_Obj_06_FR : 479|8@0+ (0.2,-10) [-10|41] "m" ADC
 SG_ ARC_OD_DistX_Obj_06_FR : 7|12@0+ (0.1,-152) [-152|257.5] "m" ADC
 SG_ ARC_OD_Classification_Obj_06_FR : 98|3@0+ (1,0) [0|7] "" ADC
 SG_ ARC_OD_AabsYStd_Obj_06_FR : 111|8@0+ (0.25,0) [0|63.75] "m/s^2" ADC
 SG_ ARC_OD_ClassConf_Obj_06_FR : 119|7@0+ (1,0) [0|127] "%" ADC
 SG_ ARC_OD_ProbOfExist_Obj_06_FR : 112|7@0+ (1,0) [0|127] "%" ADC
 SG_ ARC_OD_VabsX_Obj_06_FR : 11|11@0+ (0.125,-128) [-128|127.875] "m/s" ADC
 SG_ ARC_OD_DynProp_Obj_06_FR : 130|3@0+ (1,0) [0|7] "" ADC
 SG_ ARC_OD_Length_Obj_06_FR : 136|7@0+ (0.2,0) [0|25.4] "m" ADC
 SG_ ARC_OD_MaintenanceState_Obj_0053 : 145|2@0+ (1,0) [0|3] "" ADC
 SG_ ARC_OD_Width_Obj_06_FR : 159|7@0+ (0.2,0) [0|25.4] "m" ADC
 SG_ ARC_OD_RCS_Obj_06_FR : 152|9@0+ (0.2,-51.1) [-51.1|51.1] "dBsm" ADC
 SG_ ARC_OD_Orientation_Obj_06_FR : 175|10@0+ (0.01,-5.11) [-5.11|5.12] "rad" ADC
 SG_ ARC_OD_LifeCycle_Obj_06_FR : 207|16@0+ (1,0) [0|65535] "" ADC
 SG_ ARC_OD_DistX_Obj_07_FR : 223|12@0+ (0.1,-152) [-152|257.5] "m" ADC
 SG_ ARC_OD_VabsX_Obj_07_FR : 227|11@0+ (0.125,-128) [-128|127.875] "m/s" ADC
 SG_ ARC_OD_AabsX_Obj_07_FR : 232|9@0+ (0.125,-31.875) [-31.875|32] "m/s^2" ADC
 SG_ ARC_OD_AabsX_Obj_06_FR : 16|9@0+ (0.125,-31.875) [-31.875|32] "m/s^2" ADC
 SG_ ARC_OD_DistY_Obj_07_FR : 255|12@0+ (0.0875,-179.113) [-179.113|179.2] "m" ADC
 SG_ ARC_OD_VabsY_Obj_07_FR : 259|11@0+ (0.125,-128) [-128|127.875] "m/s" ADC
 SG_ ARC_OD_AabsY_Obj_07_FR : 264|9@0+ (0.125,-31.875) [-31.875|32] "m/s^2" ADC
 SG_ ARC_OD_DistXStd_Obj_07_FR : 287|8@0+ (0.05,0) [0|12.75] "m" ADC
 SG_ ARC_OD_DistYStd_Obj_07_FR : 295|8@0+ (0.1,0) [0|25.5] "m" ADC
 SG_ ARC_OD_VabsXStd_Obj_07_FR : 303|7@0+ (0.1,0) [0|12.7] "m/s" ADC
 SG_ ARC_OD_VabsYStd_Obj_07_FR : 296|7@0+ (0.2,0) [0|25.4] "m/s" ADC
 SG_ ARC_OD_AabsXStd_Obj_07_FR : 305|7@0+ (0.25,0) [0|31.75] "m/s^2" ADC
 SG_ ARC_OD_Classification_Obj_07_FR : 314|3@0+ (1,0) [0|7] "" ADC
 SG_ ARC_OD_AabsYStd_Obj_07_FR : 327|8@0+ (0.25,0) [0|63.75] "m/s^2" ADC
 SG_ ARC_OD_ClassConf_Obj_07_FR : 335|7@0+ (1,0) [0|127] "%" ADC
 SG_ ARC_OD_DistY_Obj_06_FR : 39|12@0+ (0.0875,-179.113) [-179.113|179.2] "m" ADC
 SG_ ARC_OD_ProbOfExist_Obj_07_FR : 328|7@0+ (1,0) [0|127] "%" ADC
 SG_ ARC_OD_DynProp_Obj_07_FR : 346|3@0+ (1,0) [0|7] "" ADC
 SG_ ARC_OD_Length_Obj_07_FR : 352|7@0+ (0.2,0) [0|25.4] "m" ADC
 SG_ ARC_OD_MaintenanceState_Obj_0054 : 361|2@0+ (1,0) [0|3] "" ADC
 SG_ ARC_OD_Width_Obj_07_FR : 375|7@0+ (0.2,0) [0|25.4] "m" ADC
 SG_ ARC_OD_RCS_Obj_07_FR : 368|9@0+ (0.2,-51.1) [-51.1|51.1] "dBsm" ADC
 SG_ ARC_OD_Orientation_Obj_07_FR : 391|10@0+ (0.01,-5.11) [-5.11|5.12] "rad" ADC
 SG_ ARC_OD_LifeCycle_Obj_07_FR : 423|16@0+ (1,0) [0|65535] "" ADC
 SG_ ARC_OD_ObstacleProb_Obj_06_FR : 447|7@0+ (1,0) [0|127] "%" ADC
 SG_ ARC_OD_ObstacleProb_Obj_07_FR : 455|7@0+ (1,0) [0|127] "%" ADC
 SG_ ARC_OD_VabsY_Obj_06_FR : 43|11@0+ (0.125,-128) [-128|127.875] "m/s" ADC
 SG_ ARC_OD_ID_06_FR : 463|8@0+ (1,0) [0|255] "" ADC
 SG_ ARC_OD_ID_07_FR : 471|8@0+ (1,0) [0|255] "" ADC
 SG_ ARC_OD_MsgCounter_Obj_06_07_FR : 491|4@0+ (1,0) [0|15] "" ADC
 SG_ ARC_OD_CRC8_Obj_06_07_FR : 511|8@0+ (1,0) [0|256] "" ADC
 SG_ ARC_OD_AabsY_Obj_06_FR : 48|9@0+ (0.125,-31.875) [-31.875|32] "m/s^2" ADC
 SG_ ARC_OD_DistXStd_Obj_06_FR : 71|8@0+ (0.05,0) [0|12.75] "m" ADC
 SG_ ARC_OD_DistYStd_Obj_06_FR : 79|8@0+ (0.1,0) [0|25.5] "m" ADC
 SG_ ARC_OD_VabsXStd_Obj_06_FR : 87|7@0+ (0.1,0) [0|12.7] "m/s" ADC
 SG_ ARC_OD_VabsYStd_Obj_06_FR : 80|7@0+ (0.2,0) [0|25.4] "m/s" ADC
 SG_ ARC_OD_AabsXStd_Obj_06_FR : 89|7@0+ (0.25,0) [0|31.75] "m/s^2" ADC

BO_ 1363 ARC_OD_04_05_FR: 64 ARC
 SG_ DistHeight_Obj_05_FR : 487|8@0+ (0.2,-10) [-10|41] "m" ADC
 SG_ DistHeight_Obj_04_FR : 479|8@0+ (0.2,-10) [-10|41] "m" ADC
 SG_ ARC_OD_DistX_Obj_04_FR : 7|12@0+ (0.1,-152) [-152|257.5] "m" ADC
 SG_ ARC_OD_Classification_Obj_04_FR : 98|3@0+ (1,0) [0|7] "" ADC
 SG_ ARC_OD_AabsYStd_Obj_04_FR : 111|8@0+ (0.25,0) [0|63.75] "m/s^2" ADC
 SG_ ARC_OD_ClassConf_Obj_04_FR : 119|7@0+ (1,0) [0|127] "%" ADC
 SG_ ARC_OD_ProbOfExist_Obj_04_FR : 112|7@0+ (1,0) [0|127] "%" ADC
 SG_ ARC_OD_VabsX_Obj_04_FR : 11|11@0+ (0.125,-128) [-128|127.875] "m/s" ADC
 SG_ ARC_OD_DynProp_Obj_04_FR : 130|3@0+ (1,0) [0|7] "" ADC
 SG_ ARC_OD_Length_Obj_04_FR : 136|7@0+ (0.2,0) [0|25.4] "m" ADC
 SG_ ARC_OD_MaintenanceState_Obj_0055 : 145|2@0+ (1,0) [0|3] "" ADC
 SG_ ARC_OD_Width_Obj_04_FR : 159|7@0+ (0.2,0) [0|25.4] "m" ADC
 SG_ ARC_OD_RCS_Obj_04_FR : 152|9@0+ (0.2,-51.1) [-51.1|51.1] "dBsm" ADC
 SG_ ARC_OD_Orientation_Obj_04_FR : 175|10@0+ (0.01,-5.11) [-5.11|5.12] "rad" ADC
 SG_ ARC_OD_LifeCycle_Obj_04_FR : 207|16@0+ (1,0) [0|65535] "" ADC
 SG_ ARC_OD_DistX_Obj_05_FR : 223|12@0+ (0.1,-152) [-152|257.5] "m" ADC
 SG_ ARC_OD_VabsX_Obj_05_FR : 227|11@0+ (0.125,-128) [-128|127.875] "m/s" ADC
 SG_ ARC_OD_AabsX_Obj_05_FR : 232|9@0+ (0.125,-31.875) [-31.875|32] "m/s^2" ADC
 SG_ ARC_OD_AabsX_Obj_04_FR : 16|9@0+ (0.125,-31.875) [-31.875|32] "m/s^2" ADC
 SG_ ARC_OD_DistY_Obj_05_FR : 255|12@0+ (0.0875,-179.113) [-179.113|179.2] "m" ADC
 SG_ ARC_OD_VabsY_Obj_05_FR : 259|11@0+ (0.125,-128) [-128|127.875] "m/s" ADC
 SG_ ARC_OD_AabsY_Obj_05_FR : 264|9@0+ (0.125,-31.875) [-31.875|32] "m/s^2" ADC
 SG_ ARC_OD_DistXStd_Obj_05_FR : 287|8@0+ (0.05,0) [0|12.75] "m" ADC
 SG_ ARC_OD_DistYStd_Obj_05_FR : 295|8@0+ (0.1,0) [0|25.5] "m" ADC
 SG_ ARC_OD_VabsXStd_Obj_05_FR : 303|7@0+ (0.1,0) [0|12.7] "m/s" ADC
 SG_ ARC_OD_VabsYStd_Obj_05_FR : 296|7@0+ (0.2,0) [0|25.4] "m/s" ADC
 SG_ ARC_OD_AabsXStd_Obj_05_FR : 305|7@0+ (0.25,0) [0|31.75] "m/s^2" ADC
 SG_ ARC_OD_Classification_Obj_05_FR : 314|3@0+ (1,0) [0|7] "" ADC
 SG_ ARC_OD_AabsYStd_Obj_05_FR : 327|8@0+ (0.25,0) [0|63.75] "m/s^2" ADC
 SG_ ARC_OD_ClassConf_Obj_05_FR : 335|7@0+ (1,0) [0|127] "%" ADC
 SG_ ARC_OD_DistY_Obj_04_FR : 39|12@0+ (0.0875,-179.113) [-179.113|179.2] "m" ADC
 SG_ ARC_OD_ProbOfExist_Obj_05_FR : 328|7@0+ (1,0) [0|127] "%" ADC
 SG_ ARC_OD_DynProp_Obj_05_FR : 346|3@0+ (1,0) [0|7] "" ADC
 SG_ ARC_OD_Length_Obj_05_FR : 352|7@0+ (0.2,0) [0|25.4] "m" ADC
 SG_ ARC_OD_MaintenanceState_Obj_0056 : 361|2@0+ (1,0) [0|3] "" ADC
 SG_ ARC_OD_Width_Obj_05_FR : 375|7@0+ (0.2,0) [0|25.4] "m" ADC
 SG_ ARC_OD_RCS_Obj_05_FR : 368|9@0+ (0.2,-51.1) [-51.1|51.1] "dBsm" ADC
 SG_ ARC_OD_Orientation_Obj_05_FR : 391|10@0+ (0.01,-5.11) [-5.11|5.12] "rad" ADC
 SG_ ARC_OD_LifeCycle_Obj_05_FR : 423|16@0+ (1,0) [0|65535] "" ADC
 SG_ ARC_OD_ObstacleProb_Obj_04_FR : 447|7@0+ (1,0) [0|127] "%" ADC
 SG_ ARC_OD_ObstacleProb_Obj_05_FR : 455|7@0+ (1,0) [0|127] "%" ADC
 SG_ ARC_OD_VabsY_Obj_04_FR : 43|11@0+ (0.125,-128) [-128|127.875] "m/s" ADC
 SG_ ARC_OD_ID_04_FR : 463|8@0+ (1,0) [0|255] "" ADC
 SG_ ARC_OD_ID_05_FR : 471|8@0+ (1,0) [0|255] "" ADC
 SG_ ARC_OD_MsgCounter_Obj_04_05_FR : 491|4@0+ (1,0) [0|15] "" ADC
 SG_ ARC_OD_CRC8_Obj_04_05_FR : 511|8@0+ (1,0) [0|256] "" ADC
 SG_ ARC_OD_AabsY_Obj_04_FR : 48|9@0+ (0.125,-31.875) [-31.875|32] "m/s^2" ADC
 SG_ ARC_OD_DistXStd_Obj_04_FR : 71|8@0+ (0.05,0) [0|12.75] "m" ADC
 SG_ ARC_OD_DistYStd_Obj_04_FR : 79|8@0+ (0.1,0) [0|25.5] "m" ADC
 SG_ ARC_OD_VabsXStd_Obj_04_FR : 87|7@0+ (0.1,0) [0|12.7] "m/s" ADC
 SG_ ARC_OD_VabsYStd_Obj_04_FR : 80|7@0+ (0.2,0) [0|25.4] "m/s" ADC
 SG_ ARC_OD_AabsXStd_Obj_04_FR : 89|7@0+ (0.25,0) [0|31.75] "m/s^2" ADC

BO_ 1362 ARC_OD_02_03_FR: 64 ARC
 SG_ DistHeight_Obj_03_FR : 487|8@0+ (0.2,-10) [-10|41] "m" ADC
 SG_ DistHeight_Obj_02_FR : 479|8@0+ (0.2,-10) [-10|41] "m" ADC
 SG_ ARC_OD_DistX_Obj_02_FR : 7|12@0+ (0.1,-152) [-152|257.5] "m" ADC
 SG_ ARC_OD_Classification_Obj_02_FR : 98|3@0+ (1,0) [0|7] "" ADC
 SG_ ARC_OD_AabsYStd_Obj_02_FR : 111|8@0+ (0.25,0) [0|63.75] "m/s^2" ADC
 SG_ ARC_OD_ClassConf_Obj_02_FR : 119|7@0+ (1,0) [0|127] "%" ADC
 SG_ ARC_OD_ProbOfExist_Obj_02_FR : 112|7@0+ (1,0) [0|127] "%" ADC
 SG_ ARC_OD_VabsX_Obj_02_FR : 11|11@0+ (0.125,-128) [-128|127.875] "m/s" ADC
 SG_ ARC_OD_DynProp_Obj_02_FR : 130|3@0+ (1,0) [0|7] "" ADC
 SG_ ARC_OD_Length_Obj_02_FR : 136|7@0+ (0.2,0) [0|25.4] "m" ADC
 SG_ ARC_OD_MaintenanceState_Obj_0057 : 145|2@0+ (1,0) [0|3] "" ADC
 SG_ ARC_OD_Width_Obj_02_FR : 159|7@0+ (0.2,0) [0|25.4] "m" ADC
 SG_ ARC_OD_RCS_Obj_02_FR : 152|9@0+ (0.2,-51.1) [-51.1|51.1] "dBsm" ADC
 SG_ ARC_OD_Orientation_Obj_02_FR : 175|10@0+ (0.01,-5.11) [-5.11|5.12] "rad" ADC
 SG_ ARC_OD_LifeCycle_Obj_02_FR : 207|16@0+ (1,0) [0|65535] "" ADC
 SG_ ARC_OD_DistX_Obj_03_FR : 223|12@0+ (0.1,-152) [-152|257.5] "m" ADC
 SG_ ARC_OD_VabsX_Obj_03_FR : 227|11@0+ (0.125,-128) [-128|127.875] "m/s" ADC
 SG_ ARC_OD_AabsX_Obj_03_FR : 232|9@0+ (0.125,-31.875) [-31.875|32] "m/s^2" ADC
 SG_ ARC_OD_AabsX_Obj_02_FR : 16|9@0+ (0.125,-31.875) [-31.875|32] "m/s^2" ADC
 SG_ ARC_OD_DistY_Obj_03_FR : 255|12@0+ (0.0875,-179.113) [-179.113|179.2] "m" ADC
 SG_ ARC_OD_VabsY_Obj_03_FR : 259|11@0+ (0.125,-128) [-128|127.875] "m/s" ADC
 SG_ ARC_OD_AabsY_Obj_03_FR : 264|9@0+ (0.125,-31.875) [-31.875|32] "m/s^2" ADC
 SG_ ARC_OD_DistXStd_Obj_03_FR : 287|8@0+ (0.05,0) [0|12.75] "m" ADC
 SG_ ARC_OD_DistYStd_Obj_03_FR : 295|8@0+ (0.1,0) [0|25.5] "m" ADC
 SG_ ARC_OD_VabsXStd_Obj_03_FR : 303|7@0+ (0.1,0) [0|12.7] "m/s" ADC
 SG_ ARC_OD_VabsYStd_Obj_03_FR : 296|7@0+ (0.2,0) [0|25.4] "m/s" ADC
 SG_ ARC_OD_AabsXStd_Obj_03_FR : 305|7@0+ (0.25,0) [0|31.75] "m/s^2" ADC
 SG_ ARC_OD_Classification_Obj_03_FR : 314|3@0+ (1,0) [0|7] "" ADC
 SG_ ARC_OD_AabsYStd_Obj_03_FR : 327|8@0+ (0.25,0) [0|63.75] "m/s^2" ADC
 SG_ ARC_OD_ClassConf_Obj_03_FR : 335|7@0+ (1,0) [0|127] "%" ADC
 SG_ ARC_OD_DistY_Obj_02_FR : 39|12@0+ (0.0875,-179.113) [-179.113|179.2] "m" ADC
 SG_ ARC_OD_ProbOfExist_Obj_03_FR : 328|7@0+ (1,0) [0|127] "%" ADC
 SG_ ARC_OD_DynProp_Obj_03_FR : 346|3@0+ (1,0) [0|7] "" ADC
 SG_ ARC_OD_Length_Obj_03_FR : 352|7@0+ (0.2,0) [0|25.4] "m" ADC
 SG_ ARC_OD_MaintenanceState_Obj_0058 : 361|2@0+ (1,0) [0|3] "" ADC
 SG_ ARC_OD_Width_Obj_03_FR : 375|7@0+ (0.2,0) [0|25.4] "m" ADC
 SG_ ARC_OD_RCS_Obj_03_FR : 368|9@0+ (0.2,-51.1) [-51.1|51.1] "dBsm" ADC
 SG_ ARC_OD_Orientation_Obj_03_FR : 391|10@0+ (0.01,-5.11) [-5.11|5.12] "rad" ADC
 SG_ ARC_OD_LifeCycle_Obj_03_FR : 423|16@0+ (1,0) [0|65535] "" ADC
 SG_ ARC_OD_ObstacleProb_Obj_02_FR : 447|7@0+ (1,0) [0|127] "%" ADC
 SG_ ARC_OD_ObstacleProb_Obj_03_FR : 455|7@0+ (1,0) [0|127] "%" ADC
 SG_ ARC_OD_VabsY_Obj_02_FR : 43|11@0+ (0.125,-128) [-128|127.875] "m/s" ADC
 SG_ ARC_OD_ID_02_FR : 463|8@0+ (1,0) [0|255] "" ADC
 SG_ ARC_OD_ID_03_FR : 471|8@0+ (1,0) [0|255] "" ADC
 SG_ ARC_OD_MsgCounter_Obj_02_03_FR : 491|4@0+ (1,0) [0|15] "" ADC
 SG_ ARC_OD_CRC8_Obj_02_03_FR : 511|8@0+ (1,0) [0|255] "" ADC
 SG_ ARC_OD_AabsY_Obj_02_FR : 48|9@0+ (0.125,-31.875) [-31.875|32] "m/s^2" ADC
 SG_ ARC_OD_DistXStd_Obj_02_FR : 71|8@0+ (0.05,0) [0|12.75] "m" ADC
 SG_ ARC_OD_DistYStd_Obj_02_FR : 79|8@0+ (0.1,0) [0|25.5] "m" ADC
 SG_ ARC_OD_VabsXStd_Obj_02_FR : 87|7@0+ (0.1,0) [0|12.7] "m/s" ADC
 SG_ ARC_OD_VabsYStd_Obj_02_FR : 80|7@0+ (0.2,0) [0|25.4] "m/s" ADC
 SG_ ARC_OD_AabsXStd_Obj_02_FR : 89|7@0+ (0.25,0) [0|31.75] "m/s^2" ADC

BO_ 1361 ARC_OD_00_01_FR: 64 ARC
 SG_ DistHeight_Obj_01_FR : 487|8@0+ (0.2,-10) [-10|41] "m" ADC
 SG_ DistHeight_Obj_00_FR : 479|8@0+ (0.2,-10) [-10|41] "m" ADC
 SG_ ARC_OD_DistX_Obj_00_FR : 7|12@0+ (0.1,-152) [-152|257.5] "m" ADC
 SG_ ARC_OD_Classification_Obj_00_FR : 98|3@0+ (1,0) [0|7] "" ADC
 SG_ ARC_OD_AabsYStd_Obj_00_FR : 111|8@0+ (0.25,0) [0|63.75] "m/s^2" ADC
 SG_ ARC_OD_ClassConf_Obj_00_FR : 119|7@0+ (1,0) [0|127] "%" ADC
 SG_ ARC_OD_ProbOfExist_Obj_00_FR : 112|7@0+ (1,0) [0|127] "%" ADC
 SG_ ARC_OD_VabsX_Obj_00_FR : 11|11@0+ (0.125,-128) [-128|127.875] "m/s" ADC
 SG_ ARC_OD_DynProp_Obj_00_FR : 130|3@0+ (1,0) [0|7] "" ADC
 SG_ ARC_OD_Length_Obj_00_FR : 136|7@0+ (0.2,0) [0|25.4] "m" ADC
 SG_ ARC_OD_MaintenanceState_Obj_0059 : 145|2@0+ (1,0) [0|3] "" ADC
 SG_ ARC_OD_Width_Obj_00_FR : 159|7@0+ (0.2,0) [0|25.4] "m" ADC
 SG_ ARC_OD_RCS_Obj_00_FR : 152|9@0+ (0.2,-51.1) [-51.1|51.1] "dBsm" ADC
 SG_ ARC_OD_Orientation_Obj_00_FR : 175|10@0+ (0.01,-5.11) [-5.11|5.12] "rad" ADC
 SG_ ARC_OD_LifeCycle_Obj_00_FR : 207|16@0+ (1,0) [0|65535] "" ADC
 SG_ ARC_OD_DistX_Obj_01_FR : 223|12@0+ (0.1,-152) [-152|257.5] "m" ADC
 SG_ ARC_OD_VabsX_Obj_01_FR : 227|11@0+ (0.125,-128) [-128|127.875] "m/s" ADC
 SG_ ARC_OD_AabsX_Obj_01_FR : 232|9@0+ (0.125,-31.875) [-31.875|32] "m/s^2" ADC
 SG_ ARC_OD_AabsX_Obj_00_FR : 16|9@0+ (0.125,-31.875) [-31.875|32] "m/s^2" ADC
 SG_ ARC_OD_DistY_Obj_01_FR : 255|12@0+ (0.0875,-179.113) [-179.113|179.2] "m" ADC
 SG_ ARC_OD_VabsY_Obj_01_FR : 259|11@0+ (0.125,-128) [-128|127.875] "m/s" ADC
 SG_ ARC_OD_AabsY_Obj_01_FR : 264|9@0+ (0.125,-31.875) [-31.875|32] "m/s^2" ADC
 SG_ ARC_OD_DistXStd_Obj_01_FR : 287|8@0+ (0.05,0) [0|12.75] "m" ADC
 SG_ ARC_OD_DistYStd_Obj_01_FR : 295|8@0+ (0.1,0) [0|25.5] "m" ADC
 SG_ ARC_OD_VabsXStd_Obj_01_FR : 303|7@0+ (0.1,0) [0|12.7] "m/s" ADC
 SG_ ARC_OD_VabsYStd_Obj_01_FR : 296|7@0+ (0.2,0) [0|25.4] "m/s" ADC
 SG_ ARC_OD_AabsXStd_Obj_01_FR : 305|7@0+ (0.25,0) [0|31.75] "m/s^2" ADC
 SG_ ARC_OD_Classification_Obj_01_FR : 314|3@0+ (1,0) [0|7] "" ADC
 SG_ ARC_OD_AabsYStd_Obj_01_FR : 327|8@0+ (0.25,0) [0|63.75] "m/s^2" ADC
 SG_ ARC_OD_ClassConf_Obj_01_FR : 335|7@0+ (1,0) [0|127] "%" ADC
 SG_ ARC_OD_DistY_Obj_00_FR : 39|12@0+ (0.0875,-179.113) [-179.113|179.2] "m" ADC
 SG_ ARC_OD_ProbOfExist_Obj_01_FR : 328|7@0+ (1,0) [0|127] "%" ADC
 SG_ ARC_OD_DynProp_Obj_01_FR : 346|3@0+ (1,0) [0|7] "" ADC
 SG_ ARC_OD_Length_Obj_01_FR : 352|7@0+ (0.2,0) [0|25.4] "m" ADC
 SG_ ARC_OD_MaintenanceState_Obj_0060 : 361|2@0+ (1,0) [0|3] "" ADC
 SG_ ARC_OD_Width_Obj_01_FR : 375|7@0+ (0.2,0) [0|25.4] "m" ADC
 SG_ ARC_OD_RCS_Obj_01_FR : 368|9@0+ (0.2,-51.1) [-51.1|51.1] "dBsm" ADC
 SG_ ARC_OD_Orientation_Obj_01_FR : 391|10@0+ (0.01,-5.11) [-5.11|5.12] "rad" ADC
 SG_ ARC_OD_LifeCycle_Obj_01_FR : 423|16@0+ (1,0) [0|65535] "" ADC
 SG_ ARC_OD_ObstacleProb_Obj_00_FR : 447|7@0+ (1,0) [0|127] "%" ADC
 SG_ ARC_OD_ObstacleProb_Obj_01_FR : 455|7@0+ (1,0) [0|127] "%" ADC
 SG_ ARC_OD_VabsY_Obj_00_FR : 43|11@0+ (0.125,-128) [-128|127.875] "m/s" ADC
 SG_ ARC_OD_ID_00_FR : 463|8@0+ (1,0) [0|255] "" ADC
 SG_ ARC_OD_ID_01_FR : 471|8@0+ (1,0) [0|255] "" ADC
 SG_ ARC_OD_MsgCounter_Obj_00_01_FR : 491|4@0+ (1,0) [0|15] "" ADC
 SG_ ARC_OD_CRC8_Obj_00_01_FR : 511|8@0+ (1,0) [0|255] "" ADC
 SG_ ARC_OD_AabsY_Obj_00_FR : 48|9@0+ (0.125,-31.875) [-31.875|32] "m/s^2" ADC
 SG_ ARC_OD_DistXStd_Obj_00_FR : 71|8@0+ (0.05,0) [0|12.75] "m" ADC
 SG_ ARC_OD_DistYStd_Obj_00_FR : 79|8@0+ (0.1,0) [0|25.5] "m" ADC
 SG_ ARC_OD_VabsXStd_Obj_00_FR : 87|7@0+ (0.1,0) [0|12.7] "m/s" ADC
 SG_ ARC_OD_VabsYStd_Obj_00_FR : 80|7@0+ (0.2,0) [0|25.4] "m/s" ADC
 SG_ ARC_OD_AabsXStd_Obj_00_FR : 89|7@0+ (0.25,0) [0|31.75] "m/s^2" ADC

BO_ 1134 ARC_OD_58_59_RR: 64 ARC
 SG_ DistHeight_Obj_59_RR : 487|8@0+ (0.2,-10) [-10|41] "m" Vector__XXX
 SG_ DistHeight_Obj_58_RR : 479|8@0+ (0.2,-10) [-10|41] "m" Vector__XXX
 SG_ ARC_OD_DistX_Obj_58_RR : 7|12@0+ (0.1,-152) [-152|257.5] "m" ADC
 SG_ ARC_OD_Classification_Obj_58_RR : 98|3@0+ (1,0) [0|7] "" ADC
 SG_ ARC_OD_AabsYStd_Obj_58_RR : 111|8@0+ (0.25,0) [0|63.75] "m/s^2" ADC
 SG_ ARC_OD_ClassConf_Obj_58_RR : 119|7@0+ (1,0) [0|127] "%" ADC
 SG_ ARC_OD_ProbOfExist_Obj_58_RR : 112|7@0+ (1,0) [0|127] "%" ADC
 SG_ ARC_OD_VabsX_Obj_58_RR : 11|11@0+ (0.125,-128) [-128|127.875] "m/s" ADC
 SG_ ARC_OD_DynProp_Obj_58_RR : 130|3@0+ (1,0) [0|7] "" ADC
 SG_ ARC_OD_Length_Obj_58_RR : 136|7@0+ (0.2,0) [0|25.4] "m" ADC
 SG_ ARC_OD_MaintenanceState_Obj_58_R : 145|2@0+ (1,0) [0|3] "" ADC
 SG_ ARC_OD_Width_Obj_58_RR : 159|7@0+ (0.2,0) [0|25.4] "m" ADC
 SG_ ARC_OD_RCS_Obj_58_RR : 152|9@0+ (0.2,-51.1) [-51.1|51.1] "dBsm" ADC
 SG_ ARC_OD_Orientation_Obj_58_RR : 175|10@0+ (0.01,-5.11) [-5.11|5.12] "rad" ADC
 SG_ ARC_OD_LifeCycle_Obj_58_RR : 207|16@0+ (1,0) [0|65535] "" ADC
 SG_ ARC_OD_DistX_Obj_59_RR : 223|12@0+ (0.1,-152) [-152|257.5] "m" ADC
 SG_ ARC_OD_VabsX_Obj_59_RR : 227|11@0+ (0.125,-128) [-128|127.875] "m/s" ADC
 SG_ ARC_OD_AabsX_Obj_59_RR : 232|9@0+ (0.125,-31.875) [-31.875|32] "m/s^2" ADC
 SG_ ARC_OD_AabsX_Obj_58_RR : 16|9@0+ (0.125,-31.875) [-31.875|32] "m/s^2" ADC
 SG_ ARC_OD_DistY_Obj_59_RR : 255|12@0+ (0.0875,-179.113) [-179.113|179.2] "m" ADC
 SG_ ARC_OD_VabsY_Obj_59_RR : 259|11@0+ (0.125,-128) [-128|127.875] "m/s" ADC
 SG_ ARC_OD_AabsY_Obj_59_RR : 264|9@0+ (0.125,-31.875) [-31.875|32] "m/s^2" ADC
 SG_ ARC_OD_DistXStd_Obj_59_RR : 287|8@0+ (0.05,0) [0|12.75] "m" ADC
 SG_ ARC_OD_DistYStd_Obj_59_RR : 295|8@0+ (0.1,0) [0|25.5] "m" ADC
 SG_ ARC_OD_VabsXStd_Obj_59_RR : 303|7@0+ (0.1,0) [0|12.7] "m/s" ADC
 SG_ ARC_OD_VabsYStd_Obj_59_RR : 296|7@0+ (0.2,0) [0|25.4] "m/s" ADC
 SG_ ARC_OD_AabsXStd_Obj_59_RR : 305|7@0+ (0.25,0) [0|31.75] "m/s^2" ADC
 SG_ ARC_OD_Classification_Obj_59_RR : 314|3@0+ (1,0) [0|7] "" ADC
 SG_ ARC_OD_AabsYStd_Obj_59_RR : 327|8@0+ (0.25,0) [0|63.75] "m/s^2" ADC
 SG_ ARC_OD_ClassConf_Obj_59_RR : 335|7@0+ (1,0) [0|127] "%" ADC
 SG_ ARC_OD_DistY_Obj_58_RR : 39|12@0+ (0.0875,-179.113) [-179.113|179.2] "m" ADC
 SG_ ARC_OD_ProbOfExist_Obj_59_RR : 328|7@0+ (1,0) [0|127] "%" ADC
 SG_ ARC_OD_DynProp_Obj_59_RR : 346|3@0+ (1,0) [0|7] "" ADC
 SG_ ARC_OD_Length_Obj_59_RR : 352|7@0+ (0.2,0) [0|25.4] "m" ADC
 SG_ ARC_OD_MaintenanceState_Obj_59_R : 361|2@0+ (1,0) [0|3] "" ADC
 SG_ ARC_OD_Width_Obj_59_RR : 375|7@0+ (0.2,0) [0|25.4] "m" ADC
 SG_ ARC_OD_RCS_Obj_59_RR : 368|9@0+ (0.2,-51.1) [-51.1|51.1] "dBsm" ADC
 SG_ ARC_OD_Orientation_Obj_59_RR : 391|10@0+ (0.01,-5.11) [-5.11|5.12] "rad" ADC
 SG_ ARC_OD_LifeCycle_Obj_59_RR : 423|16@0+ (1,0) [0|65535] "" ADC
 SG_ ARC_OD_ObstacleProb_Obj_58_RR : 447|7@0+ (1,0) [0|127] "%" ADC
 SG_ ARC_OD_ObstacleProb_Obj_59_RR : 455|7@0+ (1,0) [0|127] "%" ADC
 SG_ ARC_OD_VabsY_Obj_58_RR : 43|11@0+ (0.125,-128) [-128|127.875] "m/s" ADC
 SG_ ARC_OD_ID_58_RR : 463|8@0+ (1,0) [0|255] "" ADC
 SG_ ARC_OD_ID_59_RR : 471|8@0+ (1,0) [0|255] "" ADC
 SG_ ARC_OD_MsgCounter_Obj_58_59_RR : 491|4@0+ (1,0) [0|15] "" ADC
 SG_ ARC_OD_CRC8_Obj_58_59_RR : 511|8@0+ (1,0) [0|256] "" ADC
 SG_ ARC_OD_AabsY_Obj_58_RR : 48|9@0+ (0.125,-31.875) [-31.875|32] "m/s^2" ADC
 SG_ ARC_OD_DistXStd_Obj_58_RR : 71|8@0+ (0.05,0) [0|12.75] "m" ADC
 SG_ ARC_OD_DistYStd_Obj_58_RR : 79|8@0+ (0.1,0) [0|25.5] "m" ADC
 SG_ ARC_OD_VabsXStd_Obj_58_RR : 87|7@0+ (0.1,0) [0|12.7] "m/s" ADC
 SG_ ARC_OD_VabsYStd_Obj_58_RR : 80|7@0+ (0.2,0) [0|25.4] "m/s" ADC
 SG_ ARC_OD_AabsXStd_Obj_58_RR : 89|7@0+ (0.25,0) [0|31.75] "m/s^2" ADC

BO_ 1133 ARC_OD_56_57_RR: 64 ARC
 SG_ DistHeight_Obj_57_RR : 487|8@0+ (0.2,-10) [-10|41] "m" Vector__XXX
 SG_ DistHeight_Obj_56_RR : 479|8@0+ (0.2,-10) [-10|41] "m" Vector__XXX
 SG_ ARC_OD_DistX_Obj_56_RR : 7|12@0+ (0.1,-152) [-152|257.5] "m" ADC
 SG_ ARC_OD_Classification_Obj_56_RR : 98|3@0+ (1,0) [0|7] "" ADC
 SG_ ARC_OD_AabsYStd_Obj_56_RR : 111|8@0+ (0.25,0) [0|63.75] "m/s^2" ADC
 SG_ ARC_OD_ClassConf_Obj_56_RR : 119|7@0+ (1,0) [0|127] "%" ADC
 SG_ ARC_OD_ProbOfExist_Obj_56_RR : 112|7@0+ (1,0) [0|127] "%" ADC
 SG_ ARC_OD_VabsX_Obj_56_RR : 11|11@0+ (0.125,-128) [-128|127.875] "m/s" ADC
 SG_ ARC_OD_DynProp_Obj_56_RR : 130|3@0+ (1,0) [0|7] "" ADC
 SG_ ARC_OD_Length_Obj_56_RR : 136|7@0+ (0.2,0) [0|25.4] "m" ADC
 SG_ ARC_OD_MaintenanceState_Obj_56_R : 145|2@0+ (1,0) [0|3] "" ADC
 SG_ ARC_OD_Width_Obj_56_RR : 159|7@0+ (0.2,0) [0|25.4] "m" ADC
 SG_ ARC_OD_RCS_Obj_56_RR : 152|9@0+ (0.2,-51.1) [-51.1|51.1] "dBsm" ADC
 SG_ ARC_OD_Orientation_Obj_56_RR : 175|10@0+ (0.01,-5.11) [-5.11|5.12] "rad" ADC
 SG_ ARC_OD_LifeCycle_Obj_56_RR : 207|16@0+ (1,0) [0|65535] "" ADC
 SG_ ARC_OD_DistX_Obj_57_RR : 223|12@0+ (0.1,-152) [-152|257.5] "m" ADC
 SG_ ARC_OD_VabsX_Obj_57_RR : 227|11@0+ (0.125,-128) [-128|127.875] "m/s" ADC
 SG_ ARC_OD_AabsX_Obj_57_RR : 232|9@0+ (0.125,-31.875) [-31.875|32] "m/s^2" ADC
 SG_ ARC_OD_AabsX_Obj_56_RR : 16|9@0+ (0.125,-31.875) [-31.875|32] "m/s^2" ADC
 SG_ ARC_OD_DistY_Obj_57_RR : 255|12@0+ (0.0875,-179.113) [-179.113|179.2] "m" ADC
 SG_ ARC_OD_VabsY_Obj_57_RR : 259|11@0+ (0.125,-128) [-128|127.875] "m/s" ADC
 SG_ ARC_OD_AabsY_Obj_57_RR : 264|9@0+ (0.125,-31.875) [-31.875|32] "m/s^2" ADC
 SG_ ARC_OD_DistXStd_Obj_57_RR : 287|8@0+ (0.05,0) [0|12.75] "m" ADC
 SG_ ARC_OD_DistYStd_Obj_57_RR : 295|8@0+ (0.1,0) [0|25.5] "m" ADC
 SG_ ARC_OD_VabsXStd_Obj_57_RR : 303|7@0+ (0.1,0) [0|12.7] "m/s" ADC
 SG_ ARC_OD_VabsYStd_Obj_57_RR : 296|7@0+ (0.2,0) [0|25.4] "m/s" ADC
 SG_ ARC_OD_AabsXStd_Obj_57_RR : 305|7@0+ (0.25,0) [0|31.75] "m/s^2" ADC
 SG_ ARC_OD_Classification_Obj_57_RR : 314|3@0+ (1,0) [0|7] "" ADC
 SG_ ARC_OD_AabsYStd_Obj_57_RR : 327|8@0+ (0.25,0) [0|63.75] "m/s^2" ADC
 SG_ ARC_OD_ClassConf_Obj_57_RR : 335|7@0+ (1,0) [0|127] "%" ADC
 SG_ ARC_OD_DistY_Obj_56_RR : 39|12@0+ (0.0875,-179.113) [-179.113|179.2] "m" ADC
 SG_ ARC_OD_ProbOfExist_Obj_57_RR : 328|7@0+ (1,0) [0|127] "%" ADC
 SG_ ARC_OD_DynProp_Obj_57_RR : 346|3@0+ (1,0) [0|7] "" ADC
 SG_ ARC_OD_Length_Obj_57_RR : 352|7@0+ (0.2,0) [0|25.4] "m" ADC
 SG_ ARC_OD_MaintenanceState_Obj_57_R : 361|2@0+ (1,0) [0|3] "" ADC
 SG_ ARC_OD_Width_Obj_57_RR : 375|7@0+ (0.2,0) [0|25.4] "m" ADC
 SG_ ARC_OD_RCS_Obj_57_RR : 368|9@0+ (0.2,-51.1) [-51.1|51.1] "dBsm" ADC
 SG_ ARC_OD_Orientation_Obj_57_RR : 391|10@0+ (0.01,-5.11) [-5.11|5.12] "rad" ADC
 SG_ ARC_OD_LifeCycle_Obj_57_RR : 423|16@0+ (1,0) [0|65535] "" ADC
 SG_ ARC_OD_ObstacleProb_Obj_56_RR : 447|7@0+ (1,0) [0|127] "%" ADC
 SG_ ARC_OD_ObstacleProb_Obj_57_RR : 455|7@0+ (1,0) [0|127] "%" ADC
 SG_ ARC_OD_VabsY_Obj_56_RR : 43|11@0+ (0.125,-128) [-128|127.875] "m/s" ADC
 SG_ ARC_OD_ID_56_RR : 463|8@0+ (1,0) [0|255] "" ADC
 SG_ ARC_OD_ID_57_RR : 471|8@0+ (1,0) [0|255] "" ADC
 SG_ ARC_OD_MsgCounter_Obj_56_57_RR : 491|4@0+ (1,0) [0|15] "" ADC
 SG_ ARC_OD_CRC8_Obj_56_57_RR : 511|8@0+ (1,0) [0|256] "" ADC
 SG_ ARC_OD_AabsY_Obj_56_RR : 48|9@0+ (0.125,-31.875) [-31.875|32] "m/s^2" ADC
 SG_ ARC_OD_DistXStd_Obj_56_RR : 71|8@0+ (0.05,0) [0|12.75] "m" ADC
 SG_ ARC_OD_DistYStd_Obj_56_RR : 79|8@0+ (0.1,0) [0|25.5] "m" ADC
 SG_ ARC_OD_VabsXStd_Obj_56_RR : 87|7@0+ (0.1,0) [0|12.7] "m/s" ADC
 SG_ ARC_OD_VabsYStd_Obj_56_RR : 80|7@0+ (0.2,0) [0|25.4] "m/s" ADC
 SG_ ARC_OD_AabsXStd_Obj_56_RR : 89|7@0+ (0.25,0) [0|31.75] "m/s^2" ADC

BO_ 1132 ARC_OD_54_55_RR: 64 ARC
 SG_ DistHeight_Obj_55_RR : 487|8@0+ (0.2,-10) [-10|41] "m" Vector__XXX
 SG_ DistHeight_Obj_54_RR : 479|8@0+ (0.2,-10) [-10|41] "m" Vector__XXX
 SG_ ARC_OD_DistX_Obj_54_RR : 7|12@0+ (0.1,-152) [-152|257.5] "m" ADC
 SG_ ARC_OD_Classification_Obj_54_RR : 98|3@0+ (1,0) [0|7] "" ADC
 SG_ ARC_OD_AabsYStd_Obj_54_RR : 111|8@0+ (0.25,0) [0|63.75] "m/s^2" ADC
 SG_ ARC_OD_ClassConf_Obj_54_RR : 119|7@0+ (1,0) [0|127] "%" ADC
 SG_ ARC_OD_ProbOfExist_Obj_54_RR : 112|7@0+ (1,0) [0|127] "%" ADC
 SG_ ARC_OD_VabsX_Obj_54_RR : 11|11@0+ (0.125,-128) [-128|127.875] "m/s" ADC
 SG_ ARC_OD_DynProp_Obj_54_RR : 130|3@0+ (1,0) [0|7] "" ADC
 SG_ ARC_OD_Length_Obj_54_RR : 136|7@0+ (0.2,0) [0|25.4] "m" ADC
 SG_ ARC_OD_MaintenanceState_Obj_54_R : 145|2@0+ (1,0) [0|3] "" ADC
 SG_ ARC_OD_Width_Obj_54_RR : 159|7@0+ (0.2,0) [0|25.4] "m" ADC
 SG_ ARC_OD_RCS_Obj_54_RR : 152|9@0+ (0.2,-51.1) [-51.1|51.1] "dBsm" ADC
 SG_ ARC_OD_Orientation_Obj_54_RR : 175|10@0+ (0.01,-5.11) [-5.11|5.12] "rad" ADC
 SG_ ARC_OD_LifeCycle_Obj_54_RR : 207|16@0+ (1,0) [0|65535] "" ADC
 SG_ ARC_OD_DistX_Obj_55_RR : 223|12@0+ (0.1,-152) [-152|257.5] "m" ADC
 SG_ ARC_OD_VabsX_Obj_55_RR : 227|11@0+ (0.125,-128) [-128|127.875] "m/s" ADC
 SG_ ARC_OD_AabsX_Obj_55_RR : 232|9@0+ (0.125,-31.875) [-31.875|32] "m/s^2" ADC
 SG_ ARC_OD_AabsX_Obj_54_RR : 16|9@0+ (0.125,-31.875) [-31.875|32] "m/s^2" ADC
 SG_ ARC_OD_DistY_Obj_55_RR : 255|12@0+ (0.0875,-179.113) [-179.113|179.2] "m" ADC
 SG_ ARC_OD_VabsY_Obj_55_RR : 259|11@0+ (0.125,-128) [-128|127.875] "m/s" ADC
 SG_ ARC_OD_AabsY_Obj_55_RR : 264|9@0+ (0.125,-31.875) [-31.875|32] "m/s^2" ADC
 SG_ ARC_OD_DistXStd_Obj_55_RR : 287|8@0+ (0.05,0) [0|12.75] "m" ADC
 SG_ ARC_OD_DistYStd_Obj_55_RR : 295|8@0+ (0.1,0) [0|25.5] "m" ADC
 SG_ ARC_OD_VabsXStd_Obj_55_RR : 303|7@0+ (0.1,0) [0|12.7] "m/s" ADC
 SG_ ARC_OD_VabsYStd_Obj_55_RR : 296|7@0+ (0.2,0) [0|25.4] "m/s" ADC
 SG_ ARC_OD_AabsXStd_Obj_55_RR : 305|7@0+ (0.25,0) [0|31.75] "m/s^2" ADC
 SG_ ARC_OD_Classification_Obj_55_RR : 314|3@0+ (1,0) [0|7] "" ADC
 SG_ ARC_OD_AabsYStd_Obj_55_RR : 327|8@0+ (0.25,0) [0|63.75] "m/s^2" ADC
 SG_ ARC_OD_ClassConf_Obj_55_RR : 335|7@0+ (1,0) [0|127] "%" ADC
 SG_ ARC_OD_DistY_Obj_54_RR : 39|12@0+ (0.0875,-179.113) [-179.113|179.2] "m" ADC
 SG_ ARC_OD_ProbOfExist_Obj_55_RR : 328|7@0+ (1,0) [0|127] "%" ADC
 SG_ ARC_OD_DynProp_Obj_55_RR : 346|3@0+ (1,0) [0|7] "" ADC
 SG_ ARC_OD_Length_Obj_55_RR : 352|7@0+ (0.2,0) [0|25.4] "m" ADC
 SG_ ARC_OD_MaintenanceState_Obj_55_R : 361|2@0+ (1,0) [0|3] "" ADC
 SG_ ARC_OD_Width_Obj_55_RR : 375|7@0+ (0.2,0) [0|25.4] "m" ADC
 SG_ ARC_OD_RCS_Obj_55_RR : 368|9@0+ (0.2,-51.1) [-51.1|51.1] "dBsm" ADC
 SG_ ARC_OD_Orientation_Obj_55_RR : 391|10@0+ (0.01,-5.11) [-5.11|5.12] "rad" ADC
 SG_ ARC_OD_LifeCycle_Obj_55_RR : 423|16@0+ (1,0) [0|65535] "" ADC
 SG_ ARC_OD_ObstacleProb_Obj_54_RR : 447|7@0+ (1,0) [0|127] "%" ADC
 SG_ ARC_OD_ObstacleProb_Obj_55_RR : 455|7@0+ (1,0) [0|127] "%" ADC
 SG_ ARC_OD_VabsY_Obj_54_RR : 43|11@0+ (0.125,-128) [-128|127.875] "m/s" ADC
 SG_ ARC_OD_ID_54_RR : 463|8@0+ (1,0) [0|255] "" ADC
 SG_ ARC_OD_ID_55_RR : 471|8@0+ (1,0) [0|255] "" ADC
 SG_ ARC_OD_MsgCounter_Obj_54_55_RR : 491|4@0+ (1,0) [0|15] "" ADC
 SG_ ARC_OD_CRC8_Obj_54_55_RR : 511|8@0+ (1,0) [0|256] "" ADC
 SG_ ARC_OD_AabsY_Obj_54_RR : 48|9@0+ (0.125,-31.875) [-31.875|32] "m/s^2" ADC
 SG_ ARC_OD_DistXStd_Obj_54_RR : 71|8@0+ (0.05,0) [0|12.75] "m" ADC
 SG_ ARC_OD_DistYStd_Obj_54_RR : 79|8@0+ (0.1,0) [0|25.5] "m" ADC
 SG_ ARC_OD_VabsXStd_Obj_54_RR : 87|7@0+ (0.1,0) [0|12.7] "m/s" ADC
 SG_ ARC_OD_VabsYStd_Obj_54_RR : 80|7@0+ (0.2,0) [0|25.4] "m/s" ADC
 SG_ ARC_OD_AabsXStd_Obj_54_RR : 89|7@0+ (0.25,0) [0|31.75] "m/s^2" ADC

BO_ 1131 ARC_OD_52_53_RR: 64 ARC
 SG_ DistHeight_Obj_53_RR : 487|8@0+ (0.2,-10) [-10|41] "m" Vector__XXX
 SG_ DistHeight_Obj_52_RR : 479|8@0+ (0.2,-10) [-10|41] "m" Vector__XXX
 SG_ ARC_OD_DistX_Obj_52_RR : 7|12@0+ (0.1,-152) [-152|257.5] "m" ADC
 SG_ ARC_OD_Classification_Obj_52_RR : 98|3@0+ (1,0) [0|7] "" ADC
 SG_ ARC_OD_AabsYStd_Obj_52_RR : 111|8@0+ (0.25,0) [0|63.75] "m/s^2" ADC
 SG_ ARC_OD_ClassConf_Obj_52_RR : 119|7@0+ (1,0) [0|127] "%" ADC
 SG_ ARC_OD_ProbOfExist_Obj_52_RR : 112|7@0+ (1,0) [0|127] "%" ADC
 SG_ ARC_OD_VabsX_Obj_52_RR : 11|11@0+ (0.125,-128) [-128|127.875] "m/s" ADC
 SG_ ARC_OD_DynProp_Obj_52_RR : 130|3@0+ (1,0) [0|7] "" ADC
 SG_ ARC_OD_Length_Obj_52_RR : 136|7@0+ (0.2,0) [0|25.4] "m" ADC
 SG_ ARC_OD_MaintenanceState_Obj_52_R : 145|2@0+ (1,0) [0|3] "" ADC
 SG_ ARC_OD_Width_Obj_52_RR : 159|7@0+ (0.2,0) [0|25.4] "m" ADC
 SG_ ARC_OD_RCS_Obj_52_RR : 152|9@0+ (0.2,-51.1) [-51.1|51.1] "dBsm" ADC
 SG_ ARC_OD_Orientation_Obj_52_RR : 175|10@0+ (0.01,-5.11) [-5.11|5.12] "rad" ADC
 SG_ ARC_OD_LifeCycle_Obj_52_RR : 207|16@0+ (1,0) [0|65535] "" ADC
 SG_ ARC_OD_DistX_Obj_53_RR : 223|12@0+ (0.1,-152) [-152|257.5] "m" ADC
 SG_ ARC_OD_VabsX_Obj_53_RR : 227|11@0+ (0.125,-128) [-128|127.875] "m/s" ADC
 SG_ ARC_OD_AabsX_Obj_53_RR : 232|9@0+ (0.125,-31.875) [-31.875|32] "m/s^2" ADC
 SG_ ARC_OD_AabsX_Obj_52_RR : 16|9@0+ (0.125,-31.875) [-31.875|32] "m/s^2" ADC
 SG_ ARC_OD_DistY_Obj_53_RR : 255|12@0+ (0.0875,-179.113) [-179.113|179.2] "m" ADC
 SG_ ARC_OD_VabsY_Obj_53_RR : 259|11@0+ (0.125,-128) [-128|127.875] "m/s" ADC
 SG_ ARC_OD_AabsY_Obj_53_RR : 264|9@0+ (0.125,-31.875) [-31.875|32] "m/s^2" ADC
 SG_ ARC_OD_DistXStd_Obj_53_RR : 287|8@0+ (0.05,0) [0|12.75] "m" ADC
 SG_ ARC_OD_DistYStd_Obj_53_RR : 295|8@0+ (0.1,0) [0|25.5] "m" ADC
 SG_ ARC_OD_VabsXStd_Obj_53_RR : 303|7@0+ (0.1,0) [0|12.7] "m/s" ADC
 SG_ ARC_OD_VabsYStd_Obj_53_RR : 296|7@0+ (0.2,0) [0|25.4] "m/s" ADC
 SG_ ARC_OD_AabsXStd_Obj_53_RR : 305|7@0+ (0.25,0) [0|31.75] "m/s^2" ADC
 SG_ ARC_OD_Classification_Obj_53_RR : 314|3@0+ (1,0) [0|7] "" ADC
 SG_ ARC_OD_AabsYStd_Obj_53_RR : 327|8@0+ (0.25,0) [0|63.75] "m/s^2" ADC
 SG_ ARC_OD_ClassConf_Obj_53_RR : 335|7@0+ (1,0) [0|127] "%" ADC
 SG_ ARC_OD_DistY_Obj_52_RR : 39|12@0+ (0.0875,-179.113) [-179.113|179.2] "m" ADC
 SG_ ARC_OD_ProbOfExist_Obj_53_RR : 328|7@0+ (1,0) [0|127] "%" ADC
 SG_ ARC_OD_DynProp_Obj_53_RR : 346|3@0+ (1,0) [0|7] "" ADC
 SG_ ARC_OD_Length_Obj_53_RR : 352|7@0+ (0.2,0) [0|25.4] "m" ADC
 SG_ ARC_OD_MaintenanceState_Obj_53_R : 361|2@0+ (1,0) [0|3] "" ADC
 SG_ ARC_OD_Width_Obj_53_RR : 375|7@0+ (0.2,0) [0|25.4] "m" ADC
 SG_ ARC_OD_RCS_Obj_53_RR : 368|9@0+ (0.2,-51.1) [-51.1|51.1] "dBsm" ADC
 SG_ ARC_OD_Orientation_Obj_53_RR : 391|10@0+ (0.01,-5.11) [-5.11|5.12] "rad" ADC
 SG_ ARC_OD_LifeCycle_Obj_53_RR : 423|16@0+ (1,0) [0|65535] "" ADC
 SG_ ARC_OD_ObstacleProb_Obj_52_RR : 447|7@0+ (1,0) [0|127] "%" ADC
 SG_ ARC_OD_ObstacleProb_Obj_53_RR : 455|7@0+ (1,0) [0|127] "%" ADC
 SG_ ARC_OD_VabsY_Obj_52_RR : 43|11@0+ (0.125,-128) [-128|127.875] "m/s" ADC
 SG_ ARC_OD_ID_52_RR : 463|8@0+ (1,0) [0|255] "" ADC
 SG_ ARC_OD_ID_53_RR : 471|8@0+ (1,0) [0|255] "" ADC
 SG_ ARC_OD_MsgCounter_Obj_52_53_RR : 491|4@0+ (1,0) [0|15] "" ADC
 SG_ ARC_OD_CRC8_Obj_52_53_RR : 511|8@0+ (1,0) [0|256] "" ADC
 SG_ ARC_OD_AabsY_Obj_52_RR : 48|9@0+ (0.125,-31.875) [-31.875|32] "m/s^2" ADC
 SG_ ARC_OD_DistXStd_Obj_52_RR : 71|8@0+ (0.05,0) [0|12.75] "m" ADC
 SG_ ARC_OD_DistYStd_Obj_52_RR : 79|8@0+ (0.1,0) [0|25.5] "m" ADC
 SG_ ARC_OD_VabsXStd_Obj_52_RR : 87|7@0+ (0.1,0) [0|12.7] "m/s" ADC
 SG_ ARC_OD_VabsYStd_Obj_52_RR : 80|7@0+ (0.2,0) [0|25.4] "m/s" ADC
 SG_ ARC_OD_AabsXStd_Obj_52_RR : 89|7@0+ (0.25,0) [0|31.75] "m/s^2" ADC

BO_ 1130 ARC_OD_50_51_RR: 64 ARC
 SG_ DistHeight_Obj_51_RR : 487|8@0+ (0.2,-10) [-10|41] "m" Vector__XXX
 SG_ DistHeight_Obj_50_RR : 479|8@0+ (0.2,-10) [-10|41] "m" Vector__XXX
 SG_ ARC_OD_DistX_Obj_50_RR : 7|12@0+ (0.1,-152) [-152|257.5] "m" ADC
 SG_ ARC_OD_Classification_Obj_50_RR : 98|3@0+ (1,0) [0|7] "" ADC
 SG_ ARC_OD_AabsYStd_Obj_50_RR : 111|8@0+ (0.25,0) [0|63.75] "m/s^2" ADC
 SG_ ARC_OD_ClassConf_Obj_50_RR : 119|7@0+ (1,0) [0|127] "%" ADC
 SG_ ARC_OD_ProbOfExist_Obj_50_RR : 112|7@0+ (1,0) [0|127] "%" ADC
 SG_ ARC_OD_VabsX_Obj_50_RR : 11|11@0+ (0.125,-128) [-128|127.875] "m/s" ADC
 SG_ ARC_OD_DynProp_Obj_50_RR : 130|3@0+ (1,0) [0|7] "" ADC
 SG_ ARC_OD_Length_Obj_50_RR : 136|7@0+ (0.2,0) [0|25.4] "m" ADC
 SG_ ARC_OD_MaintenanceState_Obj_50_R : 145|2@0+ (1,0) [0|3] "" ADC
 SG_ ARC_OD_Width_Obj_50_RR : 159|7@0+ (0.2,0) [0|25.4] "m" ADC
 SG_ ARC_OD_RCS_Obj_50_RR : 152|9@0+ (0.2,-51.1) [-51.1|51.1] "dBsm" ADC
 SG_ ARC_OD_Orientation_Obj_50_RR : 175|10@0+ (0.01,-5.11) [-5.11|5.12] "rad" ADC
 SG_ ARC_OD_LifeCycle_Obj_50_RR : 207|16@0+ (1,0) [0|65535] "" ADC
 SG_ ARC_OD_DistX_Obj_51_RR : 223|12@0+ (0.1,-152) [-152|257.5] "m" ADC
 SG_ ARC_OD_VabsX_Obj_51_RR : 227|11@0+ (0.125,-128) [-128|127.875] "m/s" ADC
 SG_ ARC_OD_AabsX_Obj_51_RR : 232|9@0+ (0.125,-31.875) [-31.875|32] "m/s^2" ADC
 SG_ ARC_OD_AabsX_Obj_50_RR : 16|9@0+ (0.125,-31.875) [-31.875|32] "m/s^2" ADC
 SG_ ARC_OD_DistY_Obj_51_RR : 255|12@0+ (0.0875,-179.113) [-179.113|179.2] "m" ADC
 SG_ ARC_OD_VabsY_Obj_51_RR : 259|11@0+ (0.125,-128) [-128|127.875] "m/s" ADC
 SG_ ARC_OD_AabsY_Obj_51_RR : 264|9@0+ (0.125,-31.875) [-31.875|32] "m/s^2" ADC
 SG_ ARC_OD_DistXStd_Obj_51_RR : 287|8@0+ (0.05,0) [0|12.75] "m" ADC
 SG_ ARC_OD_DistYStd_Obj_51_RR : 295|8@0+ (0.1,0) [0|25.5] "m" ADC
 SG_ ARC_OD_VabsXStd_Obj_51_RR : 303|7@0+ (0.1,0) [0|12.7] "m/s" ADC
 SG_ ARC_OD_VabsYStd_Obj_51_RR : 296|7@0+ (0.2,0) [0|25.4] "m/s" ADC
 SG_ ARC_OD_AabsXStd_Obj_51_RR : 305|7@0+ (0.25,0) [0|31.75] "m/s^2" ADC
 SG_ ARC_OD_Classification_Obj_51_RR : 314|3@0+ (1,0) [0|7] "" ADC
 SG_ ARC_OD_AabsYStd_Obj_51_RR : 327|8@0+ (0.25,0) [0|63.75] "m/s^2" ADC
 SG_ ARC_OD_ClassConf_Obj_51_RR : 335|7@0+ (1,0) [0|127] "%" ADC
 SG_ ARC_OD_DistY_Obj_50_RR : 39|12@0+ (0.0875,-179.113) [-179.113|179.2] "m" ADC
 SG_ ARC_OD_ProbOfExist_Obj_51_RR : 328|7@0+ (1,0) [0|127] "%" ADC
 SG_ ARC_OD_DynProp_Obj_51_RR : 346|3@0+ (1,0) [0|7] "" ADC
 SG_ ARC_OD_Length_Obj_51_RR : 352|7@0+ (0.2,0) [0|25.4] "m" ADC
 SG_ ARC_OD_MaintenanceState_Obj_51_R : 361|2@0+ (1,0) [0|3] "" ADC
 SG_ ARC_OD_Width_Obj_51_RR : 375|7@0+ (0.2,0) [0|25.4] "m" ADC
 SG_ ARC_OD_RCS_Obj_51_RR : 368|9@0+ (0.2,-51.1) [-51.1|51.1] "dBsm" ADC
 SG_ ARC_OD_Orientation_Obj_51_RR : 391|10@0+ (0.01,-5.11) [-5.11|5.12] "rad" ADC
 SG_ ARC_OD_LifeCycle_Obj_51_RR : 423|16@0+ (1,0) [0|65535] "" ADC
 SG_ ARC_OD_ObstacleProb_Obj_50_RR : 447|7@0+ (1,0) [0|127] "%" ADC
 SG_ ARC_OD_ObstacleProb_Obj_51_RR : 455|7@0+ (1,0) [0|127] "%" ADC
 SG_ ARC_OD_VabsY_Obj_50_RR : 43|11@0+ (0.125,-128) [-128|127.875] "m/s" ADC
 SG_ ARC_OD_ID_50_RR : 463|8@0+ (1,0) [0|255] "" ADC
 SG_ ARC_OD_ID_51_RR : 471|8@0+ (1,0) [0|255] "" ADC
 SG_ ARC_OD_MsgCounter_Obj_50_51_RR : 491|4@0+ (1,0) [0|15] "" ADC
 SG_ ARC_OD_CRC8_Obj_50_51_RR : 511|8@0+ (1,0) [0|256] "" ADC
 SG_ ARC_OD_AabsY_Obj_50_RR : 48|9@0+ (0.125,-31.875) [-31.875|32] "m/s^2" ADC
 SG_ ARC_OD_DistXStd_Obj_50_RR : 71|8@0+ (0.05,0) [0|12.75] "m" ADC
 SG_ ARC_OD_DistYStd_Obj_50_RR : 79|8@0+ (0.1,0) [0|25.5] "m" ADC
 SG_ ARC_OD_VabsXStd_Obj_50_RR : 87|7@0+ (0.1,0) [0|12.7] "m/s" ADC
 SG_ ARC_OD_VabsYStd_Obj_50_RR : 80|7@0+ (0.2,0) [0|25.4] "m/s" ADC
 SG_ ARC_OD_AabsXStd_Obj_50_RR : 89|7@0+ (0.25,0) [0|31.75] "m/s^2" ADC

BO_ 1129 ARC_OD_48_49_RR: 64 ARC
 SG_ DistHeight_Obj_49_RR : 487|8@0+ (0.2,-10) [-10|41] "m" Vector__XXX
 SG_ DistHeight_Obj_48_RR : 479|8@0+ (0.2,-10) [-10|41] "m" Vector__XXX
 SG_ ARC_OD_DistX_Obj_48_RR : 7|12@0+ (0.1,-152) [-152|257.5] "m" ADC
 SG_ ARC_OD_Classification_Obj_48_RR : 98|3@0+ (1,0) [0|7] "" ADC
 SG_ ARC_OD_AabsYStd_Obj_48_RR : 111|8@0+ (0.25,0) [0|63.75] "m/s^2" ADC
 SG_ ARC_OD_ClassConf_Obj_48_RR : 119|7@0+ (1,0) [0|127] "%" ADC
 SG_ ARC_OD_ProbOfExist_Obj_48_RR : 112|7@0+ (1,0) [0|127] "%" ADC
 SG_ ARC_OD_VabsX_Obj_48_RR : 11|11@0+ (0.125,-128) [-128|127.875] "m/s" ADC
 SG_ ARC_OD_DynProp_Obj_48_RR : 130|3@0+ (1,0) [0|7] "" ADC
 SG_ ARC_OD_Length_Obj_48_RR : 136|7@0+ (0.2,0) [0|25.4] "m" ADC
 SG_ ARC_OD_MaintenanceState_Obj_48_R : 145|2@0+ (1,0) [0|3] "" ADC
 SG_ ARC_OD_Width_Obj_48_RR : 159|7@0+ (0.2,0) [0|25.4] "m" ADC
 SG_ ARC_OD_RCS_Obj_48_RR : 152|9@0+ (0.2,-51.1) [-51.1|51.1] "dBsm" ADC
 SG_ ARC_OD_Orientation_Obj_48_RR : 175|10@0+ (0.01,-5.11) [-5.11|5.12] "rad" ADC
 SG_ ARC_OD_LifeCycle_Obj_48_RR : 207|16@0+ (1,0) [0|65535] "" ADC
 SG_ ARC_OD_DistX_Obj_49_RR : 223|12@0+ (0.1,-152) [-152|257.5] "m" ADC
 SG_ ARC_OD_VabsX_Obj_49_RR : 227|11@0+ (0.125,-128) [-128|127.875] "m/s" ADC
 SG_ ARC_OD_AabsX_Obj_49_RR : 232|9@0+ (0.125,-31.875) [-31.875|32] "m/s^2" ADC
 SG_ ARC_OD_AabsX_Obj_48_RR : 16|9@0+ (0.125,-31.875) [-31.875|32] "m/s^2" ADC
 SG_ ARC_OD_DistY_Obj_49_RR : 255|12@0+ (0.0875,-179.113) [-179.113|179.2] "m" ADC
 SG_ ARC_OD_VabsY_Obj_49_RR : 259|11@0+ (0.125,-128) [-128|127.875] "m/s" ADC
 SG_ ARC_OD_AabsY_Obj_49_RR : 264|9@0+ (0.125,-31.875) [-31.875|32] "m/s^2" ADC
 SG_ ARC_OD_DistXStd_Obj_49_RR : 287|8@0+ (0.05,0) [0|12.75] "m" ADC
 SG_ ARC_OD_DistYStd_Obj_49_RR : 295|8@0+ (0.1,0) [0|25.5] "m" ADC
 SG_ ARC_OD_VabsXStd_Obj_49_RR : 303|7@0+ (0.1,0) [0|12.7] "m/s" ADC
 SG_ ARC_OD_VabsYStd_Obj_49_RR : 296|7@0+ (0.2,0) [0|25.4] "m/s" ADC
 SG_ ARC_OD_AabsXStd_Obj_49_RR : 305|7@0+ (0.25,0) [0|31.75] "m/s^2" ADC
 SG_ ARC_OD_Classification_Obj_49_RR : 314|3@0+ (1,0) [0|7] "" ADC
 SG_ ARC_OD_AabsYStd_Obj_49_RR : 327|8@0+ (0.25,0) [0|63.75] "m/s^2" ADC
 SG_ ARC_OD_ClassConf_Obj_49_RR : 335|7@0+ (1,0) [0|127] "%" ADC
 SG_ ARC_OD_DistY_Obj_48_RR : 39|12@0+ (0.0875,-179.113) [-179.113|179.2] "m" ADC
 SG_ ARC_OD_ProbOfExist_Obj_49_RR : 328|7@0+ (1,0) [0|127] "%" ADC
 SG_ ARC_OD_DynProp_Obj_49_RR : 346|3@0+ (1,0) [0|7] "" ADC
 SG_ ARC_OD_Length_Obj_49_RR : 352|7@0+ (0.2,0) [0|25.4] "m" ADC
 SG_ ARC_OD_MaintenanceState_Obj_49_R : 361|2@0+ (1,0) [0|3] "" ADC
 SG_ ARC_OD_Width_Obj_49_RR : 375|7@0+ (0.2,0) [0|25.4] "m" ADC
 SG_ ARC_OD_RCS_Obj_49_RR : 368|9@0+ (0.2,-51.1) [-51.1|51.1] "dBsm" ADC
 SG_ ARC_OD_Orientation_Obj_49_RR : 391|10@0+ (0.01,-5.11) [-5.11|5.12] "rad" ADC
 SG_ ARC_OD_LifeCycle_Obj_49_RR : 423|16@0+ (1,0) [0|65535] "" ADC
 SG_ ARC_OD_ObstacleProb_Obj_48_RR : 447|7@0+ (1,0) [0|127] "%" ADC
 SG_ ARC_OD_ObstacleProb_Obj_49_RR : 455|7@0+ (1,0) [0|127] "%" ADC
 SG_ ARC_OD_VabsY_Obj_48_RR : 43|11@0+ (0.125,-128) [-128|127.875] "m/s" ADC
 SG_ ARC_OD_ID_48_RR : 463|8@0+ (1,0) [0|255] "" ADC
 SG_ ARC_OD_ID_49_RR : 471|8@0+ (1,0) [0|255] "" ADC
 SG_ ARC_OD_MsgCounter_Obj_48_49_RR : 491|4@0+ (1,0) [0|15] "" ADC
 SG_ ARC_OD_CRC8_Obj_48_49_RR : 511|8@0+ (1,0) [0|256] "" ADC
 SG_ ARC_OD_AabsY_Obj_48_RR : 48|9@0+ (0.125,-31.875) [-31.875|32] "m/s^2" ADC
 SG_ ARC_OD_DistXStd_Obj_48_RR : 71|8@0+ (0.05,0) [0|12.75] "m" ADC
 SG_ ARC_OD_DistYStd_Obj_48_RR : 79|8@0+ (0.1,0) [0|25.5] "m" ADC
 SG_ ARC_OD_VabsXStd_Obj_48_RR : 87|7@0+ (0.1,0) [0|12.7] "m/s" ADC
 SG_ ARC_OD_VabsYStd_Obj_48_RR : 80|7@0+ (0.2,0) [0|25.4] "m/s" ADC
 SG_ ARC_OD_AabsXStd_Obj_48_RR : 89|7@0+ (0.25,0) [0|31.75] "m/s^2" ADC

BO_ 1128 ARC_OD_46_47_RR: 64 ARC
 SG_ DistHeight_Obj_47_RR : 487|8@0+ (0.2,-10) [-10|41] "m" Vector__XXX
 SG_ DistHeight_Obj_46_RR : 479|8@0+ (0.2,-10) [-10|41] "m" Vector__XXX
 SG_ ARC_OD_DistX_Obj_46_RR : 7|12@0+ (0.1,-152) [-152|257.5] "m" ADC
 SG_ ARC_OD_Classification_Obj_46_RR : 98|3@0+ (1,0) [0|7] "" ADC
 SG_ ARC_OD_AabsYStd_Obj_46_RR : 111|8@0+ (0.25,0) [0|63.75] "m/s^2" ADC
 SG_ ARC_OD_ClassConf_Obj_46_RR : 119|7@0+ (1,0) [0|127] "%" ADC
 SG_ ARC_OD_ProbOfExist_Obj_46_RR : 112|7@0+ (1,0) [0|127] "%" ADC
 SG_ ARC_OD_VabsX_Obj_46_RR : 11|11@0+ (0.125,-128) [-128|127.875] "m/s" ADC
 SG_ ARC_OD_DynProp_Obj_46_RR : 130|3@0+ (1,0) [0|7] "" ADC
 SG_ ARC_OD_Length_Obj_46_RR : 136|7@0+ (0.2,0) [0|25.4] "m" ADC
 SG_ ARC_OD_MaintenanceState_Obj_46_R : 145|2@0+ (1,0) [0|3] "" ADC
 SG_ ARC_OD_Width_Obj_46_RR : 159|7@0+ (0.2,0) [0|25.4] "m" ADC
 SG_ ARC_OD_RCS_Obj_46_RR : 152|9@0+ (0.2,-51.1) [-51.1|51.1] "dBsm" ADC
 SG_ ARC_OD_Orientation_Obj_46_RR : 175|10@0+ (0.01,-5.11) [-5.11|5.12] "rad" ADC
 SG_ ARC_OD_LifeCycle_Obj_46_RR : 207|16@0+ (1,0) [0|65535] "" ADC
 SG_ ARC_OD_DistX_Obj_47_RR : 223|12@0+ (0.1,-152) [-152|257.5] "m" ADC
 SG_ ARC_OD_VabsX_Obj_47_RR : 227|11@0+ (0.125,-128) [-128|127.875] "m/s" ADC
 SG_ ARC_OD_AabsX_Obj_47_RR : 232|9@0+ (0.125,-31.875) [-31.875|32] "m/s^2" ADC
 SG_ ARC_OD_AabsX_Obj_46_RR : 16|9@0+ (0.125,-31.875) [-31.875|32] "m/s^2" ADC
 SG_ ARC_OD_DistY_Obj_47_RR : 255|12@0+ (0.0875,-179.113) [-179.113|179.2] "m" ADC
 SG_ ARC_OD_VabsY_Obj_47_RR : 259|11@0+ (0.125,-128) [-128|127.875] "m/s" ADC
 SG_ ARC_OD_AabsY_Obj_47_RR : 264|9@0+ (0.125,-31.875) [-31.875|32] "m/s^2" ADC
 SG_ ARC_OD_DistXStd_Obj_47_RR : 287|8@0+ (0.05,0) [0|12.75] "m" ADC
 SG_ ARC_OD_DistYStd_Obj_47_RR : 295|8@0+ (0.1,0) [0|25.5] "m" ADC
 SG_ ARC_OD_VabsXStd_Obj_47_RR : 303|7@0+ (0.1,0) [0|12.7] "m/s" ADC
 SG_ ARC_OD_VabsYStd_Obj_47_RR : 296|7@0+ (0.2,0) [0|25.4] "m/s" ADC
 SG_ ARC_OD_AabsXStd_Obj_47_RR : 305|7@0+ (0.25,0) [0|31.75] "m/s^2" ADC
 SG_ ARC_OD_Classification_Obj_47_RR : 314|3@0+ (1,0) [0|7] "" ADC
 SG_ ARC_OD_AabsYStd_Obj_47_RR : 327|8@0+ (0.25,0) [0|63.75] "m/s^2" ADC
 SG_ ARC_OD_ClassConf_Obj_47_RR : 335|7@0+ (1,0) [0|127] "%" ADC
 SG_ ARC_OD_DistY_Obj_46_RR : 39|12@0+ (0.0875,-179.113) [-179.113|179.2] "m" ADC
 SG_ ARC_OD_ProbOfExist_Obj_47_RR : 328|7@0+ (1,0) [0|127] "%" ADC
 SG_ ARC_OD_DynProp_Obj_47_RR : 346|3@0+ (1,0) [0|7] "" ADC
 SG_ ARC_OD_Length_Obj_47_RR : 352|7@0+ (0.2,0) [0|25.4] "m" ADC
 SG_ ARC_OD_MaintenanceState_Obj_47_R : 361|2@0+ (1,0) [0|3] "" ADC
 SG_ ARC_OD_Width_Obj_47_RR : 375|7@0+ (0.2,0) [0|25.4] "m" ADC
 SG_ ARC_OD_RCS_Obj_47_RR : 368|9@0+ (0.2,-51.1) [-51.1|51.1] "dBsm" ADC
 SG_ ARC_OD_Orientation_Obj_47_RR : 391|10@0+ (0.01,-5.11) [-5.11|5.12] "rad" ADC
 SG_ ARC_OD_LifeCycle_Obj_47_RR : 423|16@0+ (1,0) [0|65535] "" ADC
 SG_ ARC_OD_ObstacleProb_Obj_46_RR : 447|7@0+ (1,0) [0|127] "%" ADC
 SG_ ARC_OD_ObstacleProb_Obj_47_RR : 455|7@0+ (1,0) [0|127] "%" ADC
 SG_ ARC_OD_VabsY_Obj_46_RR : 43|11@0+ (0.125,-128) [-128|127.875] "m/s" ADC
 SG_ ARC_OD_ID_46_RR : 463|8@0+ (1,0) [0|255] "" ADC
 SG_ ARC_OD_ID_47_RR : 471|8@0+ (1,0) [0|255] "" ADC
 SG_ ARC_OD_MsgCounter_Obj_46_47_RR : 491|4@0+ (1,0) [0|15] "" ADC
 SG_ ARC_OD_CRC8_Obj_46_47_RR : 511|8@0+ (1,0) [0|256] "" ADC
 SG_ ARC_OD_AabsY_Obj_46_RR : 48|9@0+ (0.125,-31.875) [-31.875|32] "m/s^2" ADC
 SG_ ARC_OD_DistXStd_Obj_46_RR : 71|8@0+ (0.05,0) [0|12.75] "m" ADC
 SG_ ARC_OD_DistYStd_Obj_46_RR : 79|8@0+ (0.1,0) [0|25.5] "m" ADC
 SG_ ARC_OD_VabsXStd_Obj_46_RR : 87|7@0+ (0.1,0) [0|12.7] "m/s" ADC
 SG_ ARC_OD_VabsYStd_Obj_46_RR : 80|7@0+ (0.2,0) [0|25.4] "m/s" ADC
 SG_ ARC_OD_AabsXStd_Obj_46_RR : 89|7@0+ (0.25,0) [0|31.75] "m/s^2" ADC

BO_ 1127 ARC_OD_44_45_RR: 64 ARC
 SG_ DistHeight_Obj_45_RR : 487|8@0+ (0.2,-10) [-10|41] "m" Vector__XXX
 SG_ DistHeight_Obj_44_RR : 479|8@0+ (0.2,-10) [-10|41] "m" Vector__XXX
 SG_ ARC_OD_DistX_Obj_44_RR : 7|12@0+ (0.1,-152) [-152|257.5] "m" ADC
 SG_ ARC_OD_Classification_Obj_44_RR : 98|3@0+ (1,0) [0|7] "" ADC
 SG_ ARC_OD_AabsYStd_Obj_44_RR : 111|8@0+ (0.25,0) [0|63.75] "m/s^2" ADC
 SG_ ARC_OD_ClassConf_Obj_44_RR : 119|7@0+ (1,0) [0|127] "%" ADC
 SG_ ARC_OD_ProbOfExist_Obj_44_RR : 112|7@0+ (1,0) [0|127] "%" ADC
 SG_ ARC_OD_VabsX_Obj_44_RR : 11|11@0+ (0.125,-128) [-128|127.875] "m/s" ADC
 SG_ ARC_OD_DynProp_Obj_44_RR : 130|3@0+ (1,0) [0|7] "" ADC
 SG_ ARC_OD_Length_Obj_44_RR : 136|7@0+ (0.2,0) [0|25.4] "m" ADC
 SG_ ARC_OD_MaintenanceState_Obj_44_R : 145|2@0+ (1,0) [0|3] "" ADC
 SG_ ARC_OD_Width_Obj_44_RR : 159|7@0+ (0.2,0) [0|25.4] "m" ADC
 SG_ ARC_OD_RCS_Obj_44_RR : 152|9@0+ (0.2,-51.1) [-51.1|51.1] "dBsm" ADC
 SG_ ARC_OD_Orientation_Obj_44_RR : 175|10@0+ (0.01,-5.11) [-5.11|5.12] "rad" ADC
 SG_ ARC_OD_LifeCycle_Obj_44_RR : 207|16@0+ (1,0) [0|65535] "" ADC
 SG_ ARC_OD_DistX_Obj_45_RR : 223|12@0+ (0.1,-152) [-152|257.5] "m" ADC
 SG_ ARC_OD_VabsX_Obj_45_RR : 227|11@0+ (0.125,-128) [-128|127.875] "m/s" ADC
 SG_ ARC_OD_AabsX_Obj_45_RR : 232|9@0+ (0.125,-31.875) [-31.875|32] "m/s^2" ADC
 SG_ ARC_OD_AabsX_Obj_44_RR : 16|9@0+ (0.125,-31.875) [-31.875|32] "m/s^2" ADC
 SG_ ARC_OD_DistY_Obj_45_RR : 255|12@0+ (0.0875,-179.113) [-179.113|179.2] "m" ADC
 SG_ ARC_OD_VabsY_Obj_45_RR : 259|11@0+ (0.125,-128) [-128|127.875] "m/s" ADC
 SG_ ARC_OD_AabsY_Obj_45_RR : 264|9@0+ (0.125,-31.875) [-31.875|32] "m/s^2" ADC
 SG_ ARC_OD_DistXStd_Obj_45_RR : 287|8@0+ (0.05,0) [0|12.75] "m" ADC
 SG_ ARC_OD_DistYStd_Obj_45_RR : 295|8@0+ (0.1,0) [0|25.5] "m" ADC
 SG_ ARC_OD_VabsXStd_Obj_45_RR : 303|7@0+ (0.1,0) [0|12.7] "m/s" ADC
 SG_ ARC_OD_VabsYStd_Obj_45_RR : 296|7@0+ (0.2,0) [0|25.4] "m/s" ADC
 SG_ ARC_OD_AabsXStd_Obj_45_RR : 305|7@0+ (0.25,0) [0|31.75] "m/s^2" ADC
 SG_ ARC_OD_Classification_Obj_45_RR : 314|3@0+ (1,0) [0|7] "" ADC
 SG_ ARC_OD_AabsYStd_Obj_45_RR : 327|8@0+ (0.25,0) [0|63.75] "m/s^2" ADC
 SG_ ARC_OD_ClassConf_Obj_45_RR : 335|7@0+ (1,0) [0|127] "%" ADC
 SG_ ARC_OD_DistY_Obj_44_RR : 39|12@0+ (0.0875,-179.113) [-179.113|179.2] "m" ADC
 SG_ ARC_OD_ProbOfExist_Obj_45_RR : 328|7@0+ (1,0) [0|127] "%" ADC
 SG_ ARC_OD_DynProp_Obj_45_RR : 346|3@0+ (1,0) [0|7] "" ADC
 SG_ ARC_OD_Length_Obj_45_RR : 352|7@0+ (0.2,0) [0|25.4] "m" ADC
 SG_ ARC_OD_MaintenanceState_Obj_45_R : 361|2@0+ (1,0) [0|3] "" ADC
 SG_ ARC_OD_Width_Obj_45_RR : 375|7@0+ (0.2,0) [0|25.4] "m" ADC
 SG_ ARC_OD_RCS_Obj_45_RR : 368|9@0+ (0.2,-51.1) [-51.1|51.1] "dBsm" ADC
 SG_ ARC_OD_Orientation_Obj_45_RR : 391|10@0+ (0.01,-5.11) [-5.11|5.12] "rad" ADC
 SG_ ARC_OD_LifeCycle_Obj_45_RR : 423|16@0+ (1,0) [0|65535] "" ADC
 SG_ ARC_OD_ObstacleProb_Obj_44_RR : 447|7@0+ (1,0) [0|127] "%" ADC
 SG_ ARC_OD_ObstacleProb_Obj_45_RR : 455|7@0+ (1,0) [0|127] "%" ADC
 SG_ ARC_OD_VabsY_Obj_44_RR : 43|11@0+ (0.125,-128) [-128|127.875] "m/s" ADC
 SG_ ARC_OD_ID_44_RR : 463|8@0+ (1,0) [0|255] "" ADC
 SG_ ARC_OD_ID_45_RR : 471|8@0+ (1,0) [0|255] "" ADC
 SG_ ARC_OD_MsgCounter_Obj_44_45_RR : 491|4@0+ (1,0) [0|15] "" ADC
 SG_ ARC_OD_CRC8_Obj_44_45_RR : 511|8@0+ (1,0) [0|256] "" ADC
 SG_ ARC_OD_AabsY_Obj_44_RR : 48|9@0+ (0.125,-31.875) [-31.875|32] "m/s^2" ADC
 SG_ ARC_OD_DistXStd_Obj_44_RR : 71|8@0+ (0.05,0) [0|12.75] "m" ADC
 SG_ ARC_OD_DistYStd_Obj_44_RR : 79|8@0+ (0.1,0) [0|25.5] "m" ADC
 SG_ ARC_OD_VabsXStd_Obj_44_RR : 87|7@0+ (0.1,0) [0|12.7] "m/s" ADC
 SG_ ARC_OD_VabsYStd_Obj_44_RR : 80|7@0+ (0.2,0) [0|25.4] "m/s" ADC
 SG_ ARC_OD_AabsXStd_Obj_44_RR : 89|7@0+ (0.25,0) [0|31.75] "m/s^2" ADC

BO_ 1126 ARC_OD_42_43_RR: 64 ARC
 SG_ DistHeight_Obj_43_RR : 487|8@0+ (0.2,-10) [-10|41] "m" Vector__XXX
 SG_ DistHeight_Obj_42_RR : 479|8@0+ (0.2,-10) [-10|41] "m" Vector__XXX
 SG_ ARC_OD_DistX_Obj_42_RR : 7|12@0+ (0.1,-152) [-152|257.5] "m" ADC
 SG_ ARC_OD_Classification_Obj_42_RR : 98|3@0+ (1,0) [0|7] "" ADC
 SG_ ARC_OD_AabsYStd_Obj_42_RR : 111|8@0+ (0.25,0) [0|63.75] "m/s^2" ADC
 SG_ ARC_OD_ClassConf_Obj_42_RR : 119|7@0+ (1,0) [0|127] "%" ADC
 SG_ ARC_OD_ProbOfExist_Obj_42_RR : 112|7@0+ (1,0) [0|127] "%" ADC
 SG_ ARC_OD_VabsX_Obj_42_RR : 11|11@0+ (0.125,-128) [-128|127.875] "m/s" ADC
 SG_ ARC_OD_DynProp_Obj_42_RR : 130|3@0+ (1,0) [0|7] "" ADC
 SG_ ARC_OD_Length_Obj_42_RR : 136|7@0+ (0.2,0) [0|25.4] "m" ADC
 SG_ ARC_OD_MaintenanceState_Obj_42_R : 145|2@0+ (1,0) [0|3] "" ADC
 SG_ ARC_OD_Width_Obj_42_RR : 159|7@0+ (0.2,0) [0|25.4] "m" ADC
 SG_ ARC_OD_RCS_Obj_42_RR : 152|9@0+ (0.2,-51.1) [-51.1|51.1] "dBsm" ADC
 SG_ ARC_OD_Orientation_Obj_42_RR : 175|10@0+ (0.01,-5.11) [-5.11|5.12] "rad" ADC
 SG_ ARC_OD_LifeCycle_Obj_42_RR : 207|16@0+ (1,0) [0|65535] "" ADC
 SG_ ARC_OD_DistX_Obj_43_RR : 223|12@0+ (0.1,-152) [-152|257.5] "m" ADC
 SG_ ARC_OD_VabsX_Obj_43_RR : 227|11@0+ (0.125,-128) [-128|127.875] "m/s" ADC
 SG_ ARC_OD_AabsX_Obj_43_RR : 232|9@0+ (0.125,-31.875) [-31.875|32] "m/s^2" ADC
 SG_ ARC_OD_AabsX_Obj_42_RR : 16|9@0+ (0.125,-31.875) [-31.875|32] "m/s^2" ADC
 SG_ ARC_OD_DistY_Obj_43_RR : 255|12@0+ (0.0875,-179.113) [-179.113|179.2] "m" ADC
 SG_ ARC_OD_VabsY_Obj_43_RR : 259|11@0+ (0.125,-128) [-128|127.875] "m/s" ADC
 SG_ ARC_OD_AabsY_Obj_43_RR : 264|9@0+ (0.125,-31.875) [-31.875|32] "m/s^2" ADC
 SG_ ARC_OD_DistXStd_Obj_43_RR : 287|8@0+ (0.05,0) [0|12.75] "m" ADC
 SG_ ARC_OD_DistYStd_Obj_43_RR : 295|8@0+ (0.1,0) [0|25.5] "m" ADC
 SG_ ARC_OD_VabsXStd_Obj_43_RR : 303|7@0+ (0.1,0) [0|12.7] "m/s" ADC
 SG_ ARC_OD_VabsYStd_Obj_43_RR : 296|7@0+ (0.2,0) [0|25.4] "m/s" ADC
 SG_ ARC_OD_AabsXStd_Obj_43_RR : 305|7@0+ (0.25,0) [0|31.75] "m/s^2" ADC
 SG_ ARC_OD_Classification_Obj_43_RR : 314|3@0+ (1,0) [0|7] "" ADC
 SG_ ARC_OD_AabsYStd_Obj_43_RR : 327|8@0+ (0.25,0) [0|63.75] "m/s^2" ADC
 SG_ ARC_OD_ClassConf_Obj_43_RR : 335|7@0+ (1,0) [0|127] "%" ADC
 SG_ ARC_OD_DistY_Obj_42_RR : 39|12@0+ (0.0875,-179.113) [-179.113|179.2] "m" ADC
 SG_ ARC_OD_ProbOfExist_Obj_43_RR : 328|7@0+ (1,0) [0|127] "%" ADC
 SG_ ARC_OD_DynProp_Obj_43_RR : 346|3@0+ (1,0) [0|7] "" ADC
 SG_ ARC_OD_Length_Obj_43_RR : 352|7@0+ (0.2,0) [0|25.4] "m" ADC
 SG_ ARC_OD_MaintenanceState_Obj_43_R : 361|2@0+ (1,0) [0|3] "" ADC
 SG_ ARC_OD_Width_Obj_43_RR : 375|7@0+ (0.2,0) [0|25.4] "m" ADC
 SG_ ARC_OD_RCS_Obj_43_RR : 368|9@0+ (0.2,-51.1) [-51.1|51.1] "dBsm" ADC
 SG_ ARC_OD_Orientation_Obj_43_RR : 391|10@0+ (0.01,-5.11) [-5.11|5.12] "rad" ADC
 SG_ ARC_OD_LifeCycle_Obj_43_RR : 423|16@0+ (1,0) [0|65535] "" ADC
 SG_ ARC_OD_ObstacleProb_Obj_42_RR : 447|7@0+ (1,0) [0|127] "%" ADC
 SG_ ARC_OD_ObstacleProb_Obj_43_RR : 455|7@0+ (1,0) [0|127] "%" ADC
 SG_ ARC_OD_VabsY_Obj_42_RR : 43|11@0+ (0.125,-128) [-128|127.875] "m/s" ADC
 SG_ ARC_OD_ID_42_RR : 463|8@0+ (1,0) [0|255] "" ADC
 SG_ ARC_OD_ID_43_RR : 471|8@0+ (1,0) [0|255] "" ADC
 SG_ ARC_OD_MsgCounter_Obj_42_43_RR : 491|4@0+ (1,0) [0|15] "" ADC
 SG_ ARC_OD_CRC8_Obj_42_43_RR : 511|8@0+ (1,0) [0|256] "" ADC
 SG_ ARC_OD_AabsY_Obj_42_RR : 48|9@0+ (0.125,-31.875) [-31.875|32] "m/s^2" ADC
 SG_ ARC_OD_DistXStd_Obj_42_RR : 71|8@0+ (0.05,0) [0|12.75] "m" ADC
 SG_ ARC_OD_DistYStd_Obj_42_RR : 79|8@0+ (0.1,0) [0|25.5] "m" ADC
 SG_ ARC_OD_VabsXStd_Obj_42_RR : 87|7@0+ (0.1,0) [0|12.7] "m/s" ADC
 SG_ ARC_OD_VabsYStd_Obj_42_RR : 80|7@0+ (0.2,0) [0|25.4] "m/s" ADC
 SG_ ARC_OD_AabsXStd_Obj_42_RR : 89|7@0+ (0.25,0) [0|31.75] "m/s^2" ADC

BO_ 1125 ARC_OD_40_41_RR: 64 ARC
 SG_ DistHeight_Obj_41_RR : 487|8@0+ (0.2,-10) [-10|41] "m" ADC
 SG_ DistHeight_Obj_40_RR : 479|8@0+ (0.2,-10) [-10|41] "m" ADC
 SG_ ARC_OD_DistX_Obj_40_RR : 7|12@0+ (0.1,-152) [-152|257.5] "m" ADC
 SG_ ARC_OD_Classification_Obj_40_RR : 98|3@0+ (1,0) [0|7] "" ADC
 SG_ ARC_OD_AabsYStd_Obj_40_RR : 111|8@0+ (0.25,0) [0|63.75] "m/s^2" ADC
 SG_ ARC_OD_ClassConf_Obj_40_RR : 119|7@0+ (1,0) [0|127] "%" ADC
 SG_ ARC_OD_ProbOfExist_Obj_40_RR : 112|7@0+ (1,0) [0|127] "%" ADC
 SG_ ARC_OD_VabsX_Obj_40_RR : 11|11@0+ (0.125,-128) [-128|127.875] "m/s" ADC
 SG_ ARC_OD_DynProp_Obj_40_RR : 130|3@0+ (1,0) [0|7] "" ADC
 SG_ ARC_OD_Length_Obj_40_RR : 136|7@0+ (0.2,0) [0|25.4] "m" ADC
 SG_ ARC_OD_MaintenanceState_Obj_40_R : 145|2@0+ (1,0) [0|3] "" ADC
 SG_ ARC_OD_Width_Obj_40_RR : 159|7@0+ (0.2,0) [0|25.4] "m" ADC
 SG_ ARC_OD_RCS_Obj_40_RR : 152|9@0+ (0.2,-51.1) [-51.1|51.1] "dBsm" ADC
 SG_ ARC_OD_Orientation_Obj_40_RR : 175|10@0+ (0.01,-5.11) [-5.11|5.12] "rad" ADC
 SG_ ARC_OD_LifeCycle_Obj_40_RR : 207|16@0+ (1,0) [0|65535] "" ADC
 SG_ ARC_OD_DistX_Obj_41_RR : 223|12@0+ (0.1,-152) [-152|257.5] "m" ADC
 SG_ ARC_OD_VabsX_Obj_41_RR : 227|11@0+ (0.125,-128) [-128|127.875] "m/s" ADC
 SG_ ARC_OD_AabsX_Obj_41_RR : 232|9@0+ (0.125,-31.875) [-31.875|32] "m/s^2" ADC
 SG_ ARC_OD_AabsX_Obj_40_RR : 16|9@0+ (0.125,-31.875) [-31.875|32] "m/s^2" ADC
 SG_ ARC_OD_DistY_Obj_41_RR : 255|12@0+ (0.0875,-179.113) [-179.113|179.2] "m" ADC
 SG_ ARC_OD_VabsY_Obj_41_RR : 259|11@0+ (0.125,-128) [-128|127.875] "m/s" ADC
 SG_ ARC_OD_AabsY_Obj_41_RR : 264|9@0+ (0.125,-31.875) [-31.875|32] "m/s^2" ADC
 SG_ ARC_OD_DistXStd_Obj_41_RR : 287|8@0+ (0.05,0) [0|12.75] "m" ADC
 SG_ ARC_OD_DistYStd_Obj_41_RR : 295|8@0+ (0.1,0) [0|25.5] "m" ADC
 SG_ ARC_OD_VabsXStd_Obj_41_RR : 303|7@0+ (0.1,0) [0|12.7] "m/s" ADC
 SG_ ARC_OD_VabsYStd_Obj_41_RR : 296|7@0+ (0.2,0) [0|25.4] "m/s" ADC
 SG_ ARC_OD_AabsXStd_Obj_41_RR : 305|7@0+ (0.25,0) [0|31.75] "m/s^2" ADC
 SG_ ARC_OD_Classification_Obj_41_RR : 314|3@0+ (1,0) [0|7] "" ADC
 SG_ ARC_OD_AabsYStd_Obj_41_RR : 327|8@0+ (0.25,0) [0|63.75] "m/s^2" ADC
 SG_ ARC_OD_ClassConf_Obj_41_RR : 335|7@0+ (1,0) [0|127] "%" ADC
 SG_ ARC_OD_DistY_Obj_40_RR : 39|12@0+ (0.0875,-179.113) [-179.113|179.2] "m" ADC
 SG_ ARC_OD_ProbOfExist_Obj_41_RR : 328|7@0+ (1,0) [0|127] "%" ADC
 SG_ ARC_OD_DynProp_Obj_41_RR : 346|3@0+ (1,0) [0|7] "" ADC
 SG_ ARC_OD_Length_Obj_41_RR : 352|7@0+ (0.2,0) [0|25.4] "m" ADC
 SG_ ARC_OD_MaintenanceState_Obj_41_R : 361|2@0+ (1,0) [0|3] "" ADC
 SG_ ARC_OD_Width_Obj_41_RR : 375|7@0+ (0.2,0) [0|25.4] "m" ADC
 SG_ ARC_OD_RCS_Obj_41_RR : 368|9@0+ (0.2,-51.1) [-51.1|51.1] "dBsm" ADC
 SG_ ARC_OD_Orientation_Obj_41_RR : 391|10@0+ (0.01,-5.11) [-5.11|5.12] "rad" ADC
 SG_ ARC_OD_LifeCycle_Obj_41_RR : 423|16@0+ (1,0) [0|65535] "" ADC
 SG_ ARC_OD_ObstacleProb_Obj_40_RR : 447|7@0+ (1,0) [0|127] "%" ADC
 SG_ ARC_OD_ObstacleProb_Obj_41_RR : 455|7@0+ (1,0) [0|127] "%" ADC
 SG_ ARC_OD_VabsY_Obj_40_RR : 43|11@0+ (0.125,-128) [-128|127.875] "m/s" ADC
 SG_ ARC_OD_ID_40_RR : 463|8@0+ (1,0) [0|255] "" ADC
 SG_ ARC_OD_ID_41_RR : 471|8@0+ (1,0) [0|255] "" ADC
 SG_ ARC_OD_MsgCounter_Obj_40_41_RR : 491|4@0+ (1,0) [0|15] "" ADC
 SG_ ARC_OD_CRC8_Obj_40_41_RR : 511|8@0+ (1,0) [0|256] "" ADC
 SG_ ARC_OD_AabsY_Obj_40_RR : 48|9@0+ (0.125,-31.875) [-31.875|32] "m/s^2" ADC
 SG_ ARC_OD_DistXStd_Obj_40_RR : 71|8@0+ (0.05,0) [0|12.75] "m" ADC
 SG_ ARC_OD_DistYStd_Obj_40_RR : 79|8@0+ (0.1,0) [0|25.5] "m" ADC
 SG_ ARC_OD_VabsXStd_Obj_40_RR : 87|7@0+ (0.1,0) [0|12.7] "m/s" ADC
 SG_ ARC_OD_VabsYStd_Obj_40_RR : 80|7@0+ (0.2,0) [0|25.4] "m/s" ADC
 SG_ ARC_OD_AabsXStd_Obj_40_RR : 89|7@0+ (0.25,0) [0|31.75] "m/s^2" ADC

BO_ 1124 ARC_OD_38_39_RR: 64 ARC
 SG_ DistHeight_Obj_39_RR : 487|8@0+ (0.2,-10) [-10|41] "m" ADC
 SG_ DistHeight_Obj_38_RR : 479|8@0+ (0.2,-10) [-10|41] "m" ADC
 SG_ ARC_OD_DistX_Obj_38_RR : 7|12@0+ (0.1,-152) [-152|257.5] "m" ADC
 SG_ ARC_OD_Classification_Obj_38_RR : 98|3@0+ (1,0) [0|7] "" ADC
 SG_ ARC_OD_AabsYStd_Obj_38_RR : 111|8@0+ (0.25,0) [0|63.75] "m/s^2" ADC
 SG_ ARC_OD_ClassConf_Obj_38_RR : 119|7@0+ (1,0) [0|127] "%" ADC
 SG_ ARC_OD_ProbOfExist_Obj_38_RR : 112|7@0+ (1,0) [0|127] "%" ADC
 SG_ ARC_OD_VabsX_Obj_38_RR : 11|11@0+ (0.125,-128) [-128|127.875] "m/s" ADC
 SG_ ARC_OD_DynProp_Obj_38_RR : 130|3@0+ (1,0) [0|7] "" ADC
 SG_ ARC_OD_Length_Obj_38_RR : 136|7@0+ (0.2,0) [0|25.4] "m" ADC
 SG_ ARC_OD_MaintenanceState_Obj_38_R : 145|2@0+ (1,0) [0|3] "" ADC
 SG_ ARC_OD_Width_Obj_38_RR : 159|7@0+ (0.2,0) [0|25.4] "m" ADC
 SG_ ARC_OD_RCS_Obj_38_RR : 152|9@0+ (0.2,-51.1) [-51.1|51.1] "dBsm" ADC
 SG_ ARC_OD_Orientation_Obj_38_RR : 175|10@0+ (0.01,-5.11) [-5.11|5.12] "rad" ADC
 SG_ ARC_OD_LifeCycle_Obj_38_RR : 207|16@0+ (1,0) [0|65535] "" ADC
 SG_ ARC_OD_DistX_Obj_39_RR : 223|12@0+ (0.1,-152) [-152|257.5] "m" ADC
 SG_ ARC_OD_VabsX_Obj_39_RR : 227|11@0+ (0.125,-128) [-128|127.875] "m/s" ADC
 SG_ ARC_OD_AabsX_Obj_39_RR : 232|9@0+ (0.125,-31.875) [-31.875|32] "m/s^2" ADC
 SG_ ARC_OD_AabsX_Obj_38_RR : 16|9@0+ (0.125,-31.875) [-31.875|32] "m/s^2" ADC
 SG_ ARC_OD_DistY_Obj_39_RR : 255|12@0+ (0.0875,-179.113) [-179.113|179.2] "m" ADC
 SG_ ARC_OD_VabsY_Obj_39_RR : 259|11@0+ (0.125,-128) [-128|127.875] "m/s" ADC
 SG_ ARC_OD_AabsY_Obj_39_RR : 264|9@0+ (0.125,-31.875) [-31.875|32] "m/s^2" ADC
 SG_ ARC_OD_DistXStd_Obj_39_RR : 287|8@0+ (0.05,0) [0|12.75] "m" ADC
 SG_ ARC_OD_DistYStd_Obj_39_RR : 295|8@0+ (0.1,0) [0|25.5] "m" ADC
 SG_ ARC_OD_VabsXStd_Obj_39_RR : 303|7@0+ (0.1,0) [0|12.7] "m/s" ADC
 SG_ ARC_OD_VabsYStd_Obj_39_RR : 296|7@0+ (0.2,0) [0|25.4] "m/s" ADC
 SG_ ARC_OD_AabsXStd_Obj_39_RR : 305|7@0+ (0.25,0) [0|31.75] "m/s^2" ADC
 SG_ ARC_OD_Classification_Obj_39_RR : 314|3@0+ (1,0) [0|7] "" ADC
 SG_ ARC_OD_AabsYStd_Obj_39_RR : 327|8@0+ (0.25,0) [0|63.75] "m/s^2" ADC
 SG_ ARC_OD_ClassConf_Obj_39_RR : 335|7@0+ (1,0) [0|127] "%" ADC
 SG_ ARC_OD_DistY_Obj_38_RR : 39|12@0+ (0.0875,-179.113) [-179.113|179.2] "m" ADC
 SG_ ARC_OD_ProbOfExist_Obj_39_RR : 328|7@0+ (1,0) [0|127] "%" ADC
 SG_ ARC_OD_DynProp_Obj_39_RR : 346|3@0+ (1,0) [0|7] "" ADC
 SG_ ARC_OD_Length_Obj_39_RR : 352|7@0+ (0.2,0) [0|25.4] "m" ADC
 SG_ ARC_OD_MaintenanceState_Obj_39_R : 361|2@0+ (1,0) [0|3] "" ADC
 SG_ ARC_OD_Width_Obj_39_RR : 375|7@0+ (0.2,0) [0|25.4] "m" ADC
 SG_ ARC_OD_RCS_Obj_39_RR : 368|9@0+ (0.2,-51.1) [-51.1|51.1] "dBsm" ADC
 SG_ ARC_OD_Orientation_Obj_39_RR : 391|10@0+ (0.01,-5.11) [-5.11|5.12] "rad" ADC
 SG_ ARC_OD_LifeCycle_Obj_39_RR : 423|16@0+ (1,0) [0|65535] "" ADC
 SG_ ARC_OD_ObstacleProb_Obj_38_RR : 447|7@0+ (1,0) [0|127] "%" ADC
 SG_ ARC_OD_ObstacleProb_Obj_39_RR : 455|7@0+ (1,0) [0|127] "%" ADC
 SG_ ARC_OD_VabsY_Obj_38_RR : 43|11@0+ (0.125,-128) [-128|127.875] "m/s" ADC
 SG_ ARC_OD_ID_38_RR : 463|8@0+ (1,0) [0|255] "" ADC
 SG_ ARC_OD_ID_39_RR : 471|8@0+ (1,0) [0|255] "" ADC
 SG_ ARC_OD_MsgCounter_Obj_38_39_RR : 491|4@0+ (1,0) [0|15] "" ADC
 SG_ ARC_OD_CRC8_Obj_38_39_RR : 511|8@0+ (1,0) [0|256] "" ADC
 SG_ ARC_OD_AabsY_Obj_38_RR : 48|9@0+ (0.125,-31.875) [-31.875|32] "m/s^2" ADC
 SG_ ARC_OD_DistXStd_Obj_38_RR : 71|8@0+ (0.05,0) [0|12.75] "m" ADC
 SG_ ARC_OD_DistYStd_Obj_38_RR : 79|8@0+ (0.1,0) [0|25.5] "m" ADC
 SG_ ARC_OD_VabsXStd_Obj_38_RR : 87|7@0+ (0.1,0) [0|12.7] "m/s" ADC
 SG_ ARC_OD_VabsYStd_Obj_38_RR : 80|7@0+ (0.2,0) [0|25.4] "m/s" ADC
 SG_ ARC_OD_AabsXStd_Obj_38_RR : 89|7@0+ (0.25,0) [0|31.75] "m/s^2" ADC

BO_ 1123 ARC_OD_36_37_RR: 64 ARC
 SG_ DistHeight_Obj_37_RR : 487|8@0+ (0.2,-10) [-10|41] "m" ADC
 SG_ DistHeight_Obj_36_RR : 479|8@0+ (0.2,-10) [-10|41] "m" ADC
 SG_ ARC_OD_DistX_Obj_36_RR : 7|12@0+ (0.1,-152) [-152|257.5] "m" ADC
 SG_ ARC_OD_Classification_Obj_36_RR : 98|3@0+ (1,0) [0|7] "" ADC
 SG_ ARC_OD_AabsYStd_Obj_36_RR : 111|8@0+ (0.25,0) [0|63.75] "m/s^2" ADC
 SG_ ARC_OD_ClassConf_Obj_36_RR : 119|7@0+ (1,0) [0|127] "%" ADC
 SG_ ARC_OD_ProbOfExist_Obj_36_RR : 112|7@0+ (1,0) [0|127] "%" ADC
 SG_ ARC_OD_VabsX_Obj_36_RR : 11|11@0+ (0.125,-128) [-128|127.875] "m/s" ADC
 SG_ ARC_OD_DynProp_Obj_36_RR : 130|3@0+ (1,0) [0|7] "" ADC
 SG_ ARC_OD_Length_Obj_36_RR : 136|7@0+ (0.2,0) [0|25.4] "m" ADC
 SG_ ARC_OD_MaintenanceState_Obj_36_R : 145|2@0+ (1,0) [0|3] "" ADC
 SG_ ARC_OD_Width_Obj_36_RR : 159|7@0+ (0.2,0) [0|25.4] "m" ADC
 SG_ ARC_OD_RCS_Obj_36_RR : 152|9@0+ (0.2,-51.1) [-51.1|51.1] "dBsm" ADC
 SG_ ARC_OD_Orientation_Obj_36_RR : 175|10@0+ (0.01,-5.11) [-5.11|5.12] "rad" ADC
 SG_ ARC_OD_LifeCycle_Obj_36_RR : 207|16@0+ (1,0) [0|65535] "" ADC
 SG_ ARC_OD_DistX_Obj_37_RR : 223|12@0+ (0.1,-152) [-152|257.5] "m" ADC
 SG_ ARC_OD_VabsX_Obj_37_RR : 227|11@0+ (0.125,-128) [-128|127.875] "m/s" ADC
 SG_ ARC_OD_AabsX_Obj_37_RR : 232|9@0+ (0.125,-31.875) [-31.875|32] "m/s^2" ADC
 SG_ ARC_OD_AabsX_Obj_36_RR : 16|9@0+ (0.125,-31.875) [-31.875|32] "m/s^2" ADC
 SG_ ARC_OD_DistY_Obj_37_RR : 255|12@0+ (0.0875,-179.113) [-179.113|179.2] "m" ADC
 SG_ ARC_OD_VabsY_Obj_37_RR : 259|11@0+ (0.125,-128) [-128|127.875] "m/s" ADC
 SG_ ARC_OD_AabsY_Obj_37_RR : 264|9@0+ (0.125,-31.875) [-31.875|32] "m/s^2" ADC
 SG_ ARC_OD_DistXStd_Obj_37_RR : 287|8@0+ (0.05,0) [0|12.75] "m" ADC
 SG_ ARC_OD_DistYStd_Obj_37_RR : 295|8@0+ (0.1,0) [0|25.5] "m" ADC
 SG_ ARC_OD_VabsXStd_Obj_37_RR : 303|7@0+ (0.1,0) [0|12.7] "m/s" ADC
 SG_ ARC_OD_VabsYStd_Obj_37_RR : 296|7@0+ (0.2,0) [0|25.4] "m/s" ADC
 SG_ ARC_OD_AabsXStd_Obj_37_RR : 305|7@0+ (0.25,0) [0|31.75] "m/s^2" ADC
 SG_ ARC_OD_Classification_Obj_37_RR : 314|3@0+ (1,0) [0|7] "" ADC
 SG_ ARC_OD_AabsYStd_Obj_37_RR : 327|8@0+ (0.25,0) [0|63.75] "m/s^2" ADC
 SG_ ARC_OD_ClassConf_Obj_37_RR : 335|7@0+ (1,0) [0|127] "%" ADC
 SG_ ARC_OD_DistY_Obj_36_RR : 39|12@0+ (0.0875,-179.113) [-179.113|179.2] "m" ADC
 SG_ ARC_OD_ProbOfExist_Obj_37_RR : 328|7@0+ (1,0) [0|127] "%" ADC
 SG_ ARC_OD_DynProp_Obj_37_RR : 346|3@0+ (1,0) [0|7] "" ADC
 SG_ ARC_OD_Length_Obj_37_RR : 352|7@0+ (0.2,0) [0|25.4] "m" ADC
 SG_ ARC_OD_MaintenanceState_Obj_37_R : 361|2@0+ (1,0) [0|3] "" ADC
 SG_ ARC_OD_Width_Obj_37_RR : 375|7@0+ (0.2,0) [0|25.4] "m" ADC
 SG_ ARC_OD_RCS_Obj_37_RR : 368|9@0+ (0.2,-51.1) [-51.1|51.1] "dBsm" ADC
 SG_ ARC_OD_Orientation_Obj_37_RR : 391|10@0+ (0.01,-5.11) [-5.11|5.12] "rad" ADC
 SG_ ARC_OD_LifeCycle_Obj_37_RR : 423|16@0+ (1,0) [0|65535] "" ADC
 SG_ ARC_OD_ObstacleProb_Obj_36_RR : 447|7@0+ (1,0) [0|127] "%" ADC
 SG_ ARC_OD_ObstacleProb_Obj_37_RR : 455|7@0+ (1,0) [0|127] "%" ADC
 SG_ ARC_OD_VabsY_Obj_36_RR : 43|11@0+ (0.125,-128) [-128|127.875] "m/s" ADC
 SG_ ARC_OD_ID_36_RR : 463|8@0+ (1,0) [0|255] "" ADC
 SG_ ARC_OD_ID_37_RR : 471|8@0+ (1,0) [0|255] "" ADC
 SG_ ARC_OD_MsgCounter_Obj_36_37_RR : 491|4@0+ (1,0) [0|15] "" ADC
 SG_ ARC_OD_CRC8_Obj_36_37_RR : 511|8@0+ (1,0) [0|256] "" ADC
 SG_ ARC_OD_AabsY_Obj_36_RR : 48|9@0+ (0.125,-31.875) [-31.875|32] "m/s^2" ADC
 SG_ ARC_OD_DistXStd_Obj_36_RR : 71|8@0+ (0.05,0) [0|12.75] "m" ADC
 SG_ ARC_OD_DistYStd_Obj_36_RR : 79|8@0+ (0.1,0) [0|25.5] "m" ADC
 SG_ ARC_OD_VabsXStd_Obj_36_RR : 87|7@0+ (0.1,0) [0|12.7] "m/s" ADC
 SG_ ARC_OD_VabsYStd_Obj_36_RR : 80|7@0+ (0.2,0) [0|25.4] "m/s" ADC
 SG_ ARC_OD_AabsXStd_Obj_36_RR : 89|7@0+ (0.25,0) [0|31.75] "m/s^2" ADC

BO_ 1122 ARC_OD_34_35_RR: 64 ARC
 SG_ DistHeight_Obj_35_RR : 487|8@0+ (0.2,-10) [-10|41] "m" ADC
 SG_ DistHeight_Obj_34_RR : 479|8@0+ (0.2,-10) [-10|41] "m" ADC
 SG_ ARC_OD_DistX_Obj_34_RR : 7|12@0+ (0.1,-152) [-152|257.5] "m" ADC
 SG_ ARC_OD_Classification_Obj_34_RR : 98|3@0+ (1,0) [0|7] "" ADC
 SG_ ARC_OD_AabsYStd_Obj_34_RR : 111|8@0+ (0.25,0) [0|63.75] "m/s^2" ADC
 SG_ ARC_OD_ClassConf_Obj_34_RR : 119|7@0+ (1,0) [0|127] "%" ADC
 SG_ ARC_OD_ProbOfExist_Obj_34_RR : 112|7@0+ (1,0) [0|127] "%" ADC
 SG_ ARC_OD_VabsX_Obj_34_RR : 11|11@0+ (0.125,-128) [-128|127.875] "m/s" ADC
 SG_ ARC_OD_DynProp_Obj_34_RR : 130|3@0+ (1,0) [0|7] "" ADC
 SG_ ARC_OD_Length_Obj_34_RR : 136|7@0+ (0.2,0) [0|25.4] "m" ADC
 SG_ ARC_OD_MaintenanceState_Obj_34_R : 145|2@0+ (1,0) [0|3] "" ADC
 SG_ ARC_OD_Width_Obj_34_RR : 159|7@0+ (0.2,0) [0|25.4] "m" ADC
 SG_ ARC_OD_RCS_Obj_34_RR : 152|9@0+ (0.2,-51.1) [-51.1|51.1] "dBsm" ADC
 SG_ ARC_OD_Orientation_Obj_34_RR : 175|10@0+ (0.01,-5.11) [-5.11|5.12] "rad" ADC
 SG_ ARC_OD_LifeCycle_Obj_34_RR : 207|16@0+ (1,0) [0|65535] "" ADC
 SG_ ARC_OD_DistX_Obj_35_RR : 223|12@0+ (0.1,-152) [-152|257.5] "m" ADC
 SG_ ARC_OD_VabsX_Obj_35_RR : 227|11@0+ (0.125,-128) [-128|127.875] "m/s" ADC
 SG_ ARC_OD_AabsX_Obj_35_RR : 232|9@0+ (0.125,-31.875) [-31.875|32] "m/s^2" ADC
 SG_ ARC_OD_AabsX_Obj_34_RR : 16|9@0+ (0.125,-31.875) [-31.875|32] "m/s^2" ADC
 SG_ ARC_OD_DistY_Obj_35_RR : 255|12@0+ (0.0875,-179.113) [-179.113|179.2] "m" ADC
 SG_ ARC_OD_VabsY_Obj_35_RR : 259|11@0+ (0.125,-128) [-128|127.875] "m/s" ADC
 SG_ ARC_OD_AabsY_Obj_35_RR : 264|9@0+ (0.125,-31.875) [-31.875|32] "m/s^2" ADC
 SG_ ARC_OD_DistXStd_Obj_35_RR : 287|8@0+ (0.05,0) [0|12.75] "m" ADC
 SG_ ARC_OD_DistYStd_Obj_35_RR : 295|8@0+ (0.1,0) [0|25.5] "m" ADC
 SG_ ARC_OD_VabsXStd_Obj_35_RR : 303|7@0+ (0.1,0) [0|12.7] "m/s" ADC
 SG_ ARC_OD_VabsYStd_Obj_35_RR : 296|7@0+ (0.2,0) [0|25.4] "m/s" ADC
 SG_ ARC_OD_AabsXStd_Obj_35_RR : 305|7@0+ (0.25,0) [0|31.75] "m/s^2" ADC
 SG_ ARC_OD_Classification_Obj_35_RR : 314|3@0+ (1,0) [0|7] "" ADC
 SG_ ARC_OD_AabsYStd_Obj_35_RR : 327|8@0+ (0.25,0) [0|63.75] "m/s^2" ADC
 SG_ ARC_OD_ClassConf_Obj_35_RR : 335|7@0+ (1,0) [0|127] "%" ADC
 SG_ ARC_OD_DistY_Obj_34_RR : 39|12@0+ (0.0875,-179.113) [-179.113|179.2] "m" ADC
 SG_ ARC_OD_ProbOfExist_Obj_35_RR : 328|7@0+ (1,0) [0|127] "%" ADC
 SG_ ARC_OD_DynProp_Obj_35_RR : 346|3@0+ (1,0) [0|7] "" ADC
 SG_ ARC_OD_Length_Obj_35_RR : 352|7@0+ (0.2,0) [0|25.4] "m" ADC
 SG_ ARC_OD_MaintenanceState_Obj_35_R : 361|2@0+ (1,0) [0|3] "" ADC
 SG_ ARC_OD_Width_Obj_35_RR : 375|7@0+ (0.2,0) [0|25.4] "m" ADC
 SG_ ARC_OD_RCS_Obj_35_RR : 368|9@0+ (0.2,-51.1) [-51.1|51.1] "dBsm" ADC
 SG_ ARC_OD_Orientation_Obj_35_RR : 391|10@0+ (0.01,-5.11) [-5.11|5.12] "rad" ADC
 SG_ ARC_OD_LifeCycle_Obj_35_RR : 423|16@0+ (1,0) [0|65535] "" ADC
 SG_ ARC_OD_ObstacleProb_Obj_34_RR : 447|7@0+ (1,0) [0|127] "%" ADC
 SG_ ARC_OD_ObstacleProb_Obj_35_RR : 455|7@0+ (1,0) [0|127] "%" ADC
 SG_ ARC_OD_VabsY_Obj_34_RR : 43|11@0+ (0.125,-128) [-128|127.875] "m/s" ADC
 SG_ ARC_OD_ID_34_RR : 463|8@0+ (1,0) [0|255] "" ADC
 SG_ ARC_OD_ID_35_RR : 471|8@0+ (1,0) [0|255] "" ADC
 SG_ ARC_OD_MsgCounter_Obj_34_35_RR : 491|4@0+ (1,0) [0|15] "" ADC
 SG_ ARC_OD_CRC8_Obj_34_35_RR : 511|8@0+ (1,0) [0|256] "" ADC
 SG_ ARC_OD_AabsY_Obj_34_RR : 48|9@0+ (0.125,-31.875) [-31.875|32] "m/s^2" ADC
 SG_ ARC_OD_DistXStd_Obj_34_RR : 71|8@0+ (0.05,0) [0|12.75] "m" ADC
 SG_ ARC_OD_DistYStd_Obj_34_RR : 79|8@0+ (0.1,0) [0|25.5] "m" ADC
 SG_ ARC_OD_VabsXStd_Obj_34_RR : 87|7@0+ (0.1,0) [0|12.7] "m/s" ADC
 SG_ ARC_OD_VabsYStd_Obj_34_RR : 80|7@0+ (0.2,0) [0|25.4] "m/s" ADC
 SG_ ARC_OD_AabsXStd_Obj_34_RR : 89|7@0+ (0.25,0) [0|31.75] "m/s^2" ADC

CM_ SG_ 1362 ARC_OD_DistX_Obj_02_FR "111";

BA_DEF_ BO_ "GenMsgCycleTime" INT 0 65535;
BA_DEF_ BO_ "GenMsgSendType" ENUM "Cycle","OnChange","OnWrite","OnWriteWithRepetition","OnChangeWithRepetition","IfActive","IfActiveWithRepetition","NoMsgSendType";
BA_DEF_ BO_ "VFrameFormat" ENUM "StandardCAN","ExtendedCAN","reserved","reserved","reserved","reserved","reserved","reserved","reserved","reserved","reserved","reserved","reserved","reserved","StandardCAN_FD","ExtendedCAN_FD";
BA_DEF_ SG_ "GenSigILSupport" ENUM "No","Yes";
BA_DEF_ SG_ "GenSigInactiveValue" HEX 0 0;
BA_DEF_ SG_ "GenSigSendType" ENUM "Cycle","OnWrite","OnWriteWithRepetition","OnChange","OnChangeWithRepetition","IfActive","IfActiveWithRepetition","NoSigSendType","vector_leerstring";
BA_DEF_ SG_ "GenSigStartValue" FLOAT 0 100000000000;
BA_DEF_DEF_ "GenMsgCycleTime" 0;
BA_DEF_DEF_ "GenMsgSendType" "Cycle";
BA_DEF_DEF_ "VFrameFormat" "StandardCAN";
BA_DEF_DEF_ "GenSigILSupport" "Yes";
BA_DEF_DEF_ "GenSigSendType" "NoSigSendType";
BA_DEF_DEF_ "GenSigStartValue" 0;
BA_DEF_DEF_ "GenSigInactiveValue" 0;
BA_ "GenMsgCycleTime" BO_ 1372 50;
BA_ "VFrameFormat" BO_ 1372 14;
BA_ "GenMsgCycleTime" BO_ 1371 50;
BA_ "VFrameFormat" BO_ 1371 14;
BA_ "GenMsgCycleTime" BO_ 1370 50;
BA_ "VFrameFormat" BO_ 1370 14;
BA_ "GenMsgCycleTime" BO_ 1369 50;
BA_ "VFrameFormat" BO_ 1369 14;
BA_ "GenMsgCycleTime" BO_ 1368 50;
BA_ "VFrameFormat" BO_ 1368 14;
BA_ "GenMsgCycleTime" BO_ 1367 50;
BA_ "VFrameFormat" BO_ 1367 14;
BA_ "GenMsgCycleTime" BO_ 1366 50;
BA_ "VFrameFormat" BO_ 1366 14;
BA_ "GenMsgCycleTime" BO_ 1365 50;
BA_ "VFrameFormat" BO_ 1365 14;
BA_ "GenMsgCycleTime" BO_ 1364 50;
BA_ "VFrameFormat" BO_ 1364 14;
BA_ "GenMsgCycleTime" BO_ 1363 50;
BA_ "VFrameFormat" BO_ 1363 14;
BA_ "GenMsgCycleTime" BO_ 1362 50;
BA_ "VFrameFormat" BO_ 1362 14;
BA_ "GenMsgCycleTime" BO_ 1361 50;
BA_ "VFrameFormat" BO_ 1361 14;
BA_ "GenMsgCycleTime" BO_ 1134 50;
BA_ "VFrameFormat" BO_ 1134 14;
BA_ "GenMsgCycleTime" BO_ 1133 50;
BA_ "VFrameFormat" BO_ 1133 14;
BA_ "GenMsgCycleTime" BO_ 1132 50;
BA_ "VFrameFormat" BO_ 1132 14;
BA_ "GenMsgCycleTime" BO_ 1131 50;
BA_ "VFrameFormat" BO_ 1131 14;
BA_ "GenMsgCycleTime" BO_ 1130 50;
BA_ "VFrameFormat" BO_ 1130 14;
BA_ "GenMsgCycleTime" BO_ 1129 50;
BA_ "VFrameFormat" BO_ 1129 14;
BA_ "GenMsgCycleTime" BO_ 1128 50;
BA_ "VFrameFormat" BO_ 1128 14;
BA_ "GenMsgCycleTime" BO_ 1127 50;
BA_ "VFrameFormat" BO_ 1127 14;
BA_ "GenMsgCycleTime" BO_ 1126 50;
BA_ "VFrameFormat" BO_ 1126 14;
BA_ "GenMsgCycleTime" BO_ 1125 50;
BA_ "VFrameFormat" BO_ 1125 14;
BA_ "GenMsgCycleTime" BO_ 1124 50;
BA_ "VFrameFormat" BO_ 1124 14;
BA_ "GenMsgCycleTime" BO_ 1123 50;
BA_ "VFrameFormat" BO_ 1123 14;
BA_ "GenMsgCycleTime" BO_ 1122 50;
BA_ "VFrameFormat" BO_ 1122 14;
BA_ "GenSigSendType" SG_ 1372 DistHeight_Obj_23_FR 8;
BA_ "GenSigSendType" SG_ 1372 DistHeight_Obj_22_FR 8;
BA_ "GenSigSendType" SG_ 1372 ARC_OD_DistX_Obj_22_FR 8;
BA_ "GenSigSendType" SG_ 1372 ARC_OD_Classification_Obj_22_FR 8;
BA_ "GenSigSendType" SG_ 1372 ARC_OD_AabsYStd_Obj_22_FR 8;
BA_ "GenSigSendType" SG_ 1372 ARC_OD_ClassConf_Obj_22_FR 8;
BA_ "GenSigSendType" SG_ 1372 ARC_OD_ProbOfExist_Obj_22_FR 8;
BA_ "GenSigSendType" SG_ 1372 ARC_OD_VabsX_Obj_22_FR 8;
BA_ "GenSigSendType" SG_ 1372 ARC_OD_DynProp_Obj_22_FR 8;
BA_ "GenSigSendType" SG_ 1372 ARC_OD_Length_Obj_22_FR 8;
BA_ "GenSigSendType" SG_ 1372 ARC_OD_MaintenanceState_Obj_0037 8;
BA_ "GenSigSendType" SG_ 1372 ARC_OD_Width_Obj_22_FR 8;
BA_ "GenSigSendType" SG_ 1372 ARC_OD_RCS_Obj_22_FR 8;
BA_ "GenSigSendType" SG_ 1372 ARC_OD_Orientation_Obj_22_FR 8;
BA_ "GenSigSendType" SG_ 1372 ARC_OD_LifeCycle_Obj_22_FR 8;
BA_ "GenSigSendType" SG_ 1372 ARC_OD_DistX_Obj_23_FR 8;
BA_ "GenSigSendType" SG_ 1372 ARC_OD_VabsX_Obj_23_FR 8;
BA_ "GenSigSendType" SG_ 1372 ARC_OD_AabsX_Obj_23_FR 8;
BA_ "GenSigSendType" SG_ 1372 ARC_OD_AabsX_Obj_22_FR 8;
BA_ "GenSigSendType" SG_ 1372 ARC_OD_DistY_Obj_23_FR 8;
BA_ "GenSigSendType" SG_ 1372 ARC_OD_VabsY_Obj_23_FR 8;
BA_ "GenSigSendType" SG_ 1372 ARC_OD_AabsY_Obj_23_FR 8;
BA_ "GenSigSendType" SG_ 1372 ARC_OD_DistXStd_Obj_23_FR 8;
BA_ "GenSigSendType" SG_ 1372 ARC_OD_DistYStd_Obj_23_FR 8;
BA_ "GenSigSendType" SG_ 1372 ARC_OD_VabsXStd_Obj_23_FR 8;
BA_ "GenSigSendType" SG_ 1372 ARC_OD_VabsYStd_Obj_23_FR 8;
BA_ "GenSigSendType" SG_ 1372 ARC_OD_AabsXStd_Obj_23_FR 8;
BA_ "GenSigSendType" SG_ 1372 ARC_OD_Classification_Obj_23_FR 8;
BA_ "GenSigSendType" SG_ 1372 ARC_OD_AabsYStd_Obj_23_FR 8;
BA_ "GenSigSendType" SG_ 1372 ARC_OD_ClassConf_Obj_23_FR 8;
BA_ "GenSigSendType" SG_ 1372 ARC_OD_DistY_Obj_22_FR 8;
BA_ "GenSigSendType" SG_ 1372 ARC_OD_ProbOfExist_Obj_23_FR 8;
BA_ "GenSigSendType" SG_ 1372 ARC_OD_DynProp_Obj_23_FR 8;
BA_ "GenSigSendType" SG_ 1372 ARC_OD_Length_Obj_23_FR 8;
BA_ "GenSigSendType" SG_ 1372 ARC_OD_MaintenanceState_Obj_0038 8;
BA_ "GenSigSendType" SG_ 1372 ARC_OD_Width_Obj_23_FR 8;
BA_ "GenSigSendType" SG_ 1372 ARC_OD_RCS_Obj_23_FR 8;
BA_ "GenSigSendType" SG_ 1372 ARC_OD_Orientation_Obj_23_FR 8;
BA_ "GenSigSendType" SG_ 1372 ARC_OD_LifeCycle_Obj_23_FR 8;
BA_ "GenSigSendType" SG_ 1372 ARC_OD_ObstacleProb_Obj_22_FR 8;
BA_ "GenSigSendType" SG_ 1372 ARC_OD_ObstacleProb_Obj_23_FR 8;
BA_ "GenSigSendType" SG_ 1372 ARC_OD_VabsY_Obj_22_FR 8;
BA_ "GenSigSendType" SG_ 1372 ARC_OD_ID_22_FR 8;
BA_ "GenSigSendType" SG_ 1372 ARC_OD_ID_23_FR 8;
BA_ "GenSigSendType" SG_ 1372 ARC_OD_MsgCounter_Obj_22_23_FR 8;
BA_ "GenSigSendType" SG_ 1372 ARC_OD_CRC8_Obj_22_23_FR 8;
BA_ "GenSigSendType" SG_ 1372 ARC_OD_AabsY_Obj_22_FR 8;
BA_ "GenSigSendType" SG_ 1372 ARC_OD_DistXStd_Obj_22_FR 8;
BA_ "GenSigSendType" SG_ 1372 ARC_OD_DistYStd_Obj_22_FR 8;
BA_ "GenSigSendType" SG_ 1372 ARC_OD_VabsXStd_Obj_22_FR 8;
BA_ "GenSigSendType" SG_ 1372 ARC_OD_VabsYStd_Obj_22_FR 8;
BA_ "GenSigSendType" SG_ 1372 ARC_OD_AabsXStd_Obj_22_FR 8;
BA_ "GenSigSendType" SG_ 1371 DistHeight_Obj_21_FR 8;
BA_ "GenSigSendType" SG_ 1371 DistHeight_Obj_20_FR 8;
BA_ "GenSigSendType" SG_ 1371 ARC_OD_DistX_Obj_20_FR 8;
BA_ "GenSigSendType" SG_ 1371 ARC_OD_Classification_Obj_20_FR 8;
BA_ "GenSigSendType" SG_ 1371 ARC_OD_AabsYStd_Obj_20_FR 8;
BA_ "GenSigSendType" SG_ 1371 ARC_OD_ClassConf_Obj_20_FR 8;
BA_ "GenSigSendType" SG_ 1371 ARC_OD_ProbOfExist_Obj_20_FR 8;
BA_ "GenSigSendType" SG_ 1371 ARC_OD_VabsX_Obj_20_FR 8;
BA_ "GenSigSendType" SG_ 1371 ARC_OD_DynProp_Obj_20_FR 8;
BA_ "GenSigSendType" SG_ 1371 ARC_OD_Length_Obj_20_FR 8;
BA_ "GenSigSendType" SG_ 1371 ARC_OD_MaintenanceState_Obj_0039 8;
BA_ "GenSigSendType" SG_ 1371 ARC_OD_Width_Obj_20_FR 8;
BA_ "GenSigSendType" SG_ 1371 ARC_OD_RCS_Obj_20_FR 8;
BA_ "GenSigSendType" SG_ 1371 ARC_OD_Orientation_Obj_20_FR 8;
BA_ "GenSigSendType" SG_ 1371 ARC_OD_LifeCycle_Obj_20_FR 8;
BA_ "GenSigSendType" SG_ 1371 ARC_OD_DistX_Obj_21_FR 8;
BA_ "GenSigSendType" SG_ 1371 ARC_OD_VabsX_Obj_21_FR 8;
BA_ "GenSigSendType" SG_ 1371 ARC_OD_AabsX_Obj_21_FR 8;
BA_ "GenSigSendType" SG_ 1371 ARC_OD_AabsX_Obj_20_FR 8;
BA_ "GenSigSendType" SG_ 1371 ARC_OD_DistY_Obj_21_FR 8;
BA_ "GenSigSendType" SG_ 1371 ARC_OD_VabsY_Obj_21_FR 8;
BA_ "GenSigSendType" SG_ 1371 ARC_OD_AabsY_Obj_21_FR 8;
BA_ "GenSigSendType" SG_ 1371 ARC_OD_DistXStd_Obj_21_FR 8;
BA_ "GenSigSendType" SG_ 1371 ARC_OD_DistYStd_Obj_21_FR 8;
BA_ "GenSigSendType" SG_ 1371 ARC_OD_VabsXStd_Obj_21_FR 8;
BA_ "GenSigSendType" SG_ 1371 ARC_OD_VabsYStd_Obj_21_FR 8;
BA_ "GenSigSendType" SG_ 1371 ARC_OD_AabsXStd_Obj_21_FR 8;
BA_ "GenSigSendType" SG_ 1371 ARC_OD_Classification_Obj_21_FR 8;
BA_ "GenSigSendType" SG_ 1371 ARC_OD_AabsYStd_Obj_21_FR 8;
BA_ "GenSigSendType" SG_ 1371 ARC_OD_ClassConf_Obj_21_FR 8;
BA_ "GenSigSendType" SG_ 1371 ARC_OD_DistY_Obj_20_FR 8;
BA_ "GenSigSendType" SG_ 1371 ARC_OD_ProbOfExist_Obj_21_FR 8;
BA_ "GenSigSendType" SG_ 1371 ARC_OD_DynProp_Obj_21_FR 8;
BA_ "GenSigSendType" SG_ 1371 ARC_OD_Length_Obj_21_FR 8;
BA_ "GenSigSendType" SG_ 1371 ARC_OD_MaintenanceState_Obj_0040 8;
BA_ "GenSigSendType" SG_ 1371 ARC_OD_Width_Obj_21_FR 8;
BA_ "GenSigSendType" SG_ 1371 ARC_OD_RCS_Obj_21_FR 8;
BA_ "GenSigSendType" SG_ 1371 ARC_OD_Orientation_Obj_21_FR 8;
BA_ "GenSigSendType" SG_ 1371 ARC_OD_LifeCycle_Obj_21_FR 8;
BA_ "GenSigSendType" SG_ 1371 ARC_OD_ObstacleProb_Obj_20_FR 8;
BA_ "GenSigSendType" SG_ 1371 ARC_OD_ObstacleProb_Obj_21_FR 8;
BA_ "GenSigSendType" SG_ 1371 ARC_OD_VabsY_Obj_20_FR 8;
BA_ "GenSigSendType" SG_ 1371 ARC_OD_ID_20_FR 8;
BA_ "GenSigSendType" SG_ 1371 ARC_OD_ID_21_FR 8;
BA_ "GenSigSendType" SG_ 1371 ARC_OD_MsgCounter_Obj_20_21_FR 8;
BA_ "GenSigSendType" SG_ 1371 ARC_OD_CRC8_Obj_20_21_FR 8;
BA_ "GenSigSendType" SG_ 1371 ARC_OD_AabsY_Obj_20_FR 8;
BA_ "GenSigSendType" SG_ 1371 ARC_OD_DistXStd_Obj_20_FR 8;
BA_ "GenSigSendType" SG_ 1371 ARC_OD_DistYStd_Obj_20_FR 8;
BA_ "GenSigSendType" SG_ 1371 ARC_OD_VabsXStd_Obj_20_FR 8;
BA_ "GenSigSendType" SG_ 1371 ARC_OD_VabsYStd_Obj_20_FR 8;
BA_ "GenSigSendType" SG_ 1371 ARC_OD_AabsXStd_Obj_20_FR 8;
BA_ "GenSigSendType" SG_ 1370 DistHeight_Obj_19_FR 8;
BA_ "GenSigSendType" SG_ 1370 DistHeight_Obj_18_FR 8;
BA_ "GenSigSendType" SG_ 1370 ARC_OD_DistX_Obj_18_FR 8;
BA_ "GenSigSendType" SG_ 1370 ARC_OD_Classification_Obj_18_FR 8;
BA_ "GenSigSendType" SG_ 1370 ARC_OD_AabsYStd_Obj_18_FR 8;
BA_ "GenSigSendType" SG_ 1370 ARC_OD_ClassConf_Obj_18_FR 8;
BA_ "GenSigSendType" SG_ 1370 ARC_OD_ProbOfExist_Obj_18_FR 8;
BA_ "GenSigSendType" SG_ 1370 ARC_OD_VabsX_Obj_18_FR 8;
BA_ "GenSigSendType" SG_ 1370 ARC_OD_DynProp_Obj_18_FR 8;
BA_ "GenSigSendType" SG_ 1370 ARC_OD_Length_Obj_18_FR 8;
BA_ "GenSigSendType" SG_ 1370 ARC_OD_MaintenanceState_Obj_0041 8;
BA_ "GenSigSendType" SG_ 1370 ARC_OD_Width_Obj_18_FR 8;
BA_ "GenSigSendType" SG_ 1370 ARC_OD_RCS_Obj_18_FR 8;
BA_ "GenSigSendType" SG_ 1370 ARC_OD_Orientation_Obj_18_FR 8;
BA_ "GenSigSendType" SG_ 1370 ARC_OD_LifeCycle_Obj_18_FR 8;
BA_ "GenSigSendType" SG_ 1370 ARC_OD_DistX_Obj_19_FR 8;
BA_ "GenSigSendType" SG_ 1370 ARC_OD_VabsX_Obj_19_FR 8;
BA_ "GenSigSendType" SG_ 1370 ARC_OD_AabsX_Obj_19_FR 8;
BA_ "GenSigSendType" SG_ 1370 ARC_OD_AabsX_Obj_18_FR 8;
BA_ "GenSigSendType" SG_ 1370 ARC_OD_DistY_Obj_19_FR 8;
BA_ "GenSigSendType" SG_ 1370 ARC_OD_VabsY_Obj_19_FR 8;
BA_ "GenSigSendType" SG_ 1370 ARC_OD_AabsY_Obj_19_FR 8;
BA_ "GenSigSendType" SG_ 1370 ARC_OD_DistXStd_Obj_19_FR 8;
BA_ "GenSigSendType" SG_ 1370 ARC_OD_DistYStd_Obj_19_FR 8;
BA_ "GenSigSendType" SG_ 1370 ARC_OD_VabsXStd_Obj_19_FR 8;
BA_ "GenSigSendType" SG_ 1370 ARC_OD_VabsYStd_Obj_19_FR 8;
BA_ "GenSigSendType" SG_ 1370 ARC_OD_AabsXStd_Obj_19_FR 8;
BA_ "GenSigSendType" SG_ 1370 ARC_OD_Classification_Obj_19_FR 8;
BA_ "GenSigSendType" SG_ 1370 ARC_OD_AabsYStd_Obj_19_FR 8;
BA_ "GenSigSendType" SG_ 1370 ARC_OD_ClassConf_Obj_19_FR 8;
BA_ "GenSigSendType" SG_ 1370 ARC_OD_DistY_Obj_18_FR 8;
BA_ "GenSigSendType" SG_ 1370 ARC_OD_ProbOfExist_Obj_19_FR 8;
BA_ "GenSigSendType" SG_ 1370 ARC_OD_DynProp_Obj_19_FR 8;
BA_ "GenSigSendType" SG_ 1370 ARC_OD_Length_Obj_19_FR 8;
BA_ "GenSigSendType" SG_ 1370 ARC_OD_MaintenanceState_Obj_0042 8;
BA_ "GenSigSendType" SG_ 1370 ARC_OD_Width_Obj_19_FR 8;
BA_ "GenSigSendType" SG_ 1370 ARC_OD_RCS_Obj_19_FR 8;
BA_ "GenSigSendType" SG_ 1370 ARC_OD_Orientation_Obj_19_FR 8;
BA_ "GenSigSendType" SG_ 1370 ARC_OD_LifeCycle_Obj_19_FR 8;
BA_ "GenSigSendType" SG_ 1370 ARC_OD_ObstacleProb_Obj_18_FR 8;
BA_ "GenSigSendType" SG_ 1370 ARC_OD_ObstacleProb_Obj_19_FR 8;
BA_ "GenSigSendType" SG_ 1370 ARC_OD_VabsY_Obj_18_FR 8;
BA_ "GenSigSendType" SG_ 1370 ARC_OD_ID_18_FR 8;
BA_ "GenSigSendType" SG_ 1370 ARC_OD_ID_19_FR 8;
BA_ "GenSigSendType" SG_ 1370 ARC_OD_MsgCounter_Obj_18_19_FR 8;
BA_ "GenSigSendType" SG_ 1370 ARC_OD_CRC8_Obj_18_19_FR 8;
BA_ "GenSigSendType" SG_ 1370 ARC_OD_AabsY_Obj_18_FR 8;
BA_ "GenSigSendType" SG_ 1370 ARC_OD_DistXStd_Obj_18_FR 8;
BA_ "GenSigSendType" SG_ 1370 ARC_OD_DistYStd_Obj_18_FR 8;
BA_ "GenSigSendType" SG_ 1370 ARC_OD_VabsXStd_Obj_18_FR 8;
BA_ "GenSigSendType" SG_ 1370 ARC_OD_VabsYStd_Obj_18_FR 8;
BA_ "GenSigSendType" SG_ 1370 ARC_OD_AabsXStd_Obj_18_FR 8;
BA_ "GenSigSendType" SG_ 1369 DistHeight_Obj_17_FR 8;
BA_ "GenSigSendType" SG_ 1369 DistHeight_Obj_16_FR 8;
BA_ "GenSigSendType" SG_ 1369 ARC_OD_DistX_Obj_16_FR 8;
BA_ "GenSigSendType" SG_ 1369 ARC_OD_Classification_Obj_16_FR 8;
BA_ "GenSigSendType" SG_ 1369 ARC_OD_AabsYStd_Obj_16_FR 8;
BA_ "GenSigSendType" SG_ 1369 ARC_OD_ClassConf_Obj_16_FR 8;
BA_ "GenSigSendType" SG_ 1369 ARC_OD_ProbOfExist_Obj_16_FR 8;
BA_ "GenSigSendType" SG_ 1369 ARC_OD_VabsX_Obj_16_FR 8;
BA_ "GenSigSendType" SG_ 1369 ARC_OD_DynProp_Obj_16_FR 8;
BA_ "GenSigSendType" SG_ 1369 ARC_OD_Length_Obj_16_FR 8;
BA_ "GenSigSendType" SG_ 1369 ARC_OD_MaintenanceState_Obj_0043 8;
BA_ "GenSigSendType" SG_ 1369 ARC_OD_Width_Obj_16_FR 8;
BA_ "GenSigSendType" SG_ 1369 ARC_OD_RCS_Obj_16_FR 8;
BA_ "GenSigSendType" SG_ 1369 ARC_OD_Orientation_Obj_16_FR 8;
BA_ "GenSigSendType" SG_ 1369 ARC_OD_LifeCycle_Obj_16_FR 8;
BA_ "GenSigSendType" SG_ 1369 ARC_OD_DistX_Obj_17_FR 8;
BA_ "GenSigSendType" SG_ 1369 ARC_OD_VabsX_Obj_17_FR 8;
BA_ "GenSigSendType" SG_ 1369 ARC_OD_AabsX_Obj_17_FR 8;
BA_ "GenSigSendType" SG_ 1369 ARC_OD_AabsX_Obj_16_FR 8;
BA_ "GenSigSendType" SG_ 1369 ARC_OD_DistY_Obj_17_FR 8;
BA_ "GenSigSendType" SG_ 1369 ARC_OD_VabsY_Obj_17_FR 8;
BA_ "GenSigSendType" SG_ 1369 ARC_OD_AabsY_Obj_17_FR 8;
BA_ "GenSigSendType" SG_ 1369 ARC_OD_DistXStd_Obj_17_FR 8;
BA_ "GenSigSendType" SG_ 1369 ARC_OD_DistYStd_Obj_17_FR 8;
BA_ "GenSigSendType" SG_ 1369 ARC_OD_VabsXStd_Obj_17_FR 8;
BA_ "GenSigSendType" SG_ 1369 ARC_OD_VabsYStd_Obj_17_FR 8;
BA_ "GenSigSendType" SG_ 1369 ARC_OD_AabsXStd_Obj_17_FR 8;
BA_ "GenSigSendType" SG_ 1369 ARC_OD_Classification_Obj_17_FR 8;
BA_ "GenSigSendType" SG_ 1369 ARC_OD_AabsYStd_Obj_17_FR 8;
BA_ "GenSigSendType" SG_ 1369 ARC_OD_ClassConf_Obj_17_FR 8;
BA_ "GenSigSendType" SG_ 1369 ARC_OD_DistY_Obj_16_FR 8;
BA_ "GenSigSendType" SG_ 1369 ARC_OD_ProbOfExist_Obj_17_FR 8;
BA_ "GenSigSendType" SG_ 1369 ARC_OD_DynProp_Obj_17_FR 8;
BA_ "GenSigSendType" SG_ 1369 ARC_OD_Length_Obj_17_FR 8;
BA_ "GenSigSendType" SG_ 1369 ARC_OD_MaintenanceState_Obj_0044 8;
BA_ "GenSigSendType" SG_ 1369 ARC_OD_Width_Obj_17_FR 8;
BA_ "GenSigSendType" SG_ 1369 ARC_OD_RCS_Obj_17_FR 8;
BA_ "GenSigSendType" SG_ 1369 ARC_OD_Orientation_Obj_17_FR 8;
BA_ "GenSigSendType" SG_ 1369 ARC_OD_LifeCycle_Obj_17_FR 8;
BA_ "GenSigSendType" SG_ 1369 ARC_OD_ObstacleProb_Obj_16_FR 8;
BA_ "GenSigSendType" SG_ 1369 ARC_OD_ObstacleProb_Obj_17_FR 8;
BA_ "GenSigSendType" SG_ 1369 ARC_OD_VabsY_Obj_16_FR 8;
BA_ "GenSigSendType" SG_ 1369 ARC_OD_ID_16_FR 8;
BA_ "GenSigSendType" SG_ 1369 ARC_OD_ID_17_FR 8;
BA_ "GenSigSendType" SG_ 1369 ARC_OD_MsgCounter_Obj_16_17_FR 8;
BA_ "GenSigSendType" SG_ 1369 ARC_OD_CRC8_Obj_16_17_FR 8;
BA_ "GenSigSendType" SG_ 1369 ARC_OD_AabsY_Obj_16_FR 8;
BA_ "GenSigSendType" SG_ 1369 ARC_OD_DistXStd_Obj_16_FR 8;
BA_ "GenSigSendType" SG_ 1369 ARC_OD_DistYStd_Obj_16_FR 8;
BA_ "GenSigSendType" SG_ 1369 ARC_OD_VabsXStd_Obj_16_FR 8;
BA_ "GenSigSendType" SG_ 1369 ARC_OD_VabsYStd_Obj_16_FR 8;
BA_ "GenSigSendType" SG_ 1369 ARC_OD_AabsXStd_Obj_16_FR 8;
BA_ "GenSigSendType" SG_ 1368 DistHeight_Obj_15_FR 8;
BA_ "GenSigSendType" SG_ 1368 DistHeight_Obj_14_FR 8;
BA_ "GenSigSendType" SG_ 1368 ARC_OD_DistX_Obj_14_FR 8;
BA_ "GenSigSendType" SG_ 1368 ARC_OD_Classification_Obj_14_FR 8;
BA_ "GenSigSendType" SG_ 1368 ARC_OD_AabsYStd_Obj_14_FR 8;
BA_ "GenSigSendType" SG_ 1368 ARC_OD_ClassConf_Obj_14_FR 8;
BA_ "GenSigSendType" SG_ 1368 ARC_OD_ProbOfExist_Obj_14_FR 8;
BA_ "GenSigSendType" SG_ 1368 ARC_OD_VabsX_Obj_14_FR 8;
BA_ "GenSigSendType" SG_ 1368 ARC_OD_DynProp_Obj_14_FR 8;
BA_ "GenSigSendType" SG_ 1368 ARC_OD_Length_Obj_14_FR 8;
BA_ "GenSigSendType" SG_ 1368 ARC_OD_MaintenanceState_Obj_0045 8;
BA_ "GenSigSendType" SG_ 1368 ARC_OD_Width_Obj_14_FR 8;
BA_ "GenSigSendType" SG_ 1368 ARC_OD_RCS_Obj_14_FR 8;
BA_ "GenSigSendType" SG_ 1368 ARC_OD_Orientation_Obj_14_FR 8;
BA_ "GenSigSendType" SG_ 1368 ARC_OD_LifeCycle_Obj_14_FR 8;
BA_ "GenSigSendType" SG_ 1368 ARC_OD_DistX_Obj_15_FR 8;
BA_ "GenSigSendType" SG_ 1368 ARC_OD_VabsX_Obj_15_FR 8;
BA_ "GenSigSendType" SG_ 1368 ARC_OD_AabsX_Obj_15_FR 8;
BA_ "GenSigSendType" SG_ 1368 ARC_OD_AabsX_Obj_14_FR 8;
BA_ "GenSigSendType" SG_ 1368 ARC_OD_DistY_Obj_15_FR 8;
BA_ "GenSigSendType" SG_ 1368 ARC_OD_VabsY_Obj_15_FR 8;
BA_ "GenSigSendType" SG_ 1368 ARC_OD_AabsY_Obj_15_FR 8;
BA_ "GenSigSendType" SG_ 1368 ARC_OD_DistXStd_Obj_15_FR 8;
BA_ "GenSigSendType" SG_ 1368 ARC_OD_DistYStd_Obj_15_FR 8;
BA_ "GenSigSendType" SG_ 1368 ARC_OD_VabsXStd_Obj_15_FR 8;
BA_ "GenSigSendType" SG_ 1368 ARC_OD_VabsYStd_Obj_15_FR 8;
BA_ "GenSigSendType" SG_ 1368 ARC_OD_AabsXStd_Obj_15_FR 8;
BA_ "GenSigSendType" SG_ 1368 ARC_OD_Classification_Obj_15_FR 8;
BA_ "GenSigSendType" SG_ 1368 ARC_OD_AabsYStd_Obj_15_FR 8;
BA_ "GenSigSendType" SG_ 1368 ARC_OD_ClassConf_Obj_15_FR 8;
BA_ "GenSigSendType" SG_ 1368 ARC_OD_DistY_Obj_14_FR 8;
BA_ "GenSigSendType" SG_ 1368 ARC_OD_ProbOfExist_Obj_15_FR 8;
BA_ "GenSigSendType" SG_ 1368 ARC_OD_DynProp_Obj_15_FR 8;
BA_ "GenSigSendType" SG_ 1368 ARC_OD_Length_Obj_15_FR 8;
BA_ "GenSigSendType" SG_ 1368 ARC_OD_MaintenanceState_Obj_0046 8;
BA_ "GenSigSendType" SG_ 1368 ARC_OD_Width_Obj_15_FR 8;
BA_ "GenSigSendType" SG_ 1368 ARC_OD_RCS_Obj_15_FR 8;
BA_ "GenSigSendType" SG_ 1368 ARC_OD_Orientation_Obj_15_FR 8;
BA_ "GenSigSendType" SG_ 1368 ARC_OD_LifeCycle_Obj_15_FR 8;
BA_ "GenSigSendType" SG_ 1368 ARC_OD_ObstacleProb_Obj_14_FR 8;
BA_ "GenSigSendType" SG_ 1368 ARC_OD_ObstacleProb_Obj_15_FR 8;
BA_ "GenSigSendType" SG_ 1368 ARC_OD_VabsY_Obj_14_FR 8;
BA_ "GenSigSendType" SG_ 1368 ARC_OD_ID_14_FR 8;
BA_ "GenSigSendType" SG_ 1368 ARC_OD_ID_15_FR 8;
BA_ "GenSigSendType" SG_ 1368 ARC_OD_MsgCounter_Obj_14_15_FR 8;
BA_ "GenSigSendType" SG_ 1368 ARC_OD_CRC8_Obj_14_15_FR 8;
BA_ "GenSigSendType" SG_ 1368 ARC_OD_AabsY_Obj_14_FR 8;
BA_ "GenSigSendType" SG_ 1368 ARC_OD_DistXStd_Obj_14_FR 8;
BA_ "GenSigSendType" SG_ 1368 ARC_OD_DistYStd_Obj_14_FR 8;
BA_ "GenSigSendType" SG_ 1368 ARC_OD_VabsXStd_Obj_14_FR 8;
BA_ "GenSigSendType" SG_ 1368 ARC_OD_VabsYStd_Obj_14_FR 8;
BA_ "GenSigSendType" SG_ 1368 ARC_OD_AabsXStd_Obj_14_FR 8;
BA_ "GenSigSendType" SG_ 1367 DistHeight_Obj_13_FR 8;
BA_ "GenSigSendType" SG_ 1367 DistHeight_Obj_12_FR 8;
BA_ "GenSigSendType" SG_ 1367 ARC_OD_DistX_Obj_12_FR 8;
BA_ "GenSigSendType" SG_ 1367 ARC_OD_Classification_Obj_12_FR 8;
BA_ "GenSigSendType" SG_ 1367 ARC_OD_AabsYStd_Obj_12_FR 8;
BA_ "GenSigSendType" SG_ 1367 ARC_OD_ClassConf_Obj_12_FR 8;
BA_ "GenSigSendType" SG_ 1367 ARC_OD_ProbOfExist_Obj_12_FR 8;
BA_ "GenSigSendType" SG_ 1367 ARC_OD_VabsX_Obj_12_FR 8;
BA_ "GenSigSendType" SG_ 1367 ARC_OD_DynProp_Obj_12_FR 8;
BA_ "GenSigSendType" SG_ 1367 ARC_OD_Length_Obj_12_FR 8;
BA_ "GenSigSendType" SG_ 1367 ARC_OD_MaintenanceState_Obj_0047 8;
BA_ "GenSigSendType" SG_ 1367 ARC_OD_Width_Obj_12_FR 8;
BA_ "GenSigSendType" SG_ 1367 ARC_OD_RCS_Obj_12_FR 8;
BA_ "GenSigSendType" SG_ 1367 ARC_OD_Orientation_Obj_12_FR 8;
BA_ "GenSigSendType" SG_ 1367 ARC_OD_LifeCycle_Obj_12_FR 8;
BA_ "GenSigSendType" SG_ 1367 ARC_OD_DistX_Obj_13_FR 8;
BA_ "GenSigSendType" SG_ 1367 ARC_OD_VabsX_Obj_13_FR 8;
BA_ "GenSigSendType" SG_ 1367 ARC_OD_AabsX_Obj_13_FR 8;
BA_ "GenSigSendType" SG_ 1367 ARC_OD_AabsX_Obj_12_FR 8;
BA_ "GenSigSendType" SG_ 1367 ARC_OD_DistY_Obj_13_FR 8;
BA_ "GenSigSendType" SG_ 1367 ARC_OD_VabsY_Obj_13_FR 8;
BA_ "GenSigSendType" SG_ 1367 ARC_OD_AabsY_Obj_13_FR 8;
BA_ "GenSigSendType" SG_ 1367 ARC_OD_DistXStd_Obj_13_FR 8;
BA_ "GenSigSendType" SG_ 1367 ARC_OD_DistYStd_Obj_13_FR 8;
BA_ "GenSigSendType" SG_ 1367 ARC_OD_VabsXStd_Obj_13_FR 8;
BA_ "GenSigSendType" SG_ 1367 ARC_OD_VabsYStd_Obj_13_FR 8;
BA_ "GenSigSendType" SG_ 1367 ARC_OD_AabsXStd_Obj_13_FR 8;
BA_ "GenSigSendType" SG_ 1367 ARC_OD_Classification_Obj_13_FR 8;
BA_ "GenSigSendType" SG_ 1367 ARC_OD_AabsYStd_Obj_13_FR 8;
BA_ "GenSigSendType" SG_ 1367 ARC_OD_ClassConf_Obj_13_FR 8;
BA_ "GenSigSendType" SG_ 1367 ARC_OD_DistY_Obj_12_FR 8;
BA_ "GenSigSendType" SG_ 1367 ARC_OD_ProbOfExist_Obj_13_FR 8;
BA_ "GenSigSendType" SG_ 1367 ARC_OD_DynProp_Obj_13_FR 8;
BA_ "GenSigSendType" SG_ 1367 ARC_OD_Length_Obj_13_FR 8;
BA_ "GenSigSendType" SG_ 1367 ARC_OD_MaintenanceState_Obj_0048 8;
BA_ "GenSigSendType" SG_ 1367 ARC_OD_Width_Obj_13_FR 8;
BA_ "GenSigSendType" SG_ 1367 ARC_OD_RCS_Obj_13_FR 8;
BA_ "GenSigSendType" SG_ 1367 ARC_OD_Orientation_Obj_13_FR 8;
BA_ "GenSigSendType" SG_ 1367 ARC_OD_LifeCycle_Obj_13_FR 8;
BA_ "GenSigSendType" SG_ 1367 ARC_OD_ObstacleProb_Obj_12_FR 8;
BA_ "GenSigSendType" SG_ 1367 ARC_OD_ObstacleProb_Obj_13_FR 8;
BA_ "GenSigSendType" SG_ 1367 ARC_OD_VabsY_Obj_12_FR 8;
BA_ "GenSigSendType" SG_ 1367 ARC_OD_ID_12_FR 8;
BA_ "GenSigSendType" SG_ 1367 ARC_OD_ID_13_FR 8;
BA_ "GenSigSendType" SG_ 1367 ARC_OD_MsgCounter_Obj_12_13_FR 8;
BA_ "GenSigSendType" SG_ 1367 ARC_OD_CRC8_Obj_12_13_FR 8;
BA_ "GenSigSendType" SG_ 1367 ARC_OD_AabsY_Obj_12_FR 8;
BA_ "GenSigSendType" SG_ 1367 ARC_OD_DistXStd_Obj_12_FR 8;
BA_ "GenSigSendType" SG_ 1367 ARC_OD_DistYStd_Obj_12_FR 8;
BA_ "GenSigSendType" SG_ 1367 ARC_OD_VabsXStd_Obj_12_FR 8;
BA_ "GenSigSendType" SG_ 1367 ARC_OD_VabsYStd_Obj_12_FR 8;
BA_ "GenSigSendType" SG_ 1367 ARC_OD_AabsXStd_Obj_12_FR 8;
BA_ "GenSigSendType" SG_ 1366 DistHeight_Obj_11_FR 8;
BA_ "GenSigSendType" SG_ 1366 DistHeight_Obj_10_FR 8;
BA_ "GenSigSendType" SG_ 1366 ARC_OD_DistX_Obj_10_FR 8;
BA_ "GenSigSendType" SG_ 1366 ARC_OD_Classification_Obj_10_FR 8;
BA_ "GenSigSendType" SG_ 1366 ARC_OD_AabsYStd_Obj_10_FR 8;
BA_ "GenSigSendType" SG_ 1366 ARC_OD_ClassConf_Obj_10_FR 8;
BA_ "GenSigSendType" SG_ 1366 ARC_OD_ProbOfExist_Obj_10_FR 8;
BA_ "GenSigSendType" SG_ 1366 ARC_OD_VabsX_Obj_10_FR 8;
BA_ "GenSigSendType" SG_ 1366 ARC_OD_DynProp_Obj_10_FR 8;
BA_ "GenSigSendType" SG_ 1366 ARC_OD_Length_Obj_10_FR 8;
BA_ "GenSigSendType" SG_ 1366 ARC_OD_MaintenanceState_Obj_0049 8;
BA_ "GenSigSendType" SG_ 1366 ARC_OD_Width_Obj_10_FR 8;
BA_ "GenSigSendType" SG_ 1366 ARC_OD_RCS_Obj_10_FR 8;
BA_ "GenSigSendType" SG_ 1366 ARC_OD_Orientation_Obj_10_FR 8;
BA_ "GenSigSendType" SG_ 1366 ARC_OD_LifeCycle_Obj_10_FR 8;
BA_ "GenSigSendType" SG_ 1366 ARC_OD_DistX_Obj_11_FR 8;
BA_ "GenSigSendType" SG_ 1366 ARC_OD_VabsX_Obj_11_FR 8;
BA_ "GenSigSendType" SG_ 1366 ARC_OD_AabsX_Obj_11_FR 8;
BA_ "GenSigSendType" SG_ 1366 ARC_OD_AabsX_Obj_10_FR 8;
BA_ "GenSigSendType" SG_ 1366 ARC_OD_DistY_Obj_11_FR 8;
BA_ "GenSigSendType" SG_ 1366 ARC_OD_VabsY_Obj_11_FR 8;
BA_ "GenSigSendType" SG_ 1366 ARC_OD_AabsY_Obj_11_FR 8;
BA_ "GenSigSendType" SG_ 1366 ARC_OD_DistXStd_Obj_11_FR 8;
BA_ "GenSigSendType" SG_ 1366 ARC_OD_DistYStd_Obj_11_FR 8;
BA_ "GenSigSendType" SG_ 1366 ARC_OD_VabsXStd_Obj_11_FR 8;
BA_ "GenSigSendType" SG_ 1366 ARC_OD_VabsYStd_Obj_11_FR 8;
BA_ "GenSigSendType" SG_ 1366 ARC_OD_AabsXStd_Obj_11_FR 8;
BA_ "GenSigSendType" SG_ 1366 ARC_OD_Classification_Obj_11_FR 8;
BA_ "GenSigSendType" SG_ 1366 ARC_OD_AabsYStd_Obj_11_FR 8;
BA_ "GenSigSendType" SG_ 1366 ARC_OD_ClassConf_Obj_11_FR 8;
BA_ "GenSigSendType" SG_ 1366 ARC_OD_DistY_Obj_10_FR 8;
BA_ "GenSigSendType" SG_ 1366 ARC_OD_ProbOfExist_Obj_11_FR 8;
BA_ "GenSigSendType" SG_ 1366 ARC_OD_DynProp_Obj_11_FR 8;
BA_ "GenSigSendType" SG_ 1366 ARC_OD_Length_Obj_11_FR 8;
BA_ "GenSigSendType" SG_ 1366 ARC_OD_MaintenanceState_Obj_0050 8;
BA_ "GenSigSendType" SG_ 1366 ARC_OD_Width_Obj_11_FR 8;
BA_ "GenSigSendType" SG_ 1366 ARC_OD_RCS_Obj_11_FR 8;
BA_ "GenSigSendType" SG_ 1366 ARC_OD_Orientation_Obj_11_FR 8;
BA_ "GenSigSendType" SG_ 1366 ARC_OD_LifeCycle_Obj_11_FR 8;
BA_ "GenSigSendType" SG_ 1366 ARC_OD_ObstacleProb_Obj_10_FR 8;
BA_ "GenSigSendType" SG_ 1366 ARC_OD_ObstacleProb_Obj_11_FR 8;
BA_ "GenSigSendType" SG_ 1366 ARC_OD_VabsY_Obj_10_FR 8;
BA_ "GenSigSendType" SG_ 1366 ARC_OD_ID_10_FR 8;
BA_ "GenSigSendType" SG_ 1366 ARC_OD_ID_11_FR 8;
BA_ "GenSigSendType" SG_ 1366 ARC_OD_MsgCounter_Obj_10_11_FR 8;
BA_ "GenSigSendType" SG_ 1366 ARC_OD_CRC8_Obj_10_11_FR 8;
BA_ "GenSigSendType" SG_ 1366 ARC_OD_AabsY_Obj_10_FR 8;
BA_ "GenSigSendType" SG_ 1366 ARC_OD_DistXStd_Obj_10_FR 8;
BA_ "GenSigSendType" SG_ 1366 ARC_OD_DistYStd_Obj_10_FR 8;
BA_ "GenSigSendType" SG_ 1366 ARC_OD_VabsXStd_Obj_10_FR 8;
BA_ "GenSigSendType" SG_ 1366 ARC_OD_VabsYStd_Obj_10_FR 8;
BA_ "GenSigSendType" SG_ 1366 ARC_OD_AabsXStd_Obj_10_FR 8;
BA_ "GenSigSendType" SG_ 1365 DistHeight_Obj_09_FR 8;
BA_ "GenSigSendType" SG_ 1365 DistHeight_Obj_08_FR 8;
BA_ "GenSigSendType" SG_ 1365 ARC_OD_DistX_Obj_08_FR 8;
BA_ "GenSigSendType" SG_ 1365 ARC_OD_Classification_Obj_08_FR 8;
BA_ "GenSigSendType" SG_ 1365 ARC_OD_AabsYStd_Obj_08_FR 8;
BA_ "GenSigSendType" SG_ 1365 ARC_OD_ClassConf_Obj_08_FR 8;
BA_ "GenSigSendType" SG_ 1365 ARC_OD_ProbOfExist_Obj_08_FR 8;
BA_ "GenSigSendType" SG_ 1365 ARC_OD_VabsX_Obj_08_FR 8;
BA_ "GenSigSendType" SG_ 1365 ARC_OD_DynProp_Obj_08_FR 8;
BA_ "GenSigSendType" SG_ 1365 ARC_OD_Length_Obj_08_FR 8;
BA_ "GenSigSendType" SG_ 1365 ARC_OD_MaintenanceState_Obj_0051 8;
BA_ "GenSigSendType" SG_ 1365 ARC_OD_Width_Obj_08_FR 8;
BA_ "GenSigSendType" SG_ 1365 ARC_OD_RCS_Obj_08_FR 8;
BA_ "GenSigSendType" SG_ 1365 ARC_OD_Orientation_Obj_08_FR 8;
BA_ "GenSigSendType" SG_ 1365 ARC_OD_LifeCycle_Obj_08_FR 8;
BA_ "GenSigSendType" SG_ 1365 ARC_OD_DistX_Obj_09_FR 8;
BA_ "GenSigSendType" SG_ 1365 ARC_OD_VabsX_Obj_09_FR 8;
BA_ "GenSigSendType" SG_ 1365 ARC_OD_AabsX_Obj_09_FR 8;
BA_ "GenSigSendType" SG_ 1365 ARC_OD_AabsX_Obj_08_FR 8;
BA_ "GenSigSendType" SG_ 1365 ARC_OD_DistY_Obj_09_FR 8;
BA_ "GenSigSendType" SG_ 1365 ARC_OD_VabsY_Obj_09_FR 8;
BA_ "GenSigSendType" SG_ 1365 ARC_OD_AabsY_Obj_09_FR 8;
BA_ "GenSigSendType" SG_ 1365 ARC_OD_DistXStd_Obj_09_FR 8;
BA_ "GenSigSendType" SG_ 1365 ARC_OD_DistYStd_Obj_09_FR 8;
BA_ "GenSigSendType" SG_ 1365 ARC_OD_VabsXStd_Obj_09_FR 8;
BA_ "GenSigSendType" SG_ 1365 ARC_OD_VabsYStd_Obj_09_FR 8;
BA_ "GenSigSendType" SG_ 1365 ARC_OD_AabsXStd_Obj_09_FR 8;
BA_ "GenSigSendType" SG_ 1365 ARC_OD_Classification_Obj_09_FR 8;
BA_ "GenSigSendType" SG_ 1365 ARC_OD_AabsYStd_Obj_09_FR 8;
BA_ "GenSigSendType" SG_ 1365 ARC_OD_ClassConf_Obj_09_FR 8;
BA_ "GenSigSendType" SG_ 1365 ARC_OD_DistY_Obj_08_FR 8;
BA_ "GenSigSendType" SG_ 1365 ARC_OD_ProbOfExist_Obj_09_FR 8;
BA_ "GenSigSendType" SG_ 1365 ARC_OD_DynProp_Obj_09_FR 8;
BA_ "GenSigSendType" SG_ 1365 ARC_OD_Length_Obj_09_FR 8;
BA_ "GenSigSendType" SG_ 1365 ARC_OD_MaintenanceState_Obj_0052 8;
BA_ "GenSigSendType" SG_ 1365 ARC_OD_Width_Obj_09_FR 8;
BA_ "GenSigSendType" SG_ 1365 ARC_OD_RCS_Obj_09_FR 8;
BA_ "GenSigSendType" SG_ 1365 ARC_OD_Orientation_Obj_09_FR 8;
BA_ "GenSigSendType" SG_ 1365 ARC_OD_LifeCycle_Obj_09_FR 8;
BA_ "GenSigSendType" SG_ 1365 ARC_OD_ObstacleProb_Obj_08_FR 8;
BA_ "GenSigSendType" SG_ 1365 ARC_OD_ObstacleProb_Obj_09_FR 8;
BA_ "GenSigSendType" SG_ 1365 ARC_OD_VabsY_Obj_08_FR 8;
BA_ "GenSigSendType" SG_ 1365 ARC_OD_ID_08_FR 8;
BA_ "GenSigSendType" SG_ 1365 ARC_OD_ID_09_FR 8;
BA_ "GenSigSendType" SG_ 1365 ARC_OD_MsgCounter_Obj_08_09_FR 8;
BA_ "GenSigSendType" SG_ 1365 ARC_OD_CRC8_Obj_08_09_FR 8;
BA_ "GenSigSendType" SG_ 1365 ARC_OD_AabsY_Obj_08_FR 8;
BA_ "GenSigSendType" SG_ 1365 ARC_OD_DistXStd_Obj_08_FR 8;
BA_ "GenSigSendType" SG_ 1365 ARC_OD_DistYStd_Obj_08_FR 8;
BA_ "GenSigSendType" SG_ 1365 ARC_OD_VabsXStd_Obj_08_FR 8;
BA_ "GenSigSendType" SG_ 1365 ARC_OD_VabsYStd_Obj_08_FR 8;
BA_ "GenSigSendType" SG_ 1365 ARC_OD_AabsXStd_Obj_08_FR 8;
BA_ "GenSigSendType" SG_ 1364 DistHeight_Obj_07_FR 8;
BA_ "GenSigSendType" SG_ 1364 DistHeight_Obj_06_FR 8;
BA_ "GenSigSendType" SG_ 1364 ARC_OD_DistX_Obj_06_FR 8;
BA_ "GenSigSendType" SG_ 1364 ARC_OD_Classification_Obj_06_FR 8;
BA_ "GenSigSendType" SG_ 1364 ARC_OD_AabsYStd_Obj_06_FR 8;
BA_ "GenSigSendType" SG_ 1364 ARC_OD_ClassConf_Obj_06_FR 8;
BA_ "GenSigSendType" SG_ 1364 ARC_OD_ProbOfExist_Obj_06_FR 8;
BA_ "GenSigSendType" SG_ 1364 ARC_OD_VabsX_Obj_06_FR 8;
BA_ "GenSigSendType" SG_ 1364 ARC_OD_DynProp_Obj_06_FR 8;
BA_ "GenSigSendType" SG_ 1364 ARC_OD_Length_Obj_06_FR 8;
BA_ "GenSigSendType" SG_ 1364 ARC_OD_MaintenanceState_Obj_0053 8;
BA_ "GenSigSendType" SG_ 1364 ARC_OD_Width_Obj_06_FR 8;
BA_ "GenSigSendType" SG_ 1364 ARC_OD_RCS_Obj_06_FR 8;
BA_ "GenSigSendType" SG_ 1364 ARC_OD_Orientation_Obj_06_FR 8;
BA_ "GenSigSendType" SG_ 1364 ARC_OD_LifeCycle_Obj_06_FR 8;
BA_ "GenSigSendType" SG_ 1364 ARC_OD_DistX_Obj_07_FR 8;
BA_ "GenSigSendType" SG_ 1364 ARC_OD_VabsX_Obj_07_FR 8;
BA_ "GenSigSendType" SG_ 1364 ARC_OD_AabsX_Obj_07_FR 8;
BA_ "GenSigSendType" SG_ 1364 ARC_OD_AabsX_Obj_06_FR 8;
BA_ "GenSigSendType" SG_ 1364 ARC_OD_DistY_Obj_07_FR 8;
BA_ "GenSigSendType" SG_ 1364 ARC_OD_VabsY_Obj_07_FR 8;
BA_ "GenSigSendType" SG_ 1364 ARC_OD_AabsY_Obj_07_FR 8;
BA_ "GenSigSendType" SG_ 1364 ARC_OD_DistXStd_Obj_07_FR 8;
BA_ "GenSigSendType" SG_ 1364 ARC_OD_DistYStd_Obj_07_FR 8;
BA_ "GenSigSendType" SG_ 1364 ARC_OD_VabsXStd_Obj_07_FR 8;
BA_ "GenSigSendType" SG_ 1364 ARC_OD_VabsYStd_Obj_07_FR 8;
BA_ "GenSigSendType" SG_ 1364 ARC_OD_AabsXStd_Obj_07_FR 8;
BA_ "GenSigSendType" SG_ 1364 ARC_OD_Classification_Obj_07_FR 8;
BA_ "GenSigSendType" SG_ 1364 ARC_OD_AabsYStd_Obj_07_FR 8;
BA_ "GenSigSendType" SG_ 1364 ARC_OD_ClassConf_Obj_07_FR 8;
BA_ "GenSigSendType" SG_ 1364 ARC_OD_DistY_Obj_06_FR 8;
BA_ "GenSigSendType" SG_ 1364 ARC_OD_ProbOfExist_Obj_07_FR 8;
BA_ "GenSigSendType" SG_ 1364 ARC_OD_DynProp_Obj_07_FR 8;
BA_ "GenSigSendType" SG_ 1364 ARC_OD_Length_Obj_07_FR 8;
BA_ "GenSigSendType" SG_ 1364 ARC_OD_MaintenanceState_Obj_0054 8;
BA_ "GenSigSendType" SG_ 1364 ARC_OD_Width_Obj_07_FR 8;
BA_ "GenSigSendType" SG_ 1364 ARC_OD_RCS_Obj_07_FR 8;
BA_ "GenSigSendType" SG_ 1364 ARC_OD_Orientation_Obj_07_FR 8;
BA_ "GenSigSendType" SG_ 1364 ARC_OD_LifeCycle_Obj_07_FR 8;
BA_ "GenSigSendType" SG_ 1364 ARC_OD_ObstacleProb_Obj_06_FR 8;
BA_ "GenSigSendType" SG_ 1364 ARC_OD_ObstacleProb_Obj_07_FR 8;
BA_ "GenSigSendType" SG_ 1364 ARC_OD_VabsY_Obj_06_FR 8;
BA_ "GenSigSendType" SG_ 1364 ARC_OD_ID_06_FR 8;
BA_ "GenSigSendType" SG_ 1364 ARC_OD_ID_07_FR 8;
BA_ "GenSigSendType" SG_ 1364 ARC_OD_MsgCounter_Obj_06_07_FR 8;
BA_ "GenSigSendType" SG_ 1364 ARC_OD_CRC8_Obj_06_07_FR 8;
BA_ "GenSigSendType" SG_ 1364 ARC_OD_AabsY_Obj_06_FR 8;
BA_ "GenSigSendType" SG_ 1364 ARC_OD_DistXStd_Obj_06_FR 8;
BA_ "GenSigSendType" SG_ 1364 ARC_OD_DistYStd_Obj_06_FR 8;
BA_ "GenSigSendType" SG_ 1364 ARC_OD_VabsXStd_Obj_06_FR 8;
BA_ "GenSigSendType" SG_ 1364 ARC_OD_VabsYStd_Obj_06_FR 8;
BA_ "GenSigSendType" SG_ 1364 ARC_OD_AabsXStd_Obj_06_FR 8;
BA_ "GenSigSendType" SG_ 1363 DistHeight_Obj_05_FR 8;
BA_ "GenSigSendType" SG_ 1363 DistHeight_Obj_04_FR 8;
BA_ "GenSigSendType" SG_ 1363 ARC_OD_DistX_Obj_04_FR 8;
BA_ "GenSigSendType" SG_ 1363 ARC_OD_Classification_Obj_04_FR 8;
BA_ "GenSigSendType" SG_ 1363 ARC_OD_AabsYStd_Obj_04_FR 8;
BA_ "GenSigSendType" SG_ 1363 ARC_OD_ClassConf_Obj_04_FR 8;
BA_ "GenSigSendType" SG_ 1363 ARC_OD_ProbOfExist_Obj_04_FR 8;
BA_ "GenSigSendType" SG_ 1363 ARC_OD_VabsX_Obj_04_FR 8;
BA_ "GenSigSendType" SG_ 1363 ARC_OD_DynProp_Obj_04_FR 8;
BA_ "GenSigSendType" SG_ 1363 ARC_OD_Length_Obj_04_FR 8;
BA_ "GenSigSendType" SG_ 1363 ARC_OD_MaintenanceState_Obj_0055 8;
BA_ "GenSigSendType" SG_ 1363 ARC_OD_Width_Obj_04_FR 8;
BA_ "GenSigSendType" SG_ 1363 ARC_OD_RCS_Obj_04_FR 8;
BA_ "GenSigSendType" SG_ 1363 ARC_OD_Orientation_Obj_04_FR 8;
BA_ "GenSigSendType" SG_ 1363 ARC_OD_LifeCycle_Obj_04_FR 8;
BA_ "GenSigSendType" SG_ 1363 ARC_OD_DistX_Obj_05_FR 8;
BA_ "GenSigSendType" SG_ 1363 ARC_OD_VabsX_Obj_05_FR 8;
BA_ "GenSigSendType" SG_ 1363 ARC_OD_AabsX_Obj_05_FR 8;
BA_ "GenSigSendType" SG_ 1363 ARC_OD_AabsX_Obj_04_FR 8;
BA_ "GenSigSendType" SG_ 1363 ARC_OD_DistY_Obj_05_FR 8;
BA_ "GenSigSendType" SG_ 1363 ARC_OD_VabsY_Obj_05_FR 8;
BA_ "GenSigSendType" SG_ 1363 ARC_OD_AabsY_Obj_05_FR 8;
BA_ "GenSigSendType" SG_ 1363 ARC_OD_DistXStd_Obj_05_FR 8;
BA_ "GenSigSendType" SG_ 1363 ARC_OD_DistYStd_Obj_05_FR 8;
BA_ "GenSigSendType" SG_ 1363 ARC_OD_VabsXStd_Obj_05_FR 8;
BA_ "GenSigSendType" SG_ 1363 ARC_OD_VabsYStd_Obj_05_FR 8;
BA_ "GenSigSendType" SG_ 1363 ARC_OD_AabsXStd_Obj_05_FR 8;
BA_ "GenSigSendType" SG_ 1363 ARC_OD_Classification_Obj_05_FR 8;
BA_ "GenSigSendType" SG_ 1363 ARC_OD_AabsYStd_Obj_05_FR 8;
BA_ "GenSigSendType" SG_ 1363 ARC_OD_ClassConf_Obj_05_FR 8;
BA_ "GenSigSendType" SG_ 1363 ARC_OD_DistY_Obj_04_FR 8;
BA_ "GenSigSendType" SG_ 1363 ARC_OD_ProbOfExist_Obj_05_FR 8;
BA_ "GenSigSendType" SG_ 1363 ARC_OD_DynProp_Obj_05_FR 8;
BA_ "GenSigSendType" SG_ 1363 ARC_OD_Length_Obj_05_FR 8;
BA_ "GenSigSendType" SG_ 1363 ARC_OD_MaintenanceState_Obj_0056 8;
BA_ "GenSigSendType" SG_ 1363 ARC_OD_Width_Obj_05_FR 8;
BA_ "GenSigSendType" SG_ 1363 ARC_OD_RCS_Obj_05_FR 8;
BA_ "GenSigSendType" SG_ 1363 ARC_OD_Orientation_Obj_05_FR 8;
BA_ "GenSigSendType" SG_ 1363 ARC_OD_LifeCycle_Obj_05_FR 8;
BA_ "GenSigSendType" SG_ 1363 ARC_OD_ObstacleProb_Obj_04_FR 8;
BA_ "GenSigSendType" SG_ 1363 ARC_OD_ObstacleProb_Obj_05_FR 8;
BA_ "GenSigSendType" SG_ 1363 ARC_OD_VabsY_Obj_04_FR 8;
BA_ "GenSigSendType" SG_ 1363 ARC_OD_ID_04_FR 8;
BA_ "GenSigSendType" SG_ 1363 ARC_OD_ID_05_FR 8;
BA_ "GenSigSendType" SG_ 1363 ARC_OD_MsgCounter_Obj_04_05_FR 8;
BA_ "GenSigSendType" SG_ 1363 ARC_OD_CRC8_Obj_04_05_FR 8;
BA_ "GenSigSendType" SG_ 1363 ARC_OD_AabsY_Obj_04_FR 8;
BA_ "GenSigSendType" SG_ 1363 ARC_OD_DistXStd_Obj_04_FR 8;
BA_ "GenSigSendType" SG_ 1363 ARC_OD_DistYStd_Obj_04_FR 8;
BA_ "GenSigSendType" SG_ 1363 ARC_OD_VabsXStd_Obj_04_FR 8;
BA_ "GenSigSendType" SG_ 1363 ARC_OD_VabsYStd_Obj_04_FR 8;
BA_ "GenSigSendType" SG_ 1363 ARC_OD_AabsXStd_Obj_04_FR 8;
BA_ "GenSigSendType" SG_ 1362 DistHeight_Obj_03_FR 8;
BA_ "GenSigSendType" SG_ 1362 DistHeight_Obj_02_FR 8;
BA_ "GenSigSendType" SG_ 1362 ARC_OD_DistX_Obj_02_FR 8;
BA_ "GenSigSendType" SG_ 1362 ARC_OD_Classification_Obj_02_FR 8;
BA_ "GenSigSendType" SG_ 1362 ARC_OD_AabsYStd_Obj_02_FR 8;
BA_ "GenSigSendType" SG_ 1362 ARC_OD_ClassConf_Obj_02_FR 8;
BA_ "GenSigSendType" SG_ 1362 ARC_OD_ProbOfExist_Obj_02_FR 8;
BA_ "GenSigSendType" SG_ 1362 ARC_OD_VabsX_Obj_02_FR 8;
BA_ "GenSigSendType" SG_ 1362 ARC_OD_DynProp_Obj_02_FR 8;
BA_ "GenSigSendType" SG_ 1362 ARC_OD_Length_Obj_02_FR 8;
BA_ "GenSigSendType" SG_ 1362 ARC_OD_MaintenanceState_Obj_0057 8;
BA_ "GenSigSendType" SG_ 1362 ARC_OD_Width_Obj_02_FR 8;
BA_ "GenSigSendType" SG_ 1362 ARC_OD_RCS_Obj_02_FR 8;
BA_ "GenSigSendType" SG_ 1362 ARC_OD_Orientation_Obj_02_FR 8;
BA_ "GenSigSendType" SG_ 1362 ARC_OD_LifeCycle_Obj_02_FR 8;
BA_ "GenSigSendType" SG_ 1362 ARC_OD_DistX_Obj_03_FR 8;
BA_ "GenSigSendType" SG_ 1362 ARC_OD_VabsX_Obj_03_FR 8;
BA_ "GenSigSendType" SG_ 1362 ARC_OD_AabsX_Obj_03_FR 8;
BA_ "GenSigSendType" SG_ 1362 ARC_OD_AabsX_Obj_02_FR 8;
BA_ "GenSigSendType" SG_ 1362 ARC_OD_DistY_Obj_03_FR 8;
BA_ "GenSigSendType" SG_ 1362 ARC_OD_VabsY_Obj_03_FR 8;
BA_ "GenSigSendType" SG_ 1362 ARC_OD_AabsY_Obj_03_FR 8;
BA_ "GenSigSendType" SG_ 1362 ARC_OD_DistXStd_Obj_03_FR 8;
BA_ "GenSigSendType" SG_ 1362 ARC_OD_DistYStd_Obj_03_FR 8;
BA_ "GenSigSendType" SG_ 1362 ARC_OD_VabsXStd_Obj_03_FR 8;
BA_ "GenSigSendType" SG_ 1362 ARC_OD_VabsYStd_Obj_03_FR 8;
BA_ "GenSigSendType" SG_ 1362 ARC_OD_AabsXStd_Obj_03_FR 8;
BA_ "GenSigSendType" SG_ 1362 ARC_OD_Classification_Obj_03_FR 8;
BA_ "GenSigSendType" SG_ 1362 ARC_OD_AabsYStd_Obj_03_FR 8;
BA_ "GenSigSendType" SG_ 1362 ARC_OD_ClassConf_Obj_03_FR 8;
BA_ "GenSigSendType" SG_ 1362 ARC_OD_DistY_Obj_02_FR 8;
BA_ "GenSigSendType" SG_ 1362 ARC_OD_ProbOfExist_Obj_03_FR 8;
BA_ "GenSigSendType" SG_ 1362 ARC_OD_DynProp_Obj_03_FR 8;
BA_ "GenSigSendType" SG_ 1362 ARC_OD_Length_Obj_03_FR 8;
BA_ "GenSigSendType" SG_ 1362 ARC_OD_MaintenanceState_Obj_0058 8;
BA_ "GenSigSendType" SG_ 1362 ARC_OD_Width_Obj_03_FR 8;
BA_ "GenSigSendType" SG_ 1362 ARC_OD_RCS_Obj_03_FR 8;
BA_ "GenSigSendType" SG_ 1362 ARC_OD_Orientation_Obj_03_FR 8;
BA_ "GenSigSendType" SG_ 1362 ARC_OD_LifeCycle_Obj_03_FR 8;
BA_ "GenSigSendType" SG_ 1362 ARC_OD_ObstacleProb_Obj_02_FR 8;
BA_ "GenSigSendType" SG_ 1362 ARC_OD_ObstacleProb_Obj_03_FR 8;
BA_ "GenSigSendType" SG_ 1362 ARC_OD_VabsY_Obj_02_FR 8;
BA_ "GenSigSendType" SG_ 1362 ARC_OD_ID_02_FR 8;
BA_ "GenSigSendType" SG_ 1362 ARC_OD_ID_03_FR 8;
BA_ "GenSigSendType" SG_ 1362 ARC_OD_MsgCounter_Obj_02_03_FR 8;
BA_ "GenSigSendType" SG_ 1362 ARC_OD_CRC8_Obj_02_03_FR 8;
BA_ "GenSigSendType" SG_ 1362 ARC_OD_AabsY_Obj_02_FR 8;
BA_ "GenSigSendType" SG_ 1362 ARC_OD_DistXStd_Obj_02_FR 8;
BA_ "GenSigSendType" SG_ 1362 ARC_OD_DistYStd_Obj_02_FR 8;
BA_ "GenSigSendType" SG_ 1362 ARC_OD_VabsXStd_Obj_02_FR 8;
BA_ "GenSigSendType" SG_ 1362 ARC_OD_VabsYStd_Obj_02_FR 8;
BA_ "GenSigSendType" SG_ 1362 ARC_OD_AabsXStd_Obj_02_FR 8;
BA_ "GenSigSendType" SG_ 1361 DistHeight_Obj_01_FR 8;
BA_ "GenSigSendType" SG_ 1361 DistHeight_Obj_00_FR 8;
BA_ "GenSigSendType" SG_ 1361 ARC_OD_DistX_Obj_00_FR 8;
BA_ "GenSigSendType" SG_ 1361 ARC_OD_Classification_Obj_00_FR 8;
BA_ "GenSigSendType" SG_ 1361 ARC_OD_AabsYStd_Obj_00_FR 8;
BA_ "GenSigSendType" SG_ 1361 ARC_OD_ClassConf_Obj_00_FR 8;
BA_ "GenSigSendType" SG_ 1361 ARC_OD_ProbOfExist_Obj_00_FR 8;
BA_ "GenSigSendType" SG_ 1361 ARC_OD_VabsX_Obj_00_FR 8;
BA_ "GenSigSendType" SG_ 1361 ARC_OD_DynProp_Obj_00_FR 8;
BA_ "GenSigSendType" SG_ 1361 ARC_OD_Length_Obj_00_FR 8;
BA_ "GenSigSendType" SG_ 1361 ARC_OD_MaintenanceState_Obj_0059 8;
BA_ "GenSigSendType" SG_ 1361 ARC_OD_Width_Obj_00_FR 8;
BA_ "GenSigSendType" SG_ 1361 ARC_OD_RCS_Obj_00_FR 8;
BA_ "GenSigSendType" SG_ 1361 ARC_OD_Orientation_Obj_00_FR 8;
BA_ "GenSigSendType" SG_ 1361 ARC_OD_LifeCycle_Obj_00_FR 8;
BA_ "GenSigSendType" SG_ 1361 ARC_OD_DistX_Obj_01_FR 8;
BA_ "GenSigSendType" SG_ 1361 ARC_OD_VabsX_Obj_01_FR 8;
BA_ "GenSigSendType" SG_ 1361 ARC_OD_AabsX_Obj_01_FR 8;
BA_ "GenSigSendType" SG_ 1361 ARC_OD_AabsX_Obj_00_FR 8;
BA_ "GenSigSendType" SG_ 1361 ARC_OD_DistY_Obj_01_FR 8;
BA_ "GenSigSendType" SG_ 1361 ARC_OD_VabsY_Obj_01_FR 8;
BA_ "GenSigSendType" SG_ 1361 ARC_OD_AabsY_Obj_01_FR 8;
BA_ "GenSigSendType" SG_ 1361 ARC_OD_DistXStd_Obj_01_FR 8;
BA_ "GenSigSendType" SG_ 1361 ARC_OD_DistYStd_Obj_01_FR 8;
BA_ "GenSigSendType" SG_ 1361 ARC_OD_VabsXStd_Obj_01_FR 8;
BA_ "GenSigSendType" SG_ 1361 ARC_OD_VabsYStd_Obj_01_FR 8;
BA_ "GenSigSendType" SG_ 1361 ARC_OD_AabsXStd_Obj_01_FR 8;
BA_ "GenSigSendType" SG_ 1361 ARC_OD_Classification_Obj_01_FR 8;
BA_ "GenSigSendType" SG_ 1361 ARC_OD_AabsYStd_Obj_01_FR 8;
BA_ "GenSigSendType" SG_ 1361 ARC_OD_ClassConf_Obj_01_FR 8;
BA_ "GenSigSendType" SG_ 1361 ARC_OD_DistY_Obj_00_FR 8;
BA_ "GenSigSendType" SG_ 1361 ARC_OD_ProbOfExist_Obj_01_FR 8;
BA_ "GenSigSendType" SG_ 1361 ARC_OD_DynProp_Obj_01_FR 8;
BA_ "GenSigSendType" SG_ 1361 ARC_OD_Length_Obj_01_FR 8;
BA_ "GenSigSendType" SG_ 1361 ARC_OD_MaintenanceState_Obj_0060 8;
BA_ "GenSigSendType" SG_ 1361 ARC_OD_Width_Obj_01_FR 8;
BA_ "GenSigSendType" SG_ 1361 ARC_OD_RCS_Obj_01_FR 8;
BA_ "GenSigSendType" SG_ 1361 ARC_OD_Orientation_Obj_01_FR 8;
BA_ "GenSigSendType" SG_ 1361 ARC_OD_LifeCycle_Obj_01_FR 8;
BA_ "GenSigSendType" SG_ 1361 ARC_OD_ObstacleProb_Obj_00_FR 8;
BA_ "GenSigSendType" SG_ 1361 ARC_OD_ObstacleProb_Obj_01_FR 8;
BA_ "GenSigSendType" SG_ 1361 ARC_OD_VabsY_Obj_00_FR 8;
BA_ "GenSigSendType" SG_ 1361 ARC_OD_ID_00_FR 8;
BA_ "GenSigSendType" SG_ 1361 ARC_OD_ID_01_FR 8;
BA_ "GenSigSendType" SG_ 1361 ARC_OD_MsgCounter_Obj_00_01_FR 8;
BA_ "GenSigSendType" SG_ 1361 ARC_OD_CRC8_Obj_00_01_FR 8;
BA_ "GenSigSendType" SG_ 1361 ARC_OD_AabsY_Obj_00_FR 8;
BA_ "GenSigSendType" SG_ 1361 ARC_OD_DistXStd_Obj_00_FR 8;
BA_ "GenSigSendType" SG_ 1361 ARC_OD_DistYStd_Obj_00_FR 8;
BA_ "GenSigSendType" SG_ 1361 ARC_OD_VabsXStd_Obj_00_FR 8;
BA_ "GenSigSendType" SG_ 1361 ARC_OD_VabsYStd_Obj_00_FR 8;
BA_ "GenSigSendType" SG_ 1361 ARC_OD_AabsXStd_Obj_00_FR 8;
BA_ "GenSigSendType" SG_ 1134 DistHeight_Obj_59_RR 8;
BA_ "GenSigSendType" SG_ 1134 DistHeight_Obj_58_RR 8;
BA_ "GenSigSendType" SG_ 1134 ARC_OD_DistX_Obj_58_RR 8;
BA_ "GenSigSendType" SG_ 1134 ARC_OD_Classification_Obj_58_RR 8;
BA_ "GenSigSendType" SG_ 1134 ARC_OD_AabsYStd_Obj_58_RR 8;
BA_ "GenSigSendType" SG_ 1134 ARC_OD_ClassConf_Obj_58_RR 8;
BA_ "GenSigSendType" SG_ 1134 ARC_OD_ProbOfExist_Obj_58_RR 8;
BA_ "GenSigSendType" SG_ 1134 ARC_OD_VabsX_Obj_58_RR 8;
BA_ "GenSigSendType" SG_ 1134 ARC_OD_DynProp_Obj_58_RR 8;
BA_ "GenSigSendType" SG_ 1134 ARC_OD_Length_Obj_58_RR 8;
BA_ "GenSigSendType" SG_ 1134 ARC_OD_MaintenanceState_Obj_58_R 8;
BA_ "GenSigSendType" SG_ 1134 ARC_OD_Width_Obj_58_RR 8;
BA_ "GenSigSendType" SG_ 1134 ARC_OD_RCS_Obj_58_RR 8;
BA_ "GenSigSendType" SG_ 1134 ARC_OD_Orientation_Obj_58_RR 8;
BA_ "GenSigSendType" SG_ 1134 ARC_OD_LifeCycle_Obj_58_RR 8;
BA_ "GenSigSendType" SG_ 1134 ARC_OD_DistX_Obj_59_RR 8;
BA_ "GenSigSendType" SG_ 1134 ARC_OD_VabsX_Obj_59_RR 8;
BA_ "GenSigSendType" SG_ 1134 ARC_OD_AabsX_Obj_59_RR 8;
BA_ "GenSigSendType" SG_ 1134 ARC_OD_AabsX_Obj_58_RR 8;
BA_ "GenSigSendType" SG_ 1134 ARC_OD_DistY_Obj_59_RR 8;
BA_ "GenSigSendType" SG_ 1134 ARC_OD_VabsY_Obj_59_RR 8;
BA_ "GenSigSendType" SG_ 1134 ARC_OD_AabsY_Obj_59_RR 8;
BA_ "GenSigSendType" SG_ 1134 ARC_OD_DistXStd_Obj_59_RR 8;
BA_ "GenSigSendType" SG_ 1134 ARC_OD_DistYStd_Obj_59_RR 8;
BA_ "GenSigSendType" SG_ 1134 ARC_OD_VabsXStd_Obj_59_RR 8;
BA_ "GenSigSendType" SG_ 1134 ARC_OD_VabsYStd_Obj_59_RR 8;
BA_ "GenSigSendType" SG_ 1134 ARC_OD_AabsXStd_Obj_59_RR 8;
BA_ "GenSigSendType" SG_ 1134 ARC_OD_Classification_Obj_59_RR 8;
BA_ "GenSigSendType" SG_ 1134 ARC_OD_AabsYStd_Obj_59_RR 8;
BA_ "GenSigSendType" SG_ 1134 ARC_OD_ClassConf_Obj_59_RR 8;
BA_ "GenSigSendType" SG_ 1134 ARC_OD_DistY_Obj_58_RR 8;
BA_ "GenSigSendType" SG_ 1134 ARC_OD_ProbOfExist_Obj_59_RR 8;
BA_ "GenSigSendType" SG_ 1134 ARC_OD_DynProp_Obj_59_RR 8;
BA_ "GenSigSendType" SG_ 1134 ARC_OD_Length_Obj_59_RR 8;
BA_ "GenSigSendType" SG_ 1134 ARC_OD_MaintenanceState_Obj_59_R 8;
BA_ "GenSigSendType" SG_ 1134 ARC_OD_Width_Obj_59_RR 8;
BA_ "GenSigSendType" SG_ 1134 ARC_OD_RCS_Obj_59_RR 8;
BA_ "GenSigSendType" SG_ 1134 ARC_OD_Orientation_Obj_59_RR 8;
BA_ "GenSigSendType" SG_ 1134 ARC_OD_LifeCycle_Obj_59_RR 8;
BA_ "GenSigSendType" SG_ 1134 ARC_OD_ObstacleProb_Obj_58_RR 8;
BA_ "GenSigSendType" SG_ 1134 ARC_OD_ObstacleProb_Obj_59_RR 8;
BA_ "GenSigSendType" SG_ 1134 ARC_OD_VabsY_Obj_58_RR 8;
BA_ "GenSigSendType" SG_ 1134 ARC_OD_ID_58_RR 8;
BA_ "GenSigSendType" SG_ 1134 ARC_OD_ID_59_RR 8;
BA_ "GenSigSendType" SG_ 1134 ARC_OD_MsgCounter_Obj_58_59_RR 8;
BA_ "GenSigSendType" SG_ 1134 ARC_OD_CRC8_Obj_58_59_RR 8;
BA_ "GenSigSendType" SG_ 1134 ARC_OD_AabsY_Obj_58_RR 8;
BA_ "GenSigSendType" SG_ 1134 ARC_OD_DistXStd_Obj_58_RR 8;
BA_ "GenSigSendType" SG_ 1134 ARC_OD_DistYStd_Obj_58_RR 8;
BA_ "GenSigSendType" SG_ 1134 ARC_OD_VabsXStd_Obj_58_RR 8;
BA_ "GenSigSendType" SG_ 1134 ARC_OD_VabsYStd_Obj_58_RR 8;
BA_ "GenSigSendType" SG_ 1134 ARC_OD_AabsXStd_Obj_58_RR 8;
BA_ "GenSigSendType" SG_ 1133 DistHeight_Obj_57_RR 8;
BA_ "GenSigSendType" SG_ 1133 DistHeight_Obj_56_RR 8;
BA_ "GenSigSendType" SG_ 1133 ARC_OD_DistX_Obj_56_RR 8;
BA_ "GenSigSendType" SG_ 1133 ARC_OD_Classification_Obj_56_RR 8;
BA_ "GenSigSendType" SG_ 1133 ARC_OD_AabsYStd_Obj_56_RR 8;
BA_ "GenSigSendType" SG_ 1133 ARC_OD_ClassConf_Obj_56_RR 8;
BA_ "GenSigSendType" SG_ 1133 ARC_OD_ProbOfExist_Obj_56_RR 8;
BA_ "GenSigSendType" SG_ 1133 ARC_OD_VabsX_Obj_56_RR 8;
BA_ "GenSigSendType" SG_ 1133 ARC_OD_DynProp_Obj_56_RR 8;
BA_ "GenSigSendType" SG_ 1133 ARC_OD_Length_Obj_56_RR 8;
BA_ "GenSigSendType" SG_ 1133 ARC_OD_MaintenanceState_Obj_56_R 8;
BA_ "GenSigSendType" SG_ 1133 ARC_OD_Width_Obj_56_RR 8;
BA_ "GenSigSendType" SG_ 1133 ARC_OD_RCS_Obj_56_RR 8;
BA_ "GenSigSendType" SG_ 1133 ARC_OD_Orientation_Obj_56_RR 8;
BA_ "GenSigSendType" SG_ 1133 ARC_OD_LifeCycle_Obj_56_RR 8;
BA_ "GenSigSendType" SG_ 1133 ARC_OD_DistX_Obj_57_RR 8;
BA_ "GenSigSendType" SG_ 1133 ARC_OD_VabsX_Obj_57_RR 8;
BA_ "GenSigSendType" SG_ 1133 ARC_OD_AabsX_Obj_57_RR 8;
BA_ "GenSigSendType" SG_ 1133 ARC_OD_AabsX_Obj_56_RR 8;
BA_ "GenSigSendType" SG_ 1133 ARC_OD_DistY_Obj_57_RR 8;
BA_ "GenSigSendType" SG_ 1133 ARC_OD_VabsY_Obj_57_RR 8;
BA_ "GenSigSendType" SG_ 1133 ARC_OD_AabsY_Obj_57_RR 8;
BA_ "GenSigSendType" SG_ 1133 ARC_OD_DistXStd_Obj_57_RR 8;
BA_ "GenSigSendType" SG_ 1133 ARC_OD_DistYStd_Obj_57_RR 8;
BA_ "GenSigSendType" SG_ 1133 ARC_OD_VabsXStd_Obj_57_RR 8;
BA_ "GenSigSendType" SG_ 1133 ARC_OD_VabsYStd_Obj_57_RR 8;
BA_ "GenSigSendType" SG_ 1133 ARC_OD_AabsXStd_Obj_57_RR 8;
BA_ "GenSigSendType" SG_ 1133 ARC_OD_Classification_Obj_57_RR 8;
BA_ "GenSigSendType" SG_ 1133 ARC_OD_AabsYStd_Obj_57_RR 8;
BA_ "GenSigSendType" SG_ 1133 ARC_OD_ClassConf_Obj_57_RR 8;
BA_ "GenSigSendType" SG_ 1133 ARC_OD_DistY_Obj_56_RR 8;
BA_ "GenSigSendType" SG_ 1133 ARC_OD_ProbOfExist_Obj_57_RR 8;
BA_ "GenSigSendType" SG_ 1133 ARC_OD_DynProp_Obj_57_RR 8;
BA_ "GenSigSendType" SG_ 1133 ARC_OD_Length_Obj_57_RR 8;
BA_ "GenSigSendType" SG_ 1133 ARC_OD_MaintenanceState_Obj_57_R 8;
BA_ "GenSigSendType" SG_ 1133 ARC_OD_Width_Obj_57_RR 8;
BA_ "GenSigSendType" SG_ 1133 ARC_OD_RCS_Obj_57_RR 8;
BA_ "GenSigSendType" SG_ 1133 ARC_OD_Orientation_Obj_57_RR 8;
BA_ "GenSigSendType" SG_ 1133 ARC_OD_LifeCycle_Obj_57_RR 8;
BA_ "GenSigSendType" SG_ 1133 ARC_OD_ObstacleProb_Obj_56_RR 8;
BA_ "GenSigSendType" SG_ 1133 ARC_OD_ObstacleProb_Obj_57_RR 8;
BA_ "GenSigSendType" SG_ 1133 ARC_OD_VabsY_Obj_56_RR 8;
BA_ "GenSigSendType" SG_ 1133 ARC_OD_ID_56_RR 8;
BA_ "GenSigSendType" SG_ 1133 ARC_OD_ID_57_RR 8;
BA_ "GenSigSendType" SG_ 1133 ARC_OD_MsgCounter_Obj_56_57_RR 8;
BA_ "GenSigSendType" SG_ 1133 ARC_OD_CRC8_Obj_56_57_RR 8;
BA_ "GenSigSendType" SG_ 1133 ARC_OD_AabsY_Obj_56_RR 8;
BA_ "GenSigSendType" SG_ 1133 ARC_OD_DistXStd_Obj_56_RR 8;
BA_ "GenSigSendType" SG_ 1133 ARC_OD_DistYStd_Obj_56_RR 8;
BA_ "GenSigSendType" SG_ 1133 ARC_OD_VabsXStd_Obj_56_RR 8;
BA_ "GenSigSendType" SG_ 1133 ARC_OD_VabsYStd_Obj_56_RR 8;
BA_ "GenSigSendType" SG_ 1133 ARC_OD_AabsXStd_Obj_56_RR 8;
BA_ "GenSigSendType" SG_ 1132 DistHeight_Obj_55_RR 8;
BA_ "GenSigSendType" SG_ 1132 DistHeight_Obj_54_RR 8;
BA_ "GenSigSendType" SG_ 1132 ARC_OD_DistX_Obj_54_RR 8;
BA_ "GenSigSendType" SG_ 1132 ARC_OD_Classification_Obj_54_RR 8;
BA_ "GenSigSendType" SG_ 1132 ARC_OD_AabsYStd_Obj_54_RR 8;
BA_ "GenSigSendType" SG_ 1132 ARC_OD_ClassConf_Obj_54_RR 8;
BA_ "GenSigSendType" SG_ 1132 ARC_OD_ProbOfExist_Obj_54_RR 8;
BA_ "GenSigSendType" SG_ 1132 ARC_OD_VabsX_Obj_54_RR 8;
BA_ "GenSigSendType" SG_ 1132 ARC_OD_DynProp_Obj_54_RR 8;
BA_ "GenSigSendType" SG_ 1132 ARC_OD_Length_Obj_54_RR 8;
BA_ "GenSigSendType" SG_ 1132 ARC_OD_MaintenanceState_Obj_54_R 8;
BA_ "GenSigSendType" SG_ 1132 ARC_OD_Width_Obj_54_RR 8;
BA_ "GenSigSendType" SG_ 1132 ARC_OD_RCS_Obj_54_RR 8;
BA_ "GenSigSendType" SG_ 1132 ARC_OD_Orientation_Obj_54_RR 8;
BA_ "GenSigSendType" SG_ 1132 ARC_OD_LifeCycle_Obj_54_RR 8;
BA_ "GenSigSendType" SG_ 1132 ARC_OD_DistX_Obj_55_RR 8;
BA_ "GenSigSendType" SG_ 1132 ARC_OD_VabsX_Obj_55_RR 8;
BA_ "GenSigSendType" SG_ 1132 ARC_OD_AabsX_Obj_55_RR 8;
BA_ "GenSigSendType" SG_ 1132 ARC_OD_AabsX_Obj_54_RR 8;
BA_ "GenSigSendType" SG_ 1132 ARC_OD_DistY_Obj_55_RR 8;
BA_ "GenSigSendType" SG_ 1132 ARC_OD_VabsY_Obj_55_RR 8;
BA_ "GenSigSendType" SG_ 1132 ARC_OD_AabsY_Obj_55_RR 8;
BA_ "GenSigSendType" SG_ 1132 ARC_OD_DistXStd_Obj_55_RR 8;
BA_ "GenSigSendType" SG_ 1132 ARC_OD_DistYStd_Obj_55_RR 8;
BA_ "GenSigSendType" SG_ 1132 ARC_OD_VabsXStd_Obj_55_RR 8;
BA_ "GenSigSendType" SG_ 1132 ARC_OD_VabsYStd_Obj_55_RR 8;
BA_ "GenSigSendType" SG_ 1132 ARC_OD_AabsXStd_Obj_55_RR 8;
BA_ "GenSigSendType" SG_ 1132 ARC_OD_Classification_Obj_55_RR 8;
BA_ "GenSigSendType" SG_ 1132 ARC_OD_AabsYStd_Obj_55_RR 8;
BA_ "GenSigSendType" SG_ 1132 ARC_OD_ClassConf_Obj_55_RR 8;
BA_ "GenSigSendType" SG_ 1132 ARC_OD_DistY_Obj_54_RR 8;
BA_ "GenSigSendType" SG_ 1132 ARC_OD_ProbOfExist_Obj_55_RR 8;
BA_ "GenSigSendType" SG_ 1132 ARC_OD_DynProp_Obj_55_RR 8;
BA_ "GenSigSendType" SG_ 1132 ARC_OD_Length_Obj_55_RR 8;
BA_ "GenSigSendType" SG_ 1132 ARC_OD_MaintenanceState_Obj_55_R 8;
BA_ "GenSigSendType" SG_ 1132 ARC_OD_Width_Obj_55_RR 8;
BA_ "GenSigSendType" SG_ 1132 ARC_OD_RCS_Obj_55_RR 8;
BA_ "GenSigSendType" SG_ 1132 ARC_OD_Orientation_Obj_55_RR 8;
BA_ "GenSigSendType" SG_ 1132 ARC_OD_LifeCycle_Obj_55_RR 8;
BA_ "GenSigSendType" SG_ 1132 ARC_OD_ObstacleProb_Obj_54_RR 8;
BA_ "GenSigSendType" SG_ 1132 ARC_OD_ObstacleProb_Obj_55_RR 8;
BA_ "GenSigSendType" SG_ 1132 ARC_OD_VabsY_Obj_54_RR 8;
BA_ "GenSigSendType" SG_ 1132 ARC_OD_ID_54_RR 8;
BA_ "GenSigSendType" SG_ 1132 ARC_OD_ID_55_RR 8;
BA_ "GenSigSendType" SG_ 1132 ARC_OD_MsgCounter_Obj_54_55_RR 8;
BA_ "GenSigSendType" SG_ 1132 ARC_OD_CRC8_Obj_54_55_RR 8;
BA_ "GenSigSendType" SG_ 1132 ARC_OD_AabsY_Obj_54_RR 8;
BA_ "GenSigSendType" SG_ 1132 ARC_OD_DistXStd_Obj_54_RR 8;
BA_ "GenSigSendType" SG_ 1132 ARC_OD_DistYStd_Obj_54_RR 8;
BA_ "GenSigSendType" SG_ 1132 ARC_OD_VabsXStd_Obj_54_RR 8;
BA_ "GenSigSendType" SG_ 1132 ARC_OD_VabsYStd_Obj_54_RR 8;
BA_ "GenSigSendType" SG_ 1132 ARC_OD_AabsXStd_Obj_54_RR 8;
BA_ "GenSigSendType" SG_ 1131 DistHeight_Obj_53_RR 8;
BA_ "GenSigSendType" SG_ 1131 DistHeight_Obj_52_RR 8;
BA_ "GenSigSendType" SG_ 1131 ARC_OD_DistX_Obj_52_RR 8;
BA_ "GenSigSendType" SG_ 1131 ARC_OD_Classification_Obj_52_RR 8;
BA_ "GenSigSendType" SG_ 1131 ARC_OD_AabsYStd_Obj_52_RR 8;
BA_ "GenSigSendType" SG_ 1131 ARC_OD_ClassConf_Obj_52_RR 8;
BA_ "GenSigSendType" SG_ 1131 ARC_OD_ProbOfExist_Obj_52_RR 8;
BA_ "GenSigSendType" SG_ 1131 ARC_OD_VabsX_Obj_52_RR 8;
BA_ "GenSigSendType" SG_ 1131 ARC_OD_DynProp_Obj_52_RR 8;
BA_ "GenSigSendType" SG_ 1131 ARC_OD_Length_Obj_52_RR 8;
BA_ "GenSigSendType" SG_ 1131 ARC_OD_MaintenanceState_Obj_52_R 8;
BA_ "GenSigSendType" SG_ 1131 ARC_OD_Width_Obj_52_RR 8;
BA_ "GenSigSendType" SG_ 1131 ARC_OD_RCS_Obj_52_RR 8;
BA_ "GenSigSendType" SG_ 1131 ARC_OD_Orientation_Obj_52_RR 8;
BA_ "GenSigSendType" SG_ 1131 ARC_OD_LifeCycle_Obj_52_RR 8;
BA_ "GenSigSendType" SG_ 1131 ARC_OD_DistX_Obj_53_RR 8;
BA_ "GenSigSendType" SG_ 1131 ARC_OD_VabsX_Obj_53_RR 8;
BA_ "GenSigSendType" SG_ 1131 ARC_OD_AabsX_Obj_53_RR 8;
BA_ "GenSigSendType" SG_ 1131 ARC_OD_AabsX_Obj_52_RR 8;
BA_ "GenSigSendType" SG_ 1131 ARC_OD_DistY_Obj_53_RR 8;
BA_ "GenSigSendType" SG_ 1131 ARC_OD_VabsY_Obj_53_RR 8;
BA_ "GenSigSendType" SG_ 1131 ARC_OD_AabsY_Obj_53_RR 8;
BA_ "GenSigSendType" SG_ 1131 ARC_OD_DistXStd_Obj_53_RR 8;
BA_ "GenSigSendType" SG_ 1131 ARC_OD_DistYStd_Obj_53_RR 8;
BA_ "GenSigSendType" SG_ 1131 ARC_OD_VabsXStd_Obj_53_RR 8;
BA_ "GenSigSendType" SG_ 1131 ARC_OD_VabsYStd_Obj_53_RR 8;
BA_ "GenSigSendType" SG_ 1131 ARC_OD_AabsXStd_Obj_53_RR 8;
BA_ "GenSigSendType" SG_ 1131 ARC_OD_Classification_Obj_53_RR 8;
BA_ "GenSigSendType" SG_ 1131 ARC_OD_AabsYStd_Obj_53_RR 8;
BA_ "GenSigSendType" SG_ 1131 ARC_OD_ClassConf_Obj_53_RR 8;
BA_ "GenSigSendType" SG_ 1131 ARC_OD_DistY_Obj_52_RR 8;
BA_ "GenSigSendType" SG_ 1131 ARC_OD_ProbOfExist_Obj_53_RR 8;
BA_ "GenSigSendType" SG_ 1131 ARC_OD_DynProp_Obj_53_RR 8;
BA_ "GenSigSendType" SG_ 1131 ARC_OD_Length_Obj_53_RR 8;
BA_ "GenSigSendType" SG_ 1131 ARC_OD_MaintenanceState_Obj_53_R 8;
BA_ "GenSigSendType" SG_ 1131 ARC_OD_Width_Obj_53_RR 8;
BA_ "GenSigSendType" SG_ 1131 ARC_OD_RCS_Obj_53_RR 8;
BA_ "GenSigSendType" SG_ 1131 ARC_OD_Orientation_Obj_53_RR 8;
BA_ "GenSigSendType" SG_ 1131 ARC_OD_LifeCycle_Obj_53_RR 8;
BA_ "GenSigSendType" SG_ 1131 ARC_OD_ObstacleProb_Obj_52_RR 8;
BA_ "GenSigSendType" SG_ 1131 ARC_OD_ObstacleProb_Obj_53_RR 8;
BA_ "GenSigSendType" SG_ 1131 ARC_OD_VabsY_Obj_52_RR 8;
BA_ "GenSigSendType" SG_ 1131 ARC_OD_ID_52_RR 8;
BA_ "GenSigSendType" SG_ 1131 ARC_OD_ID_53_RR 8;
BA_ "GenSigSendType" SG_ 1131 ARC_OD_MsgCounter_Obj_52_53_RR 8;
BA_ "GenSigSendType" SG_ 1131 ARC_OD_CRC8_Obj_52_53_RR 8;
BA_ "GenSigSendType" SG_ 1131 ARC_OD_AabsY_Obj_52_RR 8;
BA_ "GenSigSendType" SG_ 1131 ARC_OD_DistXStd_Obj_52_RR 8;
BA_ "GenSigSendType" SG_ 1131 ARC_OD_DistYStd_Obj_52_RR 8;
BA_ "GenSigSendType" SG_ 1131 ARC_OD_VabsXStd_Obj_52_RR 8;
BA_ "GenSigSendType" SG_ 1131 ARC_OD_VabsYStd_Obj_52_RR 8;
BA_ "GenSigSendType" SG_ 1131 ARC_OD_AabsXStd_Obj_52_RR 8;
BA_ "GenSigSendType" SG_ 1130 DistHeight_Obj_51_RR 8;
BA_ "GenSigSendType" SG_ 1130 DistHeight_Obj_50_RR 8;
BA_ "GenSigSendType" SG_ 1130 ARC_OD_DistX_Obj_50_RR 8;
BA_ "GenSigSendType" SG_ 1130 ARC_OD_Classification_Obj_50_RR 8;
BA_ "GenSigSendType" SG_ 1130 ARC_OD_AabsYStd_Obj_50_RR 8;
BA_ "GenSigSendType" SG_ 1130 ARC_OD_ClassConf_Obj_50_RR 8;
BA_ "GenSigSendType" SG_ 1130 ARC_OD_ProbOfExist_Obj_50_RR 8;
BA_ "GenSigSendType" SG_ 1130 ARC_OD_VabsX_Obj_50_RR 8;
BA_ "GenSigSendType" SG_ 1130 ARC_OD_DynProp_Obj_50_RR 8;
BA_ "GenSigSendType" SG_ 1130 ARC_OD_Length_Obj_50_RR 8;
BA_ "GenSigSendType" SG_ 1130 ARC_OD_MaintenanceState_Obj_50_R 8;
BA_ "GenSigSendType" SG_ 1130 ARC_OD_Width_Obj_50_RR 8;
BA_ "GenSigSendType" SG_ 1130 ARC_OD_RCS_Obj_50_RR 8;
BA_ "GenSigSendType" SG_ 1130 ARC_OD_Orientation_Obj_50_RR 8;
BA_ "GenSigSendType" SG_ 1130 ARC_OD_LifeCycle_Obj_50_RR 8;
BA_ "GenSigSendType" SG_ 1130 ARC_OD_DistX_Obj_51_RR 8;
BA_ "GenSigSendType" SG_ 1130 ARC_OD_VabsX_Obj_51_RR 8;
BA_ "GenSigSendType" SG_ 1130 ARC_OD_AabsX_Obj_51_RR 8;
BA_ "GenSigSendType" SG_ 1130 ARC_OD_AabsX_Obj_50_RR 8;
BA_ "GenSigSendType" SG_ 1130 ARC_OD_DistY_Obj_51_RR 8;
BA_ "GenSigSendType" SG_ 1130 ARC_OD_VabsY_Obj_51_RR 8;
BA_ "GenSigSendType" SG_ 1130 ARC_OD_AabsY_Obj_51_RR 8;
BA_ "GenSigSendType" SG_ 1130 ARC_OD_DistXStd_Obj_51_RR 8;
BA_ "GenSigSendType" SG_ 1130 ARC_OD_DistYStd_Obj_51_RR 8;
BA_ "GenSigSendType" SG_ 1130 ARC_OD_VabsXStd_Obj_51_RR 8;
BA_ "GenSigSendType" SG_ 1130 ARC_OD_VabsYStd_Obj_51_RR 8;
BA_ "GenSigSendType" SG_ 1130 ARC_OD_AabsXStd_Obj_51_RR 8;
BA_ "GenSigSendType" SG_ 1130 ARC_OD_Classification_Obj_51_RR 8;
BA_ "GenSigSendType" SG_ 1130 ARC_OD_AabsYStd_Obj_51_RR 8;
BA_ "GenSigSendType" SG_ 1130 ARC_OD_ClassConf_Obj_51_RR 8;
BA_ "GenSigSendType" SG_ 1130 ARC_OD_DistY_Obj_50_RR 8;
BA_ "GenSigSendType" SG_ 1130 ARC_OD_ProbOfExist_Obj_51_RR 8;
BA_ "GenSigSendType" SG_ 1130 ARC_OD_DynProp_Obj_51_RR 8;
BA_ "GenSigSendType" SG_ 1130 ARC_OD_Length_Obj_51_RR 8;
BA_ "GenSigSendType" SG_ 1130 ARC_OD_MaintenanceState_Obj_51_R 8;
BA_ "GenSigSendType" SG_ 1130 ARC_OD_Width_Obj_51_RR 8;
BA_ "GenSigSendType" SG_ 1130 ARC_OD_RCS_Obj_51_RR 8;
BA_ "GenSigSendType" SG_ 1130 ARC_OD_Orientation_Obj_51_RR 8;
BA_ "GenSigSendType" SG_ 1130 ARC_OD_LifeCycle_Obj_51_RR 8;
BA_ "GenSigSendType" SG_ 1130 ARC_OD_ObstacleProb_Obj_50_RR 8;
BA_ "GenSigSendType" SG_ 1130 ARC_OD_ObstacleProb_Obj_51_RR 8;
BA_ "GenSigSendType" SG_ 1130 ARC_OD_VabsY_Obj_50_RR 8;
BA_ "GenSigSendType" SG_ 1130 ARC_OD_ID_50_RR 8;
BA_ "GenSigSendType" SG_ 1130 ARC_OD_ID_51_RR 8;
BA_ "GenSigSendType" SG_ 1130 ARC_OD_MsgCounter_Obj_50_51_RR 8;
BA_ "GenSigSendType" SG_ 1130 ARC_OD_CRC8_Obj_50_51_RR 8;
BA_ "GenSigSendType" SG_ 1130 ARC_OD_AabsY_Obj_50_RR 8;
BA_ "GenSigSendType" SG_ 1130 ARC_OD_DistXStd_Obj_50_RR 8;
BA_ "GenSigSendType" SG_ 1130 ARC_OD_DistYStd_Obj_50_RR 8;
BA_ "GenSigSendType" SG_ 1130 ARC_OD_VabsXStd_Obj_50_RR 8;
BA_ "GenSigSendType" SG_ 1130 ARC_OD_VabsYStd_Obj_50_RR 8;
BA_ "GenSigSendType" SG_ 1130 ARC_OD_AabsXStd_Obj_50_RR 8;
BA_ "GenSigSendType" SG_ 1129 DistHeight_Obj_49_RR 8;
BA_ "GenSigSendType" SG_ 1129 DistHeight_Obj_48_RR 8;
BA_ "GenSigSendType" SG_ 1129 ARC_OD_DistX_Obj_48_RR 8;
BA_ "GenSigSendType" SG_ 1129 ARC_OD_Classification_Obj_48_RR 8;
BA_ "GenSigSendType" SG_ 1129 ARC_OD_AabsYStd_Obj_48_RR 8;
BA_ "GenSigSendType" SG_ 1129 ARC_OD_ClassConf_Obj_48_RR 8;
BA_ "GenSigSendType" SG_ 1129 ARC_OD_ProbOfExist_Obj_48_RR 8;
BA_ "GenSigSendType" SG_ 1129 ARC_OD_VabsX_Obj_48_RR 8;
BA_ "GenSigSendType" SG_ 1129 ARC_OD_DynProp_Obj_48_RR 8;
BA_ "GenSigSendType" SG_ 1129 ARC_OD_Length_Obj_48_RR 8;
BA_ "GenSigSendType" SG_ 1129 ARC_OD_MaintenanceState_Obj_48_R 8;
BA_ "GenSigSendType" SG_ 1129 ARC_OD_Width_Obj_48_RR 8;
BA_ "GenSigSendType" SG_ 1129 ARC_OD_RCS_Obj_48_RR 8;
BA_ "GenSigSendType" SG_ 1129 ARC_OD_Orientation_Obj_48_RR 8;
BA_ "GenSigSendType" SG_ 1129 ARC_OD_LifeCycle_Obj_48_RR 8;
BA_ "GenSigSendType" SG_ 1129 ARC_OD_DistX_Obj_49_RR 8;
BA_ "GenSigSendType" SG_ 1129 ARC_OD_VabsX_Obj_49_RR 8;
BA_ "GenSigSendType" SG_ 1129 ARC_OD_AabsX_Obj_49_RR 8;
BA_ "GenSigSendType" SG_ 1129 ARC_OD_AabsX_Obj_48_RR 8;
BA_ "GenSigSendType" SG_ 1129 ARC_OD_DistY_Obj_49_RR 8;
BA_ "GenSigSendType" SG_ 1129 ARC_OD_VabsY_Obj_49_RR 8;
BA_ "GenSigSendType" SG_ 1129 ARC_OD_AabsY_Obj_49_RR 8;
BA_ "GenSigSendType" SG_ 1129 ARC_OD_DistXStd_Obj_49_RR 8;
BA_ "GenSigSendType" SG_ 1129 ARC_OD_DistYStd_Obj_49_RR 8;
BA_ "GenSigSendType" SG_ 1129 ARC_OD_VabsXStd_Obj_49_RR 8;
BA_ "GenSigSendType" SG_ 1129 ARC_OD_VabsYStd_Obj_49_RR 8;
BA_ "GenSigSendType" SG_ 1129 ARC_OD_AabsXStd_Obj_49_RR 8;
BA_ "GenSigSendType" SG_ 1129 ARC_OD_Classification_Obj_49_RR 8;
BA_ "GenSigSendType" SG_ 1129 ARC_OD_AabsYStd_Obj_49_RR 8;
BA_ "GenSigSendType" SG_ 1129 ARC_OD_ClassConf_Obj_49_RR 8;
BA_ "GenSigSendType" SG_ 1129 ARC_OD_DistY_Obj_48_RR 8;
BA_ "GenSigSendType" SG_ 1129 ARC_OD_ProbOfExist_Obj_49_RR 8;
BA_ "GenSigSendType" SG_ 1129 ARC_OD_DynProp_Obj_49_RR 8;
BA_ "GenSigSendType" SG_ 1129 ARC_OD_Length_Obj_49_RR 8;
BA_ "GenSigSendType" SG_ 1129 ARC_OD_MaintenanceState_Obj_49_R 8;
BA_ "GenSigSendType" SG_ 1129 ARC_OD_Width_Obj_49_RR 8;
BA_ "GenSigSendType" SG_ 1129 ARC_OD_RCS_Obj_49_RR 8;
BA_ "GenSigSendType" SG_ 1129 ARC_OD_Orientation_Obj_49_RR 8;
BA_ "GenSigSendType" SG_ 1129 ARC_OD_LifeCycle_Obj_49_RR 8;
BA_ "GenSigSendType" SG_ 1129 ARC_OD_ObstacleProb_Obj_48_RR 8;
BA_ "GenSigSendType" SG_ 1129 ARC_OD_ObstacleProb_Obj_49_RR 8;
BA_ "GenSigSendType" SG_ 1129 ARC_OD_VabsY_Obj_48_RR 8;
BA_ "GenSigSendType" SG_ 1129 ARC_OD_ID_48_RR 8;
BA_ "GenSigSendType" SG_ 1129 ARC_OD_ID_49_RR 8;
BA_ "GenSigSendType" SG_ 1129 ARC_OD_MsgCounter_Obj_48_49_RR 8;
BA_ "GenSigSendType" SG_ 1129 ARC_OD_CRC8_Obj_48_49_RR 8;
BA_ "GenSigSendType" SG_ 1129 ARC_OD_AabsY_Obj_48_RR 8;
BA_ "GenSigSendType" SG_ 1129 ARC_OD_DistXStd_Obj_48_RR 8;
BA_ "GenSigSendType" SG_ 1129 ARC_OD_DistYStd_Obj_48_RR 8;
BA_ "GenSigSendType" SG_ 1129 ARC_OD_VabsXStd_Obj_48_RR 8;
BA_ "GenSigSendType" SG_ 1129 ARC_OD_VabsYStd_Obj_48_RR 8;
BA_ "GenSigSendType" SG_ 1129 ARC_OD_AabsXStd_Obj_48_RR 8;
BA_ "GenSigSendType" SG_ 1128 DistHeight_Obj_47_RR 8;
BA_ "GenSigSendType" SG_ 1128 DistHeight_Obj_46_RR 8;
BA_ "GenSigSendType" SG_ 1128 ARC_OD_DistX_Obj_46_RR 8;
BA_ "GenSigSendType" SG_ 1128 ARC_OD_Classification_Obj_46_RR 8;
BA_ "GenSigSendType" SG_ 1128 ARC_OD_AabsYStd_Obj_46_RR 8;
BA_ "GenSigSendType" SG_ 1128 ARC_OD_ClassConf_Obj_46_RR 8;
BA_ "GenSigSendType" SG_ 1128 ARC_OD_ProbOfExist_Obj_46_RR 8;
BA_ "GenSigSendType" SG_ 1128 ARC_OD_VabsX_Obj_46_RR 8;
BA_ "GenSigSendType" SG_ 1128 ARC_OD_DynProp_Obj_46_RR 8;
BA_ "GenSigSendType" SG_ 1128 ARC_OD_Length_Obj_46_RR 8;
BA_ "GenSigSendType" SG_ 1128 ARC_OD_MaintenanceState_Obj_46_R 8;
BA_ "GenSigSendType" SG_ 1128 ARC_OD_Width_Obj_46_RR 8;
BA_ "GenSigSendType" SG_ 1128 ARC_OD_RCS_Obj_46_RR 8;
BA_ "GenSigSendType" SG_ 1128 ARC_OD_Orientation_Obj_46_RR 8;
BA_ "GenSigSendType" SG_ 1128 ARC_OD_LifeCycle_Obj_46_RR 8;
BA_ "GenSigSendType" SG_ 1128 ARC_OD_DistX_Obj_47_RR 8;
BA_ "GenSigSendType" SG_ 1128 ARC_OD_VabsX_Obj_47_RR 8;
BA_ "GenSigSendType" SG_ 1128 ARC_OD_AabsX_Obj_47_RR 8;
BA_ "GenSigSendType" SG_ 1128 ARC_OD_AabsX_Obj_46_RR 8;
BA_ "GenSigSendType" SG_ 1128 ARC_OD_DistY_Obj_47_RR 8;
BA_ "GenSigSendType" SG_ 1128 ARC_OD_VabsY_Obj_47_RR 8;
BA_ "GenSigSendType" SG_ 1128 ARC_OD_AabsY_Obj_47_RR 8;
BA_ "GenSigSendType" SG_ 1128 ARC_OD_DistXStd_Obj_47_RR 8;
BA_ "GenSigSendType" SG_ 1128 ARC_OD_DistYStd_Obj_47_RR 8;
BA_ "GenSigSendType" SG_ 1128 ARC_OD_VabsXStd_Obj_47_RR 8;
BA_ "GenSigSendType" SG_ 1128 ARC_OD_VabsYStd_Obj_47_RR 8;
BA_ "GenSigSendType" SG_ 1128 ARC_OD_AabsXStd_Obj_47_RR 8;
BA_ "GenSigSendType" SG_ 1128 ARC_OD_Classification_Obj_47_RR 8;
BA_ "GenSigSendType" SG_ 1128 ARC_OD_AabsYStd_Obj_47_RR 8;
BA_ "GenSigSendType" SG_ 1128 ARC_OD_ClassConf_Obj_47_RR 8;
BA_ "GenSigSendType" SG_ 1128 ARC_OD_DistY_Obj_46_RR 8;
BA_ "GenSigSendType" SG_ 1128 ARC_OD_ProbOfExist_Obj_47_RR 8;
BA_ "GenSigSendType" SG_ 1128 ARC_OD_DynProp_Obj_47_RR 8;
BA_ "GenSigSendType" SG_ 1128 ARC_OD_Length_Obj_47_RR 8;
BA_ "GenSigSendType" SG_ 1128 ARC_OD_MaintenanceState_Obj_47_R 8;
BA_ "GenSigSendType" SG_ 1128 ARC_OD_Width_Obj_47_RR 8;
BA_ "GenSigSendType" SG_ 1128 ARC_OD_RCS_Obj_47_RR 8;
BA_ "GenSigSendType" SG_ 1128 ARC_OD_Orientation_Obj_47_RR 8;
BA_ "GenSigSendType" SG_ 1128 ARC_OD_LifeCycle_Obj_47_RR 8;
BA_ "GenSigSendType" SG_ 1128 ARC_OD_ObstacleProb_Obj_46_RR 8;
BA_ "GenSigSendType" SG_ 1128 ARC_OD_ObstacleProb_Obj_47_RR 8;
BA_ "GenSigSendType" SG_ 1128 ARC_OD_VabsY_Obj_46_RR 8;
BA_ "GenSigSendType" SG_ 1128 ARC_OD_ID_46_RR 8;
BA_ "GenSigSendType" SG_ 1128 ARC_OD_ID_47_RR 8;
BA_ "GenSigSendType" SG_ 1128 ARC_OD_MsgCounter_Obj_46_47_RR 8;
BA_ "GenSigSendType" SG_ 1128 ARC_OD_CRC8_Obj_46_47_RR 8;
BA_ "GenSigSendType" SG_ 1128 ARC_OD_AabsY_Obj_46_RR 8;
BA_ "GenSigSendType" SG_ 1128 ARC_OD_DistXStd_Obj_46_RR 8;
BA_ "GenSigSendType" SG_ 1128 ARC_OD_DistYStd_Obj_46_RR 8;
BA_ "GenSigSendType" SG_ 1128 ARC_OD_VabsXStd_Obj_46_RR 8;
BA_ "GenSigSendType" SG_ 1128 ARC_OD_VabsYStd_Obj_46_RR 8;
BA_ "GenSigSendType" SG_ 1128 ARC_OD_AabsXStd_Obj_46_RR 8;
BA_ "GenSigSendType" SG_ 1127 DistHeight_Obj_45_RR 8;
BA_ "GenSigSendType" SG_ 1127 DistHeight_Obj_44_RR 8;
BA_ "GenSigSendType" SG_ 1127 ARC_OD_DistX_Obj_44_RR 8;
BA_ "GenSigSendType" SG_ 1127 ARC_OD_Classification_Obj_44_RR 8;
BA_ "GenSigSendType" SG_ 1127 ARC_OD_AabsYStd_Obj_44_RR 8;
BA_ "GenSigSendType" SG_ 1127 ARC_OD_ClassConf_Obj_44_RR 8;
BA_ "GenSigSendType" SG_ 1127 ARC_OD_ProbOfExist_Obj_44_RR 8;
BA_ "GenSigSendType" SG_ 1127 ARC_OD_VabsX_Obj_44_RR 8;
BA_ "GenSigSendType" SG_ 1127 ARC_OD_DynProp_Obj_44_RR 8;
BA_ "GenSigSendType" SG_ 1127 ARC_OD_Length_Obj_44_RR 8;
BA_ "GenSigSendType" SG_ 1127 ARC_OD_MaintenanceState_Obj_44_R 8;
BA_ "GenSigSendType" SG_ 1127 ARC_OD_Width_Obj_44_RR 8;
BA_ "GenSigSendType" SG_ 1127 ARC_OD_RCS_Obj_44_RR 8;
BA_ "GenSigSendType" SG_ 1127 ARC_OD_Orientation_Obj_44_RR 8;
BA_ "GenSigSendType" SG_ 1127 ARC_OD_LifeCycle_Obj_44_RR 8;
BA_ "GenSigSendType" SG_ 1127 ARC_OD_DistX_Obj_45_RR 8;
BA_ "GenSigSendType" SG_ 1127 ARC_OD_VabsX_Obj_45_RR 8;
BA_ "GenSigSendType" SG_ 1127 ARC_OD_AabsX_Obj_45_RR 8;
BA_ "GenSigSendType" SG_ 1127 ARC_OD_AabsX_Obj_44_RR 8;
BA_ "GenSigSendType" SG_ 1127 ARC_OD_DistY_Obj_45_RR 8;
BA_ "GenSigSendType" SG_ 1127 ARC_OD_VabsY_Obj_45_RR 8;
BA_ "GenSigSendType" SG_ 1127 ARC_OD_AabsY_Obj_45_RR 8;
BA_ "GenSigSendType" SG_ 1127 ARC_OD_DistXStd_Obj_45_RR 8;
BA_ "GenSigSendType" SG_ 1127 ARC_OD_DistYStd_Obj_45_RR 8;
BA_ "GenSigSendType" SG_ 1127 ARC_OD_VabsXStd_Obj_45_RR 8;
BA_ "GenSigSendType" SG_ 1127 ARC_OD_VabsYStd_Obj_45_RR 8;
BA_ "GenSigSendType" SG_ 1127 ARC_OD_AabsXStd_Obj_45_RR 8;
BA_ "GenSigSendType" SG_ 1127 ARC_OD_Classification_Obj_45_RR 8;
BA_ "GenSigSendType" SG_ 1127 ARC_OD_AabsYStd_Obj_45_RR 8;
BA_ "GenSigSendType" SG_ 1127 ARC_OD_ClassConf_Obj_45_RR 8;
BA_ "GenSigSendType" SG_ 1127 ARC_OD_DistY_Obj_44_RR 8;
BA_ "GenSigSendType" SG_ 1127 ARC_OD_ProbOfExist_Obj_45_RR 8;
BA_ "GenSigSendType" SG_ 1127 ARC_OD_DynProp_Obj_45_RR 8;
BA_ "GenSigSendType" SG_ 1127 ARC_OD_Length_Obj_45_RR 8;
BA_ "GenSigSendType" SG_ 1127 ARC_OD_MaintenanceState_Obj_45_R 8;
BA_ "GenSigSendType" SG_ 1127 ARC_OD_Width_Obj_45_RR 8;
BA_ "GenSigSendType" SG_ 1127 ARC_OD_RCS_Obj_45_RR 8;
BA_ "GenSigSendType" SG_ 1127 ARC_OD_Orientation_Obj_45_RR 8;
BA_ "GenSigSendType" SG_ 1127 ARC_OD_LifeCycle_Obj_45_RR 8;
BA_ "GenSigSendType" SG_ 1127 ARC_OD_ObstacleProb_Obj_44_RR 8;
BA_ "GenSigSendType" SG_ 1127 ARC_OD_ObstacleProb_Obj_45_RR 8;
BA_ "GenSigSendType" SG_ 1127 ARC_OD_VabsY_Obj_44_RR 8;
BA_ "GenSigSendType" SG_ 1127 ARC_OD_ID_44_RR 8;
BA_ "GenSigSendType" SG_ 1127 ARC_OD_ID_45_RR 8;
BA_ "GenSigSendType" SG_ 1127 ARC_OD_MsgCounter_Obj_44_45_RR 8;
BA_ "GenSigSendType" SG_ 1127 ARC_OD_CRC8_Obj_44_45_RR 8;
BA_ "GenSigSendType" SG_ 1127 ARC_OD_AabsY_Obj_44_RR 8;
BA_ "GenSigSendType" SG_ 1127 ARC_OD_DistXStd_Obj_44_RR 8;
BA_ "GenSigSendType" SG_ 1127 ARC_OD_DistYStd_Obj_44_RR 8;
BA_ "GenSigSendType" SG_ 1127 ARC_OD_VabsXStd_Obj_44_RR 8;
BA_ "GenSigSendType" SG_ 1127 ARC_OD_VabsYStd_Obj_44_RR 8;
BA_ "GenSigSendType" SG_ 1127 ARC_OD_AabsXStd_Obj_44_RR 8;
BA_ "GenSigSendType" SG_ 1126 DistHeight_Obj_43_RR 8;
BA_ "GenSigSendType" SG_ 1126 DistHeight_Obj_42_RR 8;
BA_ "GenSigSendType" SG_ 1126 ARC_OD_DistX_Obj_42_RR 8;
BA_ "GenSigSendType" SG_ 1126 ARC_OD_Classification_Obj_42_RR 8;
BA_ "GenSigSendType" SG_ 1126 ARC_OD_AabsYStd_Obj_42_RR 8;
BA_ "GenSigSendType" SG_ 1126 ARC_OD_ClassConf_Obj_42_RR 8;
BA_ "GenSigSendType" SG_ 1126 ARC_OD_ProbOfExist_Obj_42_RR 8;
BA_ "GenSigSendType" SG_ 1126 ARC_OD_VabsX_Obj_42_RR 8;
BA_ "GenSigSendType" SG_ 1126 ARC_OD_DynProp_Obj_42_RR 8;
BA_ "GenSigSendType" SG_ 1126 ARC_OD_Length_Obj_42_RR 8;
BA_ "GenSigSendType" SG_ 1126 ARC_OD_MaintenanceState_Obj_42_R 8;
BA_ "GenSigSendType" SG_ 1126 ARC_OD_Width_Obj_42_RR 8;
BA_ "GenSigSendType" SG_ 1126 ARC_OD_RCS_Obj_42_RR 8;
BA_ "GenSigSendType" SG_ 1126 ARC_OD_Orientation_Obj_42_RR 8;
BA_ "GenSigSendType" SG_ 1126 ARC_OD_LifeCycle_Obj_42_RR 8;
BA_ "GenSigSendType" SG_ 1126 ARC_OD_DistX_Obj_43_RR 8;
BA_ "GenSigSendType" SG_ 1126 ARC_OD_VabsX_Obj_43_RR 8;
BA_ "GenSigSendType" SG_ 1126 ARC_OD_AabsX_Obj_43_RR 8;
BA_ "GenSigSendType" SG_ 1126 ARC_OD_AabsX_Obj_42_RR 8;
BA_ "GenSigSendType" SG_ 1126 ARC_OD_DistY_Obj_43_RR 8;
BA_ "GenSigSendType" SG_ 1126 ARC_OD_VabsY_Obj_43_RR 8;
BA_ "GenSigSendType" SG_ 1126 ARC_OD_AabsY_Obj_43_RR 8;
BA_ "GenSigSendType" SG_ 1126 ARC_OD_DistXStd_Obj_43_RR 8;
BA_ "GenSigSendType" SG_ 1126 ARC_OD_DistYStd_Obj_43_RR 8;
BA_ "GenSigSendType" SG_ 1126 ARC_OD_VabsXStd_Obj_43_RR 8;
BA_ "GenSigSendType" SG_ 1126 ARC_OD_VabsYStd_Obj_43_RR 8;
BA_ "GenSigSendType" SG_ 1126 ARC_OD_AabsXStd_Obj_43_RR 8;
BA_ "GenSigSendType" SG_ 1126 ARC_OD_Classification_Obj_43_RR 8;
BA_ "GenSigSendType" SG_ 1126 ARC_OD_AabsYStd_Obj_43_RR 8;
BA_ "GenSigSendType" SG_ 1126 ARC_OD_ClassConf_Obj_43_RR 8;
BA_ "GenSigSendType" SG_ 1126 ARC_OD_DistY_Obj_42_RR 8;
BA_ "GenSigSendType" SG_ 1126 ARC_OD_ProbOfExist_Obj_43_RR 8;
BA_ "GenSigSendType" SG_ 1126 ARC_OD_DynProp_Obj_43_RR 8;
BA_ "GenSigSendType" SG_ 1126 ARC_OD_Length_Obj_43_RR 8;
BA_ "GenSigSendType" SG_ 1126 ARC_OD_MaintenanceState_Obj_43_R 8;
BA_ "GenSigSendType" SG_ 1126 ARC_OD_Width_Obj_43_RR 8;
BA_ "GenSigSendType" SG_ 1126 ARC_OD_RCS_Obj_43_RR 8;
BA_ "GenSigSendType" SG_ 1126 ARC_OD_Orientation_Obj_43_RR 8;
BA_ "GenSigSendType" SG_ 1126 ARC_OD_LifeCycle_Obj_43_RR 8;
BA_ "GenSigSendType" SG_ 1126 ARC_OD_ObstacleProb_Obj_42_RR 8;
BA_ "GenSigSendType" SG_ 1126 ARC_OD_ObstacleProb_Obj_43_RR 8;
BA_ "GenSigSendType" SG_ 1126 ARC_OD_VabsY_Obj_42_RR 8;
BA_ "GenSigSendType" SG_ 1126 ARC_OD_ID_42_RR 8;
BA_ "GenSigSendType" SG_ 1126 ARC_OD_ID_43_RR 8;
BA_ "GenSigSendType" SG_ 1126 ARC_OD_MsgCounter_Obj_42_43_RR 8;
BA_ "GenSigSendType" SG_ 1126 ARC_OD_CRC8_Obj_42_43_RR 8;
BA_ "GenSigSendType" SG_ 1126 ARC_OD_AabsY_Obj_42_RR 8;
BA_ "GenSigSendType" SG_ 1126 ARC_OD_DistXStd_Obj_42_RR 8;
BA_ "GenSigSendType" SG_ 1126 ARC_OD_DistYStd_Obj_42_RR 8;
BA_ "GenSigSendType" SG_ 1126 ARC_OD_VabsXStd_Obj_42_RR 8;
BA_ "GenSigSendType" SG_ 1126 ARC_OD_VabsYStd_Obj_42_RR 8;
BA_ "GenSigSendType" SG_ 1126 ARC_OD_AabsXStd_Obj_42_RR 8;
BA_ "GenSigSendType" SG_ 1125 DistHeight_Obj_41_RR 8;
BA_ "GenSigSendType" SG_ 1125 DistHeight_Obj_40_RR 8;
BA_ "GenSigSendType" SG_ 1125 ARC_OD_DistX_Obj_40_RR 8;
BA_ "GenSigSendType" SG_ 1125 ARC_OD_Classification_Obj_40_RR 8;
BA_ "GenSigSendType" SG_ 1125 ARC_OD_AabsYStd_Obj_40_RR 8;
BA_ "GenSigSendType" SG_ 1125 ARC_OD_ClassConf_Obj_40_RR 8;
BA_ "GenSigSendType" SG_ 1125 ARC_OD_ProbOfExist_Obj_40_RR 8;
BA_ "GenSigSendType" SG_ 1125 ARC_OD_VabsX_Obj_40_RR 8;
BA_ "GenSigSendType" SG_ 1125 ARC_OD_DynProp_Obj_40_RR 8;
BA_ "GenSigSendType" SG_ 1125 ARC_OD_Length_Obj_40_RR 8;
BA_ "GenSigSendType" SG_ 1125 ARC_OD_MaintenanceState_Obj_40_R 8;
BA_ "GenSigSendType" SG_ 1125 ARC_OD_Width_Obj_40_RR 8;
BA_ "GenSigSendType" SG_ 1125 ARC_OD_RCS_Obj_40_RR 8;
BA_ "GenSigSendType" SG_ 1125 ARC_OD_Orientation_Obj_40_RR 8;
BA_ "GenSigSendType" SG_ 1125 ARC_OD_LifeCycle_Obj_40_RR 8;
BA_ "GenSigSendType" SG_ 1125 ARC_OD_DistX_Obj_41_RR 8;
BA_ "GenSigSendType" SG_ 1125 ARC_OD_VabsX_Obj_41_RR 8;
BA_ "GenSigSendType" SG_ 1125 ARC_OD_AabsX_Obj_41_RR 8;
BA_ "GenSigSendType" SG_ 1125 ARC_OD_AabsX_Obj_40_RR 8;
BA_ "GenSigSendType" SG_ 1125 ARC_OD_DistY_Obj_41_RR 8;
BA_ "GenSigSendType" SG_ 1125 ARC_OD_VabsY_Obj_41_RR 8;
BA_ "GenSigSendType" SG_ 1125 ARC_OD_AabsY_Obj_41_RR 8;
BA_ "GenSigSendType" SG_ 1125 ARC_OD_DistXStd_Obj_41_RR 8;
BA_ "GenSigSendType" SG_ 1125 ARC_OD_DistYStd_Obj_41_RR 8;
BA_ "GenSigSendType" SG_ 1125 ARC_OD_VabsXStd_Obj_41_RR 8;
BA_ "GenSigSendType" SG_ 1125 ARC_OD_VabsYStd_Obj_41_RR 8;
BA_ "GenSigSendType" SG_ 1125 ARC_OD_AabsXStd_Obj_41_RR 8;
BA_ "GenSigSendType" SG_ 1125 ARC_OD_Classification_Obj_41_RR 8;
BA_ "GenSigSendType" SG_ 1125 ARC_OD_AabsYStd_Obj_41_RR 8;
BA_ "GenSigSendType" SG_ 1125 ARC_OD_ClassConf_Obj_41_RR 8;
BA_ "GenSigSendType" SG_ 1125 ARC_OD_DistY_Obj_40_RR 8;
BA_ "GenSigSendType" SG_ 1125 ARC_OD_ProbOfExist_Obj_41_RR 8;
BA_ "GenSigSendType" SG_ 1125 ARC_OD_DynProp_Obj_41_RR 8;
BA_ "GenSigSendType" SG_ 1125 ARC_OD_Length_Obj_41_RR 8;
BA_ "GenSigSendType" SG_ 1125 ARC_OD_MaintenanceState_Obj_41_R 8;
BA_ "GenSigSendType" SG_ 1125 ARC_OD_Width_Obj_41_RR 8;
BA_ "GenSigSendType" SG_ 1125 ARC_OD_RCS_Obj_41_RR 8;
BA_ "GenSigSendType" SG_ 1125 ARC_OD_Orientation_Obj_41_RR 8;
BA_ "GenSigSendType" SG_ 1125 ARC_OD_LifeCycle_Obj_41_RR 8;
BA_ "GenSigSendType" SG_ 1125 ARC_OD_ObstacleProb_Obj_40_RR 8;
BA_ "GenSigSendType" SG_ 1125 ARC_OD_ObstacleProb_Obj_41_RR 8;
BA_ "GenSigSendType" SG_ 1125 ARC_OD_VabsY_Obj_40_RR 8;
BA_ "GenSigSendType" SG_ 1125 ARC_OD_ID_40_RR 8;
BA_ "GenSigSendType" SG_ 1125 ARC_OD_ID_41_RR 8;
BA_ "GenSigSendType" SG_ 1125 ARC_OD_MsgCounter_Obj_40_41_RR 8;
BA_ "GenSigSendType" SG_ 1125 ARC_OD_CRC8_Obj_40_41_RR 8;
BA_ "GenSigSendType" SG_ 1125 ARC_OD_AabsY_Obj_40_RR 8;
BA_ "GenSigSendType" SG_ 1125 ARC_OD_DistXStd_Obj_40_RR 8;
BA_ "GenSigSendType" SG_ 1125 ARC_OD_DistYStd_Obj_40_RR 8;
BA_ "GenSigSendType" SG_ 1125 ARC_OD_VabsXStd_Obj_40_RR 8;
BA_ "GenSigSendType" SG_ 1125 ARC_OD_VabsYStd_Obj_40_RR 8;
BA_ "GenSigSendType" SG_ 1125 ARC_OD_AabsXStd_Obj_40_RR 8;
BA_ "GenSigSendType" SG_ 1124 DistHeight_Obj_39_RR 8;
BA_ "GenSigSendType" SG_ 1124 DistHeight_Obj_38_RR 8;
BA_ "GenSigSendType" SG_ 1124 ARC_OD_DistX_Obj_38_RR 8;
BA_ "GenSigSendType" SG_ 1124 ARC_OD_Classification_Obj_38_RR 8;
BA_ "GenSigSendType" SG_ 1124 ARC_OD_AabsYStd_Obj_38_RR 8;
BA_ "GenSigSendType" SG_ 1124 ARC_OD_ClassConf_Obj_38_RR 8;
BA_ "GenSigSendType" SG_ 1124 ARC_OD_ProbOfExist_Obj_38_RR 8;
BA_ "GenSigSendType" SG_ 1124 ARC_OD_VabsX_Obj_38_RR 8;
BA_ "GenSigSendType" SG_ 1124 ARC_OD_DynProp_Obj_38_RR 8;
BA_ "GenSigSendType" SG_ 1124 ARC_OD_Length_Obj_38_RR 8;
BA_ "GenSigSendType" SG_ 1124 ARC_OD_MaintenanceState_Obj_38_R 8;
BA_ "GenSigSendType" SG_ 1124 ARC_OD_Width_Obj_38_RR 8;
BA_ "GenSigSendType" SG_ 1124 ARC_OD_RCS_Obj_38_RR 8;
BA_ "GenSigSendType" SG_ 1124 ARC_OD_Orientation_Obj_38_RR 8;
BA_ "GenSigSendType" SG_ 1124 ARC_OD_LifeCycle_Obj_38_RR 8;
BA_ "GenSigSendType" SG_ 1124 ARC_OD_DistX_Obj_39_RR 8;
BA_ "GenSigSendType" SG_ 1124 ARC_OD_VabsX_Obj_39_RR 8;
BA_ "GenSigSendType" SG_ 1124 ARC_OD_AabsX_Obj_39_RR 8;
BA_ "GenSigSendType" SG_ 1124 ARC_OD_AabsX_Obj_38_RR 8;
BA_ "GenSigSendType" SG_ 1124 ARC_OD_DistY_Obj_39_RR 8;
BA_ "GenSigSendType" SG_ 1124 ARC_OD_VabsY_Obj_39_RR 8;
BA_ "GenSigSendType" SG_ 1124 ARC_OD_AabsY_Obj_39_RR 8;
BA_ "GenSigSendType" SG_ 1124 ARC_OD_DistXStd_Obj_39_RR 8;
BA_ "GenSigSendType" SG_ 1124 ARC_OD_DistYStd_Obj_39_RR 8;
BA_ "GenSigSendType" SG_ 1124 ARC_OD_VabsXStd_Obj_39_RR 8;
BA_ "GenSigSendType" SG_ 1124 ARC_OD_VabsYStd_Obj_39_RR 8;
BA_ "GenSigSendType" SG_ 1124 ARC_OD_AabsXStd_Obj_39_RR 8;
BA_ "GenSigSendType" SG_ 1124 ARC_OD_Classification_Obj_39_RR 8;
BA_ "GenSigSendType" SG_ 1124 ARC_OD_AabsYStd_Obj_39_RR 8;
BA_ "GenSigSendType" SG_ 1124 ARC_OD_ClassConf_Obj_39_RR 8;
BA_ "GenSigSendType" SG_ 1124 ARC_OD_DistY_Obj_38_RR 8;
BA_ "GenSigSendType" SG_ 1124 ARC_OD_ProbOfExist_Obj_39_RR 8;
BA_ "GenSigSendType" SG_ 1124 ARC_OD_DynProp_Obj_39_RR 8;
BA_ "GenSigSendType" SG_ 1124 ARC_OD_Length_Obj_39_RR 8;
BA_ "GenSigSendType" SG_ 1124 ARC_OD_MaintenanceState_Obj_39_R 8;
BA_ "GenSigSendType" SG_ 1124 ARC_OD_Width_Obj_39_RR 8;
BA_ "GenSigSendType" SG_ 1124 ARC_OD_RCS_Obj_39_RR 8;
BA_ "GenSigSendType" SG_ 1124 ARC_OD_Orientation_Obj_39_RR 8;
BA_ "GenSigSendType" SG_ 1124 ARC_OD_LifeCycle_Obj_39_RR 8;
BA_ "GenSigSendType" SG_ 1124 ARC_OD_ObstacleProb_Obj_38_RR 8;
BA_ "GenSigSendType" SG_ 1124 ARC_OD_ObstacleProb_Obj_39_RR 8;
BA_ "GenSigSendType" SG_ 1124 ARC_OD_VabsY_Obj_38_RR 8;
BA_ "GenSigSendType" SG_ 1124 ARC_OD_ID_38_RR 8;
BA_ "GenSigSendType" SG_ 1124 ARC_OD_ID_39_RR 8;
BA_ "GenSigSendType" SG_ 1124 ARC_OD_MsgCounter_Obj_38_39_RR 8;
BA_ "GenSigSendType" SG_ 1124 ARC_OD_CRC8_Obj_38_39_RR 8;
BA_ "GenSigSendType" SG_ 1124 ARC_OD_AabsY_Obj_38_RR 8;
BA_ "GenSigSendType" SG_ 1124 ARC_OD_DistXStd_Obj_38_RR 8;
BA_ "GenSigSendType" SG_ 1124 ARC_OD_DistYStd_Obj_38_RR 8;
BA_ "GenSigSendType" SG_ 1124 ARC_OD_VabsXStd_Obj_38_RR 8;
BA_ "GenSigSendType" SG_ 1124 ARC_OD_VabsYStd_Obj_38_RR 8;
BA_ "GenSigSendType" SG_ 1124 ARC_OD_AabsXStd_Obj_38_RR 8;
BA_ "GenSigSendType" SG_ 1123 DistHeight_Obj_37_RR 8;
BA_ "GenSigSendType" SG_ 1123 DistHeight_Obj_36_RR 8;
BA_ "GenSigSendType" SG_ 1123 ARC_OD_DistX_Obj_36_RR 8;
BA_ "GenSigSendType" SG_ 1123 ARC_OD_Classification_Obj_36_RR 8;
BA_ "GenSigSendType" SG_ 1123 ARC_OD_AabsYStd_Obj_36_RR 8;
BA_ "GenSigSendType" SG_ 1123 ARC_OD_ClassConf_Obj_36_RR 8;
BA_ "GenSigSendType" SG_ 1123 ARC_OD_ProbOfExist_Obj_36_RR 8;
BA_ "GenSigSendType" SG_ 1123 ARC_OD_VabsX_Obj_36_RR 8;
BA_ "GenSigSendType" SG_ 1123 ARC_OD_DynProp_Obj_36_RR 8;
BA_ "GenSigSendType" SG_ 1123 ARC_OD_Length_Obj_36_RR 8;
BA_ "GenSigSendType" SG_ 1123 ARC_OD_MaintenanceState_Obj_36_R 8;
BA_ "GenSigSendType" SG_ 1123 ARC_OD_Width_Obj_36_RR 8;
BA_ "GenSigSendType" SG_ 1123 ARC_OD_RCS_Obj_36_RR 8;
BA_ "GenSigSendType" SG_ 1123 ARC_OD_Orientation_Obj_36_RR 8;
BA_ "GenSigSendType" SG_ 1123 ARC_OD_LifeCycle_Obj_36_RR 8;
BA_ "GenSigSendType" SG_ 1123 ARC_OD_DistX_Obj_37_RR 8;
BA_ "GenSigSendType" SG_ 1123 ARC_OD_VabsX_Obj_37_RR 8;
BA_ "GenSigSendType" SG_ 1123 ARC_OD_AabsX_Obj_37_RR 8;
BA_ "GenSigSendType" SG_ 1123 ARC_OD_AabsX_Obj_36_RR 8;
BA_ "GenSigSendType" SG_ 1123 ARC_OD_DistY_Obj_37_RR 8;
BA_ "GenSigSendType" SG_ 1123 ARC_OD_VabsY_Obj_37_RR 8;
BA_ "GenSigSendType" SG_ 1123 ARC_OD_AabsY_Obj_37_RR 8;
BA_ "GenSigSendType" SG_ 1123 ARC_OD_DistXStd_Obj_37_RR 8;
BA_ "GenSigSendType" SG_ 1123 ARC_OD_DistYStd_Obj_37_RR 8;
BA_ "GenSigSendType" SG_ 1123 ARC_OD_VabsXStd_Obj_37_RR 8;
BA_ "GenSigSendType" SG_ 1123 ARC_OD_VabsYStd_Obj_37_RR 8;
BA_ "GenSigSendType" SG_ 1123 ARC_OD_AabsXStd_Obj_37_RR 8;
BA_ "GenSigSendType" SG_ 1123 ARC_OD_Classification_Obj_37_RR 8;
BA_ "GenSigSendType" SG_ 1123 ARC_OD_AabsYStd_Obj_37_RR 8;
BA_ "GenSigSendType" SG_ 1123 ARC_OD_ClassConf_Obj_37_RR 8;
BA_ "GenSigSendType" SG_ 1123 ARC_OD_DistY_Obj_36_RR 8;
BA_ "GenSigSendType" SG_ 1123 ARC_OD_ProbOfExist_Obj_37_RR 8;
BA_ "GenSigSendType" SG_ 1123 ARC_OD_DynProp_Obj_37_RR 8;
BA_ "GenSigSendType" SG_ 1123 ARC_OD_Length_Obj_37_RR 8;
BA_ "GenSigSendType" SG_ 1123 ARC_OD_MaintenanceState_Obj_37_R 8;
BA_ "GenSigSendType" SG_ 1123 ARC_OD_Width_Obj_37_RR 8;
BA_ "GenSigSendType" SG_ 1123 ARC_OD_RCS_Obj_37_RR 8;
BA_ "GenSigSendType" SG_ 1123 ARC_OD_Orientation_Obj_37_RR 8;
BA_ "GenSigSendType" SG_ 1123 ARC_OD_LifeCycle_Obj_37_RR 8;
BA_ "GenSigSendType" SG_ 1123 ARC_OD_ObstacleProb_Obj_36_RR 8;
BA_ "GenSigSendType" SG_ 1123 ARC_OD_ObstacleProb_Obj_37_RR 8;
BA_ "GenSigSendType" SG_ 1123 ARC_OD_VabsY_Obj_36_RR 8;
BA_ "GenSigSendType" SG_ 1123 ARC_OD_ID_36_RR 8;
BA_ "GenSigSendType" SG_ 1123 ARC_OD_ID_37_RR 8;
BA_ "GenSigSendType" SG_ 1123 ARC_OD_MsgCounter_Obj_36_37_RR 8;
BA_ "GenSigSendType" SG_ 1123 ARC_OD_CRC8_Obj_36_37_RR 8;
BA_ "GenSigSendType" SG_ 1123 ARC_OD_AabsY_Obj_36_RR 8;
BA_ "GenSigSendType" SG_ 1123 ARC_OD_DistXStd_Obj_36_RR 8;
BA_ "GenSigSendType" SG_ 1123 ARC_OD_DistYStd_Obj_36_RR 8;
BA_ "GenSigSendType" SG_ 1123 ARC_OD_VabsXStd_Obj_36_RR 8;
BA_ "GenSigSendType" SG_ 1123 ARC_OD_VabsYStd_Obj_36_RR 8;
BA_ "GenSigSendType" SG_ 1123 ARC_OD_AabsXStd_Obj_36_RR 8;
BA_ "GenSigSendType" SG_ 1122 DistHeight_Obj_35_RR 8;
BA_ "GenSigSendType" SG_ 1122 DistHeight_Obj_34_RR 8;
BA_ "GenSigSendType" SG_ 1122 ARC_OD_DistX_Obj_34_RR 8;
BA_ "GenSigSendType" SG_ 1122 ARC_OD_Classification_Obj_34_RR 8;
BA_ "GenSigSendType" SG_ 1122 ARC_OD_AabsYStd_Obj_34_RR 8;
BA_ "GenSigSendType" SG_ 1122 ARC_OD_ClassConf_Obj_34_RR 8;
BA_ "GenSigSendType" SG_ 1122 ARC_OD_ProbOfExist_Obj_34_RR 8;
BA_ "GenSigSendType" SG_ 1122 ARC_OD_VabsX_Obj_34_RR 8;
BA_ "GenSigSendType" SG_ 1122 ARC_OD_DynProp_Obj_34_RR 8;
BA_ "GenSigSendType" SG_ 1122 ARC_OD_Length_Obj_34_RR 8;
BA_ "GenSigSendType" SG_ 1122 ARC_OD_MaintenanceState_Obj_34_R 8;
BA_ "GenSigSendType" SG_ 1122 ARC_OD_Width_Obj_34_RR 8;
BA_ "GenSigSendType" SG_ 1122 ARC_OD_RCS_Obj_34_RR 8;
BA_ "GenSigSendType" SG_ 1122 ARC_OD_Orientation_Obj_34_RR 8;
BA_ "GenSigSendType" SG_ 1122 ARC_OD_LifeCycle_Obj_34_RR 8;
BA_ "GenSigSendType" SG_ 1122 ARC_OD_DistX_Obj_35_RR 8;
BA_ "GenSigSendType" SG_ 1122 ARC_OD_VabsX_Obj_35_RR 8;
BA_ "GenSigSendType" SG_ 1122 ARC_OD_AabsX_Obj_35_RR 8;
BA_ "GenSigSendType" SG_ 1122 ARC_OD_AabsX_Obj_34_RR 8;
BA_ "GenSigSendType" SG_ 1122 ARC_OD_DistY_Obj_35_RR 8;
BA_ "GenSigSendType" SG_ 1122 ARC_OD_VabsY_Obj_35_RR 8;
BA_ "GenSigSendType" SG_ 1122 ARC_OD_AabsY_Obj_35_RR 8;
BA_ "GenSigSendType" SG_ 1122 ARC_OD_DistXStd_Obj_35_RR 8;
BA_ "GenSigSendType" SG_ 1122 ARC_OD_DistYStd_Obj_35_RR 8;
BA_ "GenSigSendType" SG_ 1122 ARC_OD_VabsXStd_Obj_35_RR 8;
BA_ "GenSigSendType" SG_ 1122 ARC_OD_VabsYStd_Obj_35_RR 8;
BA_ "GenSigSendType" SG_ 1122 ARC_OD_AabsXStd_Obj_35_RR 8;
BA_ "GenSigSendType" SG_ 1122 ARC_OD_Classification_Obj_35_RR 8;
BA_ "GenSigSendType" SG_ 1122 ARC_OD_AabsYStd_Obj_35_RR 8;
BA_ "GenSigSendType" SG_ 1122 ARC_OD_ClassConf_Obj_35_RR 8;
BA_ "GenSigSendType" SG_ 1122 ARC_OD_DistY_Obj_34_RR 8;
BA_ "GenSigSendType" SG_ 1122 ARC_OD_ProbOfExist_Obj_35_RR 8;
BA_ "GenSigSendType" SG_ 1122 ARC_OD_DynProp_Obj_35_RR 8;
BA_ "GenSigSendType" SG_ 1122 ARC_OD_Length_Obj_35_RR 8;
BA_ "GenSigSendType" SG_ 1122 ARC_OD_MaintenanceState_Obj_35_R 8;
BA_ "GenSigSendType" SG_ 1122 ARC_OD_Width_Obj_35_RR 8;
BA_ "GenSigSendType" SG_ 1122 ARC_OD_RCS_Obj_35_RR 8;
BA_ "GenSigSendType" SG_ 1122 ARC_OD_Orientation_Obj_35_RR 8;
BA_ "GenSigSendType" SG_ 1122 ARC_OD_LifeCycle_Obj_35_RR 8;
BA_ "GenSigSendType" SG_ 1122 ARC_OD_ObstacleProb_Obj_34_RR 8;
BA_ "GenSigSendType" SG_ 1122 ARC_OD_ObstacleProb_Obj_35_RR 8;
BA_ "GenSigSendType" SG_ 1122 ARC_OD_VabsY_Obj_34_RR 8;
BA_ "GenSigSendType" SG_ 1122 ARC_OD_ID_34_RR 8;
BA_ "GenSigSendType" SG_ 1122 ARC_OD_ID_35_RR 8;
BA_ "GenSigSendType" SG_ 1122 ARC_OD_MsgCounter_Obj_34_35_RR 8;
BA_ "GenSigSendType" SG_ 1122 ARC_OD_CRC8_Obj_34_35_RR 8;
BA_ "GenSigSendType" SG_ 1122 ARC_OD_AabsY_Obj_34_RR 8;
BA_ "GenSigSendType" SG_ 1122 ARC_OD_DistXStd_Obj_34_RR 8;
BA_ "GenSigSendType" SG_ 1122 ARC_OD_DistYStd_Obj_34_RR 8;
BA_ "GenSigSendType" SG_ 1122 ARC_OD_VabsXStd_Obj_34_RR 8;
BA_ "GenSigSendType" SG_ 1122 ARC_OD_VabsYStd_Obj_34_RR 8;
BA_ "GenSigSendType" SG_ 1122 ARC_OD_AabsXStd_Obj_34_RR 8;
VAL_ 1372 ARC_OD_Classification_Obj_22_FR 0 "Unknow" 1 "Person" 2 "Bimo" 3 "Car" 4 "Truck" 5 "Barrier" 6 "Reserved" 7 "Reserved";
VAL_ 1372 ARC_OD_DynProp_Obj_22_FR 0 "MOVING" 1 "STATIONARY" 2 "ONCOMING" 3 "CROSSING_LEFT2RIGHT" 4 "CROSSING_RIGHT2LEFT" 5 "UNKNOWN" 6 "STOPPED" 7 "RESERVED";
VAL_ 1372 ARC_OD_MaintenanceState_Obj_0037 0 "INVALID" 1 "NEW" 2 "MEASURED" 3 "PREDICTED";
VAL_ 1372 ARC_OD_Classification_Obj_23_FR 0 "Unknow" 1 "Person" 2 "Bimo" 3 "Car" 4 "Truck" 5 "Barrier" 6 "Reserved" 7 "Reserved";
VAL_ 1372 ARC_OD_DynProp_Obj_23_FR 0 "STATIONAR" 1 "MOVIN" 2 "ONCOMING" 3 "STOPPE" 4 "CROSSING_LEFT2RIGH" 5 "CROSSING_RIGHT2LEF" 6 "RESERVE" 7 "RESERVED";
VAL_ 1372 ARC_OD_MaintenanceState_Obj_0038 0 "INVALID" 1 "NEW" 2 "MEASURED" 3 "PREDICTED";
VAL_ 1371 ARC_OD_Classification_Obj_20_FR 0 "Unknow" 1 "Person" 2 "Bimo" 3 "Car" 4 "Truck" 5 "Barrier" 6 "Reserved" 7 "Reserved";
VAL_ 1371 ARC_OD_DynProp_Obj_20_FR 0 "MOVING" 1 "STATIONARY" 2 "ONCOMING" 3 "CROSSING_LEFT2RIGHT" 4 "CROSSING_RIGHT2LEFT" 5 "UNKNOWN" 6 "STOPPED" 7 "RESERVED";
VAL_ 1371 ARC_OD_MaintenanceState_Obj_0039 0 "INVALID" 1 "NEW" 2 "MEASURED" 3 "PREDICTED";
VAL_ 1371 ARC_OD_Classification_Obj_21_FR 0 "Unknow" 1 "Person" 2 "Bimo" 3 "Car" 4 "Truck" 5 "Barrier" 6 "Reserved" 7 "Reserved";
VAL_ 1371 ARC_OD_DynProp_Obj_21_FR 0 "STATIONAR" 1 "MOVIN" 2 "ONCOMING" 3 "STOPPE" 4 "CROSSING_LEFT2RIGH" 5 "CROSSING_RIGHT2LEF" 6 "RESERVE" 7 "RESERVED";
VAL_ 1371 ARC_OD_MaintenanceState_Obj_0040 0 "INVALID" 1 "NEW" 2 "MEASURED" 3 "PREDICTED";
VAL_ 1370 ARC_OD_Classification_Obj_18_FR 0 "Unknow" 1 "Person" 2 "Bimo" 3 "Car" 4 "Truck" 5 "Barrier" 6 "Reserved" 7 "Reserved";
VAL_ 1370 ARC_OD_DynProp_Obj_18_FR 0 "MOVING" 1 "STATIONARY" 2 "ONCOMING" 3 "CROSSING_LEFT2RIGHT" 4 "CROSSING_RIGHT2LEFT" 5 "UNKNOWN" 6 "STOPPED" 7 "RESERVED";
VAL_ 1370 ARC_OD_MaintenanceState_Obj_0041 0 "INVALID" 1 "NEW" 2 "MEASURED" 3 "PREDICTED";
VAL_ 1370 ARC_OD_Classification_Obj_19_FR 0 "Unknow" 1 "Person" 2 "Bimo" 3 "Car" 4 "Truck" 5 "Barrier" 6 "Reserved" 7 "Reserved";
VAL_ 1370 ARC_OD_DynProp_Obj_19_FR 0 "STATIONAR" 1 "MOVIN" 2 "ONCOMING" 3 "STOPPE" 4 "CROSSING_LEFT2RIGH" 5 "CROSSING_RIGHT2LEF" 6 "RESERVE" 7 "RESERVED";
VAL_ 1370 ARC_OD_MaintenanceState_Obj_0042 0 "INVALID" 1 "NEW" 2 "MEASURED" 3 "PREDICTED";
VAL_ 1369 ARC_OD_Classification_Obj_16_FR 0 "Unknow" 1 "Person" 2 "Bimo" 3 "Car" 4 "Truck" 5 "Barrier" 6 "Reserved" 7 "Reserved";
VAL_ 1369 ARC_OD_DynProp_Obj_16_FR 0 "MOVING" 1 "STATIONARY" 2 "ONCOMING" 3 "CROSSING_LEFT2RIGHT" 4 "CROSSING_RIGHT2LEFT" 5 "UNKNOWN" 6 "STOPPED" 7 "RESERVED";
VAL_ 1369 ARC_OD_MaintenanceState_Obj_0043 0 "INVALID" 1 "NEW" 2 "MEASURED" 3 "PREDICTED";
VAL_ 1369 ARC_OD_Classification_Obj_17_FR 0 "Unknow" 1 "Person" 2 "Bimo" 3 "Car" 4 "Truck" 5 "Barrier" 6 "Reserved" 7 "Reserved";
VAL_ 1369 ARC_OD_DynProp_Obj_17_FR 0 "STATIONAR" 1 "MOVIN" 2 "ONCOMING" 3 "STOPPE" 4 "CROSSING_LEFT2RIGH" 5 "CROSSING_RIGHT2LEF" 6 "RESERVE" 7 "RESERVED";
VAL_ 1369 ARC_OD_MaintenanceState_Obj_0044 0 "INVALID" 1 "NEW" 2 "MEASURED" 3 "PREDICTED";
VAL_ 1368 ARC_OD_Classification_Obj_14_FR 0 "Unknow" 1 "Person" 2 "Bimo" 3 "Car" 4 "Truck" 5 "Barrier" 6 "Reserved" 7 "Reserved";
VAL_ 1368 ARC_OD_DynProp_Obj_14_FR 0 "MOVING" 1 "STATIONARY" 2 "ONCOMING" 3 "CROSSING_LEFT2RIGHT" 4 "CROSSING_RIGHT2LEFT" 5 "UNKNOWN" 6 "STOPPED" 7 "RESERVED";
VAL_ 1368 ARC_OD_MaintenanceState_Obj_0045 0 "INVALID" 1 "NEW" 2 "MEASURED" 3 "PREDICTED";
VAL_ 1368 ARC_OD_Classification_Obj_15_FR 0 "Unknow" 1 "Person" 2 "Bimo" 3 "Car" 4 "Truck" 5 "Barrier" 6 "Reserved" 7 "Reserved";
VAL_ 1368 ARC_OD_DynProp_Obj_15_FR 0 "STATIONAR" 1 "MOVIN" 2 "ONCOMING" 3 "STOPPE" 4 "CROSSING_LEFT2RIGH" 5 "CROSSING_RIGHT2LEF" 6 "RESERVE" 7 "RESERVED";
VAL_ 1368 ARC_OD_MaintenanceState_Obj_0046 0 "INVALID" 1 "NEW" 2 "MEASURED" 3 "PREDICTED";
VAL_ 1367 ARC_OD_Classification_Obj_12_FR 0 "Unknow" 1 "Person" 2 "Bimo" 3 "Car" 4 "Truck" 5 "Barrier" 6 "Reserved" 7 "Reserved";
VAL_ 1367 ARC_OD_DynProp_Obj_12_FR 0 "MOVING" 1 "STATIONARY" 2 "ONCOMING" 3 "CROSSING_LEFT2RIGHT" 4 "CROSSING_RIGHT2LEFT" 5 "UNKNOWN" 6 "STOPPED" 7 "RESERVED";
VAL_ 1367 ARC_OD_MaintenanceState_Obj_0047 0 "INVALID" 1 "NEW" 2 "MEASURED" 3 "PREDICTED";
VAL_ 1367 ARC_OD_Classification_Obj_13_FR 0 "Unknow" 1 "Person" 2 "Bimo" 3 "Car" 4 "Truck" 5 "Barrier" 6 "Reserved" 7 "Reserved";
VAL_ 1367 ARC_OD_DynProp_Obj_13_FR 0 "STATIONAR" 1 "MOVIN" 2 "ONCOMING" 3 "STOPPE" 4 "CROSSING_LEFT2RIGH" 5 "CROSSING_RIGHT2LEF" 6 "RESERVE" 7 "RESERVED";
VAL_ 1367 ARC_OD_MaintenanceState_Obj_0048 0 "INVALID" 1 "NEW" 2 "MEASURED" 3 "PREDICTED";
VAL_ 1366 ARC_OD_Classification_Obj_10_FR 0 "Unknow" 1 "Person" 2 "Bimo" 3 "Car" 4 "Truck" 5 "Barrier" 6 "Reserved" 7 "Reserved";
VAL_ 1366 ARC_OD_DynProp_Obj_10_FR 0 "MOVING" 1 "STATIONARY" 2 "ONCOMING" 3 "CROSSING_LEFT2RIGHT" 4 "CROSSING_RIGHT2LEFT" 5 "UNKNOWN" 6 "STOPPED" 7 "RESERVED";
VAL_ 1366 ARC_OD_MaintenanceState_Obj_0049 0 "INVALID" 1 "NEW" 2 "MEASURED" 3 "PREDICTED";
VAL_ 1366 ARC_OD_Classification_Obj_11_FR 0 "Unknow" 1 "Person" 2 "Bimo" 3 "Car" 4 "Truck" 5 "Barrier" 6 "Reserved" 7 "Reserved";
VAL_ 1366 ARC_OD_DynProp_Obj_11_FR 0 "STATIONAR" 1 "MOVIN" 2 "ONCOMING" 3 "STOPPE" 4 "CROSSING_LEFT2RIGH" 5 "CROSSING_RIGHT2LEF" 6 "RESERVE" 7 "RESERVED";
VAL_ 1366 ARC_OD_MaintenanceState_Obj_0050 0 "INVALID" 1 "NEW" 2 "MEASURED" 3 "PREDICTED";
VAL_ 1365 ARC_OD_Classification_Obj_08_FR 0 "Unknow" 1 "Person" 2 "Bimo" 3 "Car" 4 "Truck" 5 "Barrier" 6 "Reserved" 7 "Reserved";
VAL_ 1365 ARC_OD_DynProp_Obj_08_FR 0 "MOVING" 1 "STATIONARY" 2 "ONCOMING" 3 "CROSSING_LEFT2RIGHT" 4 "CROSSING_RIGHT2LEFT" 5 "UNKNOWN" 6 "STOPPED" 7 "RESERVED";
VAL_ 1365 ARC_OD_MaintenanceState_Obj_0051 0 "INVALID" 1 "NEW" 2 "MEASURED" 3 "PREDICTED";
VAL_ 1365 ARC_OD_Classification_Obj_09_FR 0 "Unknow" 1 "Person" 2 "Bimo" 3 "Car" 4 "Truck" 5 "Barrier" 6 "Reserved" 7 "Reserved";
VAL_ 1365 ARC_OD_DynProp_Obj_09_FR 0 "STATIONAR" 1 "MOVIN" 2 "ONCOMING" 3 "STOPPE" 4 "CROSSING_LEFT2RIGH" 5 "CROSSING_RIGHT2LEF" 6 "RESERVE" 7 "RESERVED";
VAL_ 1365 ARC_OD_MaintenanceState_Obj_0052 0 "INVALID" 1 "NEW" 2 "MEASURED" 3 "PREDICTED";
VAL_ 1364 ARC_OD_Classification_Obj_06_FR 0 "Unknow" 1 "Person" 2 "Bimo" 3 "Car" 4 "Truck" 5 "Barrier" 6 "Reserved" 7 "Reserved";
VAL_ 1364 ARC_OD_DynProp_Obj_06_FR 0 "MOVING" 1 "STATIONARY" 2 "ONCOMING" 3 "CROSSING_LEFT2RIGHT" 4 "CROSSING_RIGHT2LEFT" 5 "UNKNOWN" 6 "STOPPED" 7 "RESERVED";
VAL_ 1364 ARC_OD_MaintenanceState_Obj_0053 0 "INVALID" 1 "NEW" 2 "MEASURED" 3 "PREDICTED";
VAL_ 1364 ARC_OD_Classification_Obj_07_FR 0 "Unknow" 1 "Person" 2 "Bimo" 3 "Car" 4 "Truck" 5 "Barrier" 6 "Reserved" 7 "Reserved";
VAL_ 1364 ARC_OD_DynProp_Obj_07_FR 0 "STATIONAR" 1 "MOVIN" 2 "ONCOMING" 3 "STOPPE" 4 "CROSSING_LEFT2RIGH" 5 "CROSSING_RIGHT2LEF" 6 "RESERVE" 7 "RESERVED";
VAL_ 1364 ARC_OD_MaintenanceState_Obj_0054 0 "INVALID" 1 "NEW" 2 "MEASURED" 3 "PREDICTED";
VAL_ 1363 ARC_OD_Classification_Obj_04_FR 0 "Unknow" 1 "Person" 2 "Bimo" 3 "Car" 4 "Truck" 5 "Barrier" 6 "Reserved" 7 "Reserved";
VAL_ 1363 ARC_OD_DynProp_Obj_04_FR 0 "MOVING" 1 "STATIONARY" 2 "ONCOMING" 3 "CROSSING_LEFT2RIGHT" 4 "CROSSING_RIGHT2LEFT" 5 "UNKNOWN" 6 "STOPPED" 7 "RESERVED";
VAL_ 1363 ARC_OD_MaintenanceState_Obj_0055 0 "INVALID" 1 "NEW" 2 "MEASURED" 3 "PREDICTED";
VAL_ 1363 ARC_OD_Classification_Obj_05_FR 0 "Unknow" 1 "Person" 2 "Bimo" 3 "Car" 4 "Truck" 5 "Barrier" 6 "Reserved" 7 "Reserved";
VAL_ 1363 ARC_OD_DynProp_Obj_05_FR 0 "STATIONAR" 1 "MOVIN" 2 "ONCOMING" 3 "STOPPE" 4 "CROSSING_LEFT2RIGH" 5 "CROSSING_RIGHT2LEF" 6 "RESERVE" 7 "RESERVED";
VAL_ 1363 ARC_OD_MaintenanceState_Obj_0056 0 "INVALID" 1 "NEW" 2 "MEASURED" 3 "PREDICTED";
VAL_ 1362 ARC_OD_Classification_Obj_02_FR 0 "Unknow" 1 "Person" 2 "Bimo" 3 "Car" 4 "Truck" 5 "Barrier" 6 "Reserved" 7 "Reserved";
VAL_ 1362 ARC_OD_DynProp_Obj_02_FR 0 "MOVING" 1 "STATIONARY" 2 "ONCOMING" 3 "CROSSING_LEFT2RIGHT" 4 "CROSSING_RIGHT2LEFT" 5 "UNKNOWN" 6 "STOPPED" 7 "RESERVED";
VAL_ 1362 ARC_OD_MaintenanceState_Obj_0057 0 "INVALID" 1 "NEW" 2 "MEASURED" 3 "PREDICTED";
VAL_ 1362 ARC_OD_Classification_Obj_03_FR 0 "Unknow" 1 "Person" 2 "Bimo" 3 "Car" 4 "Truck" 5 "Barrier" 6 "Reserved" 7 "Reserved";
VAL_ 1362 ARC_OD_DynProp_Obj_03_FR 0 "STATIONAR" 1 "MOVIN" 2 "ONCOMING" 3 "STOPPE" 4 "CROSSING_LEFT2RIGH" 5 "CROSSING_RIGHT2LEF" 6 "RESERVE" 7 "RESERVED";
VAL_ 1362 ARC_OD_MaintenanceState_Obj_0058 0 "INVALID" 1 "NEW" 2 "MEASURED" 3 "PREDICTED";
VAL_ 1361 ARC_OD_Classification_Obj_00_FR 0 "Unknow" 1 "Person" 2 "Bimo" 3 "Car" 4 "Truck" 5 "Barrier" 6 "Reserved" 7 "Reserved";
VAL_ 1361 ARC_OD_DynProp_Obj_00_FR 0 "MOVING" 1 "STATIONARY" 2 "ONCOMING" 3 "CROSSING_LEFT2RIGHT" 4 "CROSSING_RIGHT2LEFT" 5 "UNKNOWN" 6 "STOPPED" 7 "RESERVED";
VAL_ 1361 ARC_OD_MaintenanceState_Obj_0059 0 "INVALID" 1 "NEW" 2 "MEASURED" 3 "PREDICTED";
VAL_ 1361 ARC_OD_Classification_Obj_01_FR 0 "Unknow" 1 "Person" 2 "Bimo" 3 "Car" 4 "Truck" 5 "Barrier" 6 "Reserved" 7 "Reserved";
VAL_ 1361 ARC_OD_DynProp_Obj_01_FR 0 "STATIONAR" 1 "MOVIN" 2 "ONCOMING" 3 "STOPPE" 4 "CROSSING_LEFT2RIGH" 5 "CROSSING_RIGHT2LEF" 6 "RESERVE" 7 "RESERVED";
VAL_ 1361 ARC_OD_MaintenanceState_Obj_0060 0 "INVALID" 1 "NEW" 2 "MEASURED" 3 "PREDICTED";
VAL_ 1134 ARC_OD_Classification_Obj_58_RR 0 "POINT" 1 "CAR" 2 "TRUCK" 3 "PEDESTRIAN" 4 "MOTORCYCLE" 5 "BICYCLE" 6 "WIDE" 7 "UNCLASSIFIED";
VAL_ 1134 ARC_OD_DynProp_Obj_58_RR 0 "MOVING" 1 "STATIONARY" 2 "ONCOMING" 3 "CROSSING_LEFT2RIGHT" 4 "CROSSING_RIGHT2LEFT" 5 "UNKNOWN" 6 "STOPPED" 7 "RESERVED";
VAL_ 1134 ARC_OD_MaintenanceState_Obj_58_R 0 "INVALID" 1 "NEW" 2 "MEASURED" 3 "PREDICTED";
VAL_ 1134 ARC_OD_Classification_Obj_59_RR 0 "POINT" 1 "CAR" 2 "TRUCK" 3 "PEDESTRIAN" 4 "MOTORCYCLE" 5 "BICYCLE" 6 "WIDE" 7 "UNCLASSIFIED";
VAL_ 1134 ARC_OD_DynProp_Obj_59_RR 0 "STATIONAR" 1 "MOVIN" 2 "ONCOMING" 3 "STOPPE" 4 "CROSSING_LEFT2RIGH" 5 "CROSSING_RIGHT2LEF" 6 "RESERVE" 7 "RESERVED";
VAL_ 1134 ARC_OD_MaintenanceState_Obj_59_R 0 "INVALID" 1 "NEW" 2 "MEASURED" 3 "PREDICTED";
VAL_ 1133 ARC_OD_Classification_Obj_56_RR 0 "POINT" 1 "CAR" 2 "TRUCK" 3 "PEDESTRIAN" 4 "MOTORCYCLE" 5 "BICYCLE" 6 "WIDE" 7 "UNCLASSIFIED";
VAL_ 1133 ARC_OD_DynProp_Obj_56_RR 0 "MOVING" 1 "STATIONARY" 2 "ONCOMING" 3 "CROSSING_LEFT2RIGHT" 4 "CROSSING_RIGHT2LEFT" 5 "UNKNOWN" 6 "STOPPED" 7 "RESERVED";
VAL_ 1133 ARC_OD_MaintenanceState_Obj_56_R 0 "INVALID" 1 "NEW" 2 "MEASURED" 3 "PREDICTED";
VAL_ 1133 ARC_OD_Classification_Obj_57_RR 0 "POINT" 1 "CAR" 2 "TRUCK" 3 "PEDESTRIAN" 4 "MOTORCYCLE" 5 "BICYCLE" 6 "WIDE" 7 "UNCLASSIFIED";
VAL_ 1133 ARC_OD_DynProp_Obj_57_RR 0 "STATIONAR" 1 "MOVIN" 2 "ONCOMING" 3 "STOPPE" 4 "CROSSING_LEFT2RIGH" 5 "CROSSING_RIGHT2LEF" 6 "RESERVE" 7 "RESERVED";
VAL_ 1133 ARC_OD_MaintenanceState_Obj_57_R 0 "INVALID" 1 "NEW" 2 "MEASURED" 3 "PREDICTED";
VAL_ 1132 ARC_OD_Classification_Obj_54_RR 0 "POINT" 1 "CAR" 2 "TRUCK" 3 "PEDESTRIAN" 4 "MOTORCYCLE" 5 "BICYCLE" 6 "WIDE" 7 "UNCLASSIFIED";
VAL_ 1132 ARC_OD_DynProp_Obj_54_RR 0 "MOVING" 1 "STATIONARY" 2 "ONCOMING" 3 "CROSSING_LEFT2RIGHT" 4 "CROSSING_RIGHT2LEFT" 5 "UNKNOWN" 6 "STOPPED" 7 "RESERVED";
VAL_ 1132 ARC_OD_MaintenanceState_Obj_54_R 0 "INVALID" 1 "NEW" 2 "MEASURED" 3 "PREDICTED";
VAL_ 1132 ARC_OD_Classification_Obj_55_RR 0 "POINT" 1 "CAR" 2 "TRUCK" 3 "PEDESTRIAN" 4 "MOTORCYCLE" 5 "BICYCLE" 6 "WIDE" 7 "UNCLASSIFIED";
VAL_ 1132 ARC_OD_DynProp_Obj_55_RR 0 "STATIONAR" 1 "MOVIN" 2 "ONCOMING" 3 "STOPPE" 4 "CROSSING_LEFT2RIGH" 5 "CROSSING_RIGHT2LEF" 6 "RESERVE" 7 "RESERVED";
VAL_ 1132 ARC_OD_MaintenanceState_Obj_55_R 0 "INVALID" 1 "NEW" 2 "MEASURED" 3 "PREDICTED";
VAL_ 1131 ARC_OD_Classification_Obj_52_RR 0 "POINT" 1 "CAR" 2 "TRUCK" 3 "PEDESTRIAN" 4 "MOTORCYCLE" 5 "BICYCLE" 6 "WIDE" 7 "UNCLASSIFIED";
VAL_ 1131 ARC_OD_DynProp_Obj_52_RR 0 "MOVING" 1 "STATIONARY" 2 "ONCOMING" 3 "CROSSING_LEFT2RIGHT" 4 "CROSSING_RIGHT2LEFT" 5 "UNKNOWN" 6 "STOPPED" 7 "RESERVED";
VAL_ 1131 ARC_OD_MaintenanceState_Obj_52_R 0 "INVALID" 1 "NEW" 2 "MEASURED" 3 "PREDICTED";
VAL_ 1131 ARC_OD_Classification_Obj_53_RR 0 "POINT" 1 "CAR" 2 "TRUCK" 3 "PEDESTRIAN" 4 "MOTORCYCLE" 5 "BICYCLE" 6 "WIDE" 7 "UNCLASSIFIED";
VAL_ 1131 ARC_OD_DynProp_Obj_53_RR 0 "STATIONAR" 1 "MOVIN" 2 "ONCOMING" 3 "STOPPE" 4 "CROSSING_LEFT2RIGH" 5 "CROSSING_RIGHT2LEF" 6 "RESERVE" 7 "RESERVED";
VAL_ 1131 ARC_OD_MaintenanceState_Obj_53_R 0 "INVALID" 1 "NEW" 2 "MEASURED" 3 "PREDICTED";
VAL_ 1130 ARC_OD_Classification_Obj_50_RR 0 "POINT" 1 "CAR" 2 "TRUCK" 3 "PEDESTRIAN" 4 "MOTORCYCLE" 5 "BICYCLE" 6 "WIDE" 7 "UNCLASSIFIED";
VAL_ 1130 ARC_OD_DynProp_Obj_50_RR 0 "MOVING" 1 "STATIONARY" 2 "ONCOMING" 3 "CROSSING_LEFT2RIGHT" 4 "CROSSING_RIGHT2LEFT" 5 "UNKNOWN" 6 "STOPPED" 7 "RESERVED";
VAL_ 1130 ARC_OD_MaintenanceState_Obj_50_R 0 "INVALID" 1 "NEW" 2 "MEASURED" 3 "PREDICTED";
VAL_ 1130 ARC_OD_Classification_Obj_51_RR 0 "POINT" 1 "CAR" 2 "TRUCK" 3 "PEDESTRIAN" 4 "MOTORCYCLE" 5 "BICYCLE" 6 "WIDE" 7 "UNCLASSIFIED";
VAL_ 1130 ARC_OD_DynProp_Obj_51_RR 0 "STATIONAR" 1 "MOVIN" 2 "ONCOMING" 3 "STOPPE" 4 "CROSSING_LEFT2RIGH" 5 "CROSSING_RIGHT2LEF" 6 "RESERVE" 7 "RESERVED";
VAL_ 1130 ARC_OD_MaintenanceState_Obj_51_R 0 "INVALID" 1 "NEW" 2 "MEASURED" 3 "PREDICTED";
VAL_ 1129 ARC_OD_Classification_Obj_48_RR 0 "POINT" 1 "CAR" 2 "TRUCK" 3 "PEDESTRIAN" 4 "MOTORCYCLE" 5 "BICYCLE" 6 "WIDE" 7 "UNCLASSIFIED";
VAL_ 1129 ARC_OD_DynProp_Obj_48_RR 0 "MOVING" 1 "STATIONARY" 2 "ONCOMING" 3 "CROSSING_LEFT2RIGHT" 4 "CROSSING_RIGHT2LEFT" 5 "UNKNOWN" 6 "STOPPED" 7 "RESERVED";
VAL_ 1129 ARC_OD_MaintenanceState_Obj_48_R 0 "INVALID" 1 "NEW" 2 "MEASURED" 3 "PREDICTED";
VAL_ 1129 ARC_OD_Classification_Obj_49_RR 0 "POINT" 1 "CAR" 2 "TRUCK" 3 "PEDESTRIAN" 4 "MOTORCYCLE" 5 "BICYCLE" 6 "WIDE" 7 "UNCLASSIFIED";
VAL_ 1129 ARC_OD_DynProp_Obj_49_RR 0 "STATIONAR" 1 "MOVIN" 2 "ONCOMING" 3 "STOPPE" 4 "CROSSING_LEFT2RIGH" 5 "CROSSING_RIGHT2LEF" 6 "RESERVE" 7 "RESERVED";
VAL_ 1129 ARC_OD_MaintenanceState_Obj_49_R 0 "INVALID" 1 "NEW" 2 "MEASURED" 3 "PREDICTED";
VAL_ 1128 ARC_OD_Classification_Obj_46_RR 0 "POINT" 1 "CAR" 2 "TRUCK" 3 "PEDESTRIAN" 4 "MOTORCYCLE" 5 "BICYCLE" 6 "WIDE" 7 "UNCLASSIFIED";
VAL_ 1128 ARC_OD_DynProp_Obj_46_RR 0 "MOVING" 1 "STATIONARY" 2 "ONCOMING" 3 "CROSSING_LEFT2RIGHT" 4 "CROSSING_RIGHT2LEFT" 5 "UNKNOWN" 6 "STOPPED" 7 "RESERVED";
VAL_ 1128 ARC_OD_MaintenanceState_Obj_46_R 0 "INVALID" 1 "NEW" 2 "MEASURED" 3 "PREDICTED";
VAL_ 1128 ARC_OD_Classification_Obj_47_RR 0 "POINT" 1 "CAR" 2 "TRUCK" 3 "PEDESTRIAN" 4 "MOTORCYCLE" 5 "BICYCLE" 6 "WIDE" 7 "UNCLASSIFIED";
VAL_ 1128 ARC_OD_DynProp_Obj_47_RR 0 "STATIONAR" 1 "MOVIN" 2 "ONCOMING" 3 "STOPPE" 4 "CROSSING_LEFT2RIGH" 5 "CROSSING_RIGHT2LEF" 6 "RESERVE" 7 "RESERVED";
VAL_ 1128 ARC_OD_MaintenanceState_Obj_47_R 0 "INVALID" 1 "NEW" 2 "MEASURED" 3 "PREDICTED";
VAL_ 1127 ARC_OD_Classification_Obj_44_RR 0 "POINT" 1 "CAR" 2 "TRUCK" 3 "PEDESTRIAN" 4 "MOTORCYCLE" 5 "BICYCLE" 6 "WIDE" 7 "UNCLASSIFIED";
VAL_ 1127 ARC_OD_DynProp_Obj_44_RR 0 "MOVING" 1 "STATIONARY" 2 "ONCOMING" 3 "CROSSING_LEFT2RIGHT" 4 "CROSSING_RIGHT2LEFT" 5 "UNKNOWN" 6 "STOPPED" 7 "RESERVED";
VAL_ 1127 ARC_OD_MaintenanceState_Obj_44_R 0 "INVALID" 1 "NEW" 2 "MEASURED" 3 "PREDICTED";
VAL_ 1127 ARC_OD_Classification_Obj_45_RR 0 "POINT" 1 "CAR" 2 "TRUCK" 3 "PEDESTRIAN" 4 "MOTORCYCLE" 5 "BICYCLE" 6 "WIDE" 7 "UNCLASSIFIED";
VAL_ 1127 ARC_OD_DynProp_Obj_45_RR 0 "STATIONAR" 1 "MOVIN" 2 "ONCOMING" 3 "STOPPE" 4 "CROSSING_LEFT2RIGH" 5 "CROSSING_RIGHT2LEF" 6 "RESERVE" 7 "RESERVED";
VAL_ 1127 ARC_OD_MaintenanceState_Obj_45_R 0 "INVALID" 1 "NEW" 2 "MEASURED" 3 "PREDICTED";
VAL_ 1126 ARC_OD_Classification_Obj_42_RR 0 "POINT" 1 "CAR" 2 "TRUCK" 3 "PEDESTRIAN" 4 "MOTORCYCLE" 5 "BICYCLE" 6 "WIDE" 7 "UNCLASSIFIED";
VAL_ 1126 ARC_OD_DynProp_Obj_42_RR 0 "MOVING" 1 "STATIONARY" 2 "ONCOMING" 3 "CROSSING_LEFT2RIGHT" 4 "CROSSING_RIGHT2LEFT" 5 "UNKNOWN" 6 "STOPPED" 7 "RESERVED";
VAL_ 1126 ARC_OD_MaintenanceState_Obj_42_R 0 "INVALID" 1 "NEW" 2 "MEASURED" 3 "PREDICTED";
VAL_ 1126 ARC_OD_Classification_Obj_43_RR 0 "POINT" 1 "CAR" 2 "TRUCK" 3 "PEDESTRIAN" 4 "MOTORCYCLE" 5 "BICYCLE" 6 "WIDE" 7 "UNCLASSIFIED";
VAL_ 1126 ARC_OD_DynProp_Obj_43_RR 0 "STATIONAR" 1 "MOVIN" 2 "ONCOMING" 3 "STOPPE" 4 "CROSSING_LEFT2RIGH" 5 "CROSSING_RIGHT2LEF" 6 "RESERVE" 7 "RESERVED";
VAL_ 1126 ARC_OD_MaintenanceState_Obj_43_R 0 "INVALID" 1 "NEW" 2 "MEASURED" 3 "PREDICTED";
VAL_ 1125 ARC_OD_Classification_Obj_40_RR 0 "Unknow" 1 "Person" 2 "Bimo" 3 "Car" 4 "Truck" 5 "Barrier" 6 "Reserved" 7 "Reserved";
VAL_ 1125 ARC_OD_DynProp_Obj_40_RR 0 "MOVING" 1 "STATIONARY" 2 "ONCOMING" 3 "CROSSING_LEFT2RIGHT" 4 "CROSSING_RIGHT2LEFT" 5 "UNKNOWN" 6 "STOPPED" 7 "RESERVED";
VAL_ 1125 ARC_OD_MaintenanceState_Obj_40_R 0 "INVALID" 1 "NEW" 2 "MEASURED" 3 "PREDICTED";
VAL_ 1125 ARC_OD_Classification_Obj_41_RR 0 "Unknow" 1 "Person" 2 "Bimo" 3 "Car" 4 "Truck" 5 "Barrier" 6 "Reserved" 7 "Reserved";
VAL_ 1125 ARC_OD_DynProp_Obj_41_RR 0 "STATIONAR" 1 "MOVIN" 2 "ONCOMING" 3 "STOPPE" 4 "CROSSING_LEFT2RIGH" 5 "CROSSING_RIGHT2LEF" 6 "RESERVE" 7 "RESERVED";
VAL_ 1125 ARC_OD_MaintenanceState_Obj_41_R 0 "INVALID" 1 "NEW" 2 "MEASURED" 3 "PREDICTED";
VAL_ 1124 ARC_OD_Classification_Obj_38_RR 0 "Unknow" 1 "Person" 2 "Bimo" 3 "Car" 4 "Truck" 5 "Barrier" 6 "Reserved" 7 "Reserved";
VAL_ 1124 ARC_OD_DynProp_Obj_38_RR 0 "MOVING" 1 "STATIONARY" 2 "ONCOMING" 3 "CROSSING_LEFT2RIGHT" 4 "CROSSING_RIGHT2LEFT" 5 "UNKNOWN" 6 "STOPPED" 7 "RESERVED";
VAL_ 1124 ARC_OD_MaintenanceState_Obj_38_R 0 "INVALID" 1 "NEW" 2 "MEASURED" 3 "PREDICTED";
VAL_ 1124 ARC_OD_Classification_Obj_39_RR 0 "Unknow" 1 "Person" 2 "Bimo" 3 "Car" 4 "Truck" 5 "Barrier" 6 "Reserved" 7 "Reserved";
VAL_ 1124 ARC_OD_DynProp_Obj_39_RR 0 "STATIONAR" 1 "MOVIN" 2 "ONCOMING" 3 "STOPPE" 4 "CROSSING_LEFT2RIGH" 5 "CROSSING_RIGHT2LEF" 6 "RESERVE" 7 "RESERVED";
VAL_ 1124 ARC_OD_MaintenanceState_Obj_39_R 0 "INVALID" 1 "NEW" 2 "MEASURED" 3 "PREDICTED";
VAL_ 1123 ARC_OD_Classification_Obj_36_RR 0 "Unknow" 1 "Person" 2 "Bimo" 3 "Car" 4 "Truck" 5 "Barrier" 6 "Reserved" 7 "Reserved";
VAL_ 1123 ARC_OD_DynProp_Obj_36_RR 0 "MOVING" 1 "STATIONARY" 2 "ONCOMING" 3 "CROSSING_LEFT2RIGHT" 4 "CROSSING_RIGHT2LEFT" 5 "UNKNOWN" 6 "STOPPED" 7 "RESERVED";
VAL_ 1123 ARC_OD_MaintenanceState_Obj_36_R 0 "INVALID" 1 "NEW" 2 "MEASURED" 3 "PREDICTED";
VAL_ 1123 ARC_OD_Classification_Obj_37_RR 0 "Unknow" 1 "Person" 2 "Bimo" 3 "Car" 4 "Truck" 5 "Barrier" 6 "Reserved" 7 "Reserved";
VAL_ 1123 ARC_OD_DynProp_Obj_37_RR 0 "STATIONAR" 1 "MOVIN" 2 "ONCOMING" 3 "STOPPE" 4 "CROSSING_LEFT2RIGH" 5 "CROSSING_RIGHT2LEF" 6 "RESERVE" 7 "RESERVED";
VAL_ 1123 ARC_OD_MaintenanceState_Obj_37_R 0 "INVALID" 1 "NEW" 2 "MEASURED" 3 "PREDICTED";
VAL_ 1122 ARC_OD_Classification_Obj_34_RR 0 "Unknow" 1 "Person" 2 "Bimo" 3 "Car" 4 "Truck" 5 "Barrier" 6 "Reserved" 7 "Reserved";
VAL_ 1122 ARC_OD_DynProp_Obj_34_RR 0 "MOVING" 1 "STATIONARY" 2 "ONCOMING" 3 "CROSSING_LEFT2RIGHT" 4 "CROSSING_RIGHT2LEFT" 5 "UNKNOWN" 6 "STOPPED" 7 "RESERVED";
VAL_ 1122 ARC_OD_MaintenanceState_Obj_34_R 0 "INVALID" 1 "NEW" 2 "MEASURED" 3 "PREDICTED";
VAL_ 1122 ARC_OD_Classification_Obj_35_RR 0 "Unknow" 1 "Person" 2 "Bimo" 3 "Car" 4 "Truck" 5 "Barrier" 6 "Reserved" 7 "Reserved";
VAL_ 1122 ARC_OD_DynProp_Obj_35_RR 0 "STATIONAR" 1 "MOVIN" 2 "ONCOMING" 3 "STOPPE" 4 "CROSSING_LEFT2RIGH" 5 "CROSSING_RIGHT2LEF" 6 "RESERVE" 7 "RESERVED";
VAL_ 1122 ARC_OD_MaintenanceState_Obj_35_R 0 "INVALID" 1 "NEW" 2 "MEASURED" 3 "PREDICTED";
