VERSION "created by canmatrix"

NS_ :

BS_:

BU_: ARC ADC

BO_ 1623 ARC_OD_12_13_FL: 64 ARC
 SG_ ARC_OD_Length_Obj_12_FL : 136|7@0+ (0.2,0) [0|25.4] "m" Vector__XXX
 SG_ ARC_OD_DistY_Obj_13_FL : 255|12@0+ (0.0875,-179.113) [-179.113|179.2] "m" Vector__XXX
 SG_ ARC_OD_AabsXStd_Obj_13_FL : 305|7@0+ (0.25,0) [0|31.75] "m/s^2" Vector__XXX
 SG_ ARC_OD_AabsY_Obj_12_FL : 48|9@0+ (0.125,-31.875) [-31.875|32] "m/s^2" Vector__XXX
 SG_ DistHeight_Obj_13_FL : 487|8@0+ (0.2,-10) [-10|41] "m" ADC
 SG_ DistHeight_Obj_12_FL : 479|8@0+ (0.2,-10) [-10|41] "m" ADC
 SG_ ARC_OD_DistX_Obj_12_FL : 7|12@0+ (0.1,-152) [-152|257.5] "m" ADC
 SG_ ARC_OD_Classification_Obj_12_FL : 98|3@0+ (1,0) [0|7] "" ADC
 SG_ ARC_OD_AabsYStd_Obj_12_FL : 111|8@0+ (0.25,0) [0|63.75] "m/s^2" ADC
 SG_ ARC_OD_ClassConf_Obj_12_FL : 119|7@0+ (1,0) [0|127] "%" ADC
 SG_ ARC_OD_ProbOfExist_Obj_12_FL : 112|7@0+ (1,0) [0|127] "%" ADC
 SG_ ARC_OD_VabsX_Obj_12_FL : 11|11@0+ (0.125,-128) [-128|127.875] "m/s" ADC
 SG_ ARC_OD_DynProp_Obj_12_FL : 130|3@0+ (1,0) [0|7] "" ADC
 SG_ ARC_OD_MaintenanceState_Obj_12_F : 145|2@0+ (1,0) [0|3] "" ADC
 SG_ ARC_OD_Width_Obj_12_FL : 159|7@0+ (0.2,0) [0|25.4] "m" ADC
 SG_ ARC_OD_RCS_Obj_12_FL : 152|9@0+ (0.2,-51.1) [-51.1|51.1] "dBsm" ADC
 SG_ ARC_OD_Orientation_Obj_12_FL : 175|10@0+ (0.01,-5.11) [-5.11|5.12] "rad" ADC
 SG_ ARC_OD_LifeCycle_Obj_12_FL : 207|16@0+ (1,0) [0|65535] "" ADC
 SG_ ARC_OD_DistX_Obj_13_FL : 223|12@0+ (0.1,-152) [-152|257.5] "m" ADC
 SG_ ARC_OD_VabsX_Obj_13_FL : 227|11@0+ (0.125,-128) [-128|127.875] "m/s" ADC
 SG_ ARC_OD_AabsX_Obj_13_FL : 232|9@0+ (0.125,-31.875) [-31.875|32] "m/s^2" ADC
 SG_ ARC_OD_AabsX_Obj_12_FL : 16|9@0+ (0.125,-31.875) [-31.875|32] "m/s^2" ADC
 SG_ ARC_OD_VabsY_Obj_13_FL : 259|11@0+ (0.125,-128) [-128|127.875] "m/s" ADC
 SG_ ARC_OD_AabsY_Obj_13_FL : 264|9@0+ (0.125,-31.875) [-31.875|32] "m/s^2" ADC
 SG_ ARC_OD_DistXStd_Obj_13_FL : 287|8@0+ (0.05,0) [0|12.75] "m" ADC
 SG_ ARC_OD_DistYStd_Obj_13_FL : 295|8@0+ (0.1,0) [0|25.5] "m" ADC
 SG_ ARC_OD_VabsXStd_Obj_13_FL : 303|7@0+ (0.1,0) [0|12.7] "m/s" ADC
 SG_ ARC_OD_VabsYStd_Obj_13_FL : 296|7@0+ (0.2,0) [0|25.4] "m/s" ADC
 SG_ ARC_OD_Classification_Obj_13_FL : 314|3@0+ (1,0) [0|7] "" ADC
 SG_ ARC_OD_AabsYStd_Obj_13_FL : 327|8@0+ (0.25,0) [0|63.75] "m/s^2" ADC
 SG_ ARC_OD_ClassConf_Obj_13_FL : 335|7@0+ (1,0) [0|127] "%" ADC
 SG_ ARC_OD_DistY_Obj_12_FL : 39|12@0+ (0.0875,-179.113) [-179.113|179.2] "m" ADC
 SG_ ARC_OD_ProbOfExist_Obj_13_FL : 328|7@0+ (1,0) [0|127] "%" ADC
 SG_ ARC_OD_DynProp_Obj_13_FL : 346|3@0+ (1,0) [0|7] "" ADC
 SG_ ARC_OD_Length_Obj_13_FL : 352|7@0+ (0.2,0) [0|25.4] "m" ADC
 SG_ ARC_OD_MaintenanceState_Obj_13_F : 361|2@0+ (1,0) [0|3] "" ADC
 SG_ ARC_OD_Width_Obj_13_FL : 375|7@0+ (0.2,0) [0|25.4] "m" ADC
 SG_ ARC_OD_RCS_Obj_13_FL : 368|9@0+ (0.2,-51.1) [-51.1|51.1] "dBsm" ADC
 SG_ ARC_OD_Orientation_Obj_13_FL : 391|10@0+ (0.01,-5.11) [-5.11|5.12] "rad" ADC
 SG_ ARC_OD_LifeCycle_Obj_13_FL : 423|16@0+ (1,0) [0|65535] "" ADC
 SG_ ARC_OD_ObstacleProb_Obj_12_FL : 447|7@0+ (1,0) [0|127] "%" ADC
 SG_ ARC_OD_ObstacleProb_Obj_13_FL : 455|7@0+ (1,0) [0|127] "%" ADC
 SG_ ARC_OD_VabsY_Obj_12_FL : 43|11@0+ (0.125,-128) [-128|127.875] "m/s" ADC
 SG_ ARC_OD_ID_13_FL : 471|8@0+ (1,0) [0|255] "" ADC
 SG_ ARC_OD_MsgCounter_Obj_12_13_FL : 491|4@0+ (1,0) [0|15] "" ADC
 SG_ ARC_OD_CRC8_Obj_12_13_FL : 511|8@0+ (1,0) [0|256] "" ADC
 SG_ ARC_OD_DistXStd_Obj_12_FL : 71|8@0+ (0.05,0) [0|12.75] "m" ADC
 SG_ ARC_OD_DistYStd_Obj_12_FL : 79|8@0+ (0.1,0) [0|25.5] "m" ADC
 SG_ ARC_OD_VabsXStd_Obj_12_FL : 87|7@0+ (0.1,0) [0|12.7] "m/s" ADC
 SG_ ARC_OD_VabsYStd_Obj_12_FL : 80|7@0+ (0.2,0) [0|25.4] "m/s" ADC
 SG_ ARC_OD_AabsXStd_Obj_12_FL : 89|7@0+ (0.25,0) [0|31.75] "m/s^2" ADC

BO_ 1622 ARC_OD_10_11_FL: 64 ARC
 SG_ DistHeight_Obj_11_FL : 487|8@0+ (0.2,-10) [-10|41] "m" ADC
 SG_ DistHeight_Obj_10_FL : 479|8@0+ (0.2,-10) [-10|41] "m" ADC
 SG_ ARC_OD_DistX_Obj_10_FL : 7|12@0+ (0.1,-152) [-152|257.5] "m" ADC
 SG_ ARC_OD_Classification_Obj_10_FL : 98|3@0+ (1,0) [0|7] "" ADC
 SG_ ARC_OD_AabsYStd_Obj_10_FL : 111|8@0+ (0.25,0) [0|63.75] "m/s^2" ADC
 SG_ ARC_OD_ClassConf_Obj_10_FL : 119|7@0+ (1,0) [0|127] "%" ADC
 SG_ ARC_OD_ProbOfExist_Obj_10_FL : 112|7@0+ (1,0) [0|127] "%" ADC
 SG_ ARC_OD_VabsX_Obj_10_FL : 11|11@0+ (0.125,-128) [-128|127.875] "m/s" ADC
 SG_ ARC_OD_DynProp_Obj_10_FL : 130|3@0+ (1,0) [0|7] "" ADC
 SG_ ARC_OD_Length_Obj_10_FL : 136|7@0+ (0.2,0) [0|25.4] "m" ADC
 SG_ ARC_OD_Width_Obj_10_FL : 159|7@0+ (0.2,0) [0|25.4] "m" ADC
 SG_ ARC_OD_RCS_Obj_10_FL : 152|9@0+ (0.2,-51.1) [-51.1|51.1] "dBsm" ADC
 SG_ ARC_OD_Orientation_Obj_10_FL : 175|10@0+ (0.01,-5.11) [-5.11|5.12] "rad" ADC
 SG_ ARC_OD_LifeCycle_Obj_10_FL : 207|16@0+ (1,0) [0|65535] "" ADC
 SG_ ARC_OD_DistX_Obj_11_FL : 223|12@0+ (0.1,-152) [-152|257.5] "m" ADC
 SG_ ARC_OD_VabsX_Obj_11_FL : 227|11@0+ (0.125,-128) [-128|127.875] "m/s" ADC
 SG_ ARC_OD_AabsX_Obj_11_FL : 232|9@0+ (0.125,-31.875) [-31.875|32] "m/s^2" ADC
 SG_ ARC_OD_AabsX_Obj_10_FL : 16|9@0+ (0.125,-31.875) [-31.875|32] "m/s^2" ADC
 SG_ ARC_OD_DistY_Obj_11_FL : 255|12@0+ (0.0875,-179.113) [-179.113|179.2] "m" ADC
 SG_ ARC_OD_VabsY_Obj_11_FL : 259|11@0+ (0.125,-128) [-128|127.875] "m/s" ADC
 SG_ ARC_OD_AabsY_Obj_11_FL : 264|9@0+ (0.125,-31.875) [-31.875|32] "m/s^2" ADC
 SG_ ARC_OD_DistXStd_Obj_11_FL : 287|8@0+ (0.05,0) [0|12.75] "m" ADC
 SG_ ARC_OD_DistYStd_Obj_11_FL : 295|8@0+ (0.1,0) [0|25.5] "m" ADC
 SG_ ARC_OD_VabsXStd_Obj_11_FL : 303|7@0+ (0.1,0) [0|12.7] "m/s" ADC
 SG_ ARC_OD_VabsYStd_Obj_11_FL : 296|7@0+ (0.2,0) [0|25.4] "m/s" ADC
 SG_ ARC_OD_AabsXStd_Obj_11_FL : 305|7@0+ (0.25,0) [0|31.75] "m/s^2" ADC
 SG_ ARC_OD_Classification_Obj_11_FL : 314|3@0+ (1,0) [0|7] "" ADC
 SG_ ARC_OD_AabsYStd_Obj_11_FL : 327|8@0+ (0.25,0) [0|63.75] "m/s^2" ADC
 SG_ ARC_OD_ClassConf_Obj_11_FL : 335|7@0+ (1,0) [0|127] "%" ADC
 SG_ ARC_OD_DistY_Obj_10_FL : 39|12@0+ (0.0875,-179.113) [-179.113|179.2] "m" ADC
 SG_ ARC_OD_ProbOfExist_Obj_11_FL : 328|7@0+ (1,0) [0|127] "%" ADC
 SG_ ARC_OD_DynProp_Obj_11_FL : 346|3@0+ (1,0) [0|7] "" ADC
 SG_ ARC_OD_Length_Obj_11_FL : 352|7@0+ (0.2,0) [0|25.4] "m" ADC
 SG_ ARC_OD_MaintenanceState_Obj_11_F : 361|2@0+ (1,0) [0|3] "" ADC
 SG_ ARC_OD_Width_Obj_11_FL : 375|7@0+ (0.2,0) [0|25.4] "m" ADC
 SG_ ARC_OD_RCS_Obj_11_FL : 368|9@0+ (0.2,-51.1) [-51.1|51.1] "dBsm" ADC
 SG_ ARC_OD_Orientation_Obj_11_FL : 391|10@0+ (0.01,-5.11) [-5.11|5.12] "rad" ADC
 SG_ ARC_OD_LifeCycle_Obj_11_FL : 423|16@0+ (1,0) [0|65535] "" ADC
 SG_ ARC_OD_ObstacleProb_Obj_10_FL : 447|7@0+ (1,0) [0|127] "%" ADC
 SG_ ARC_OD_ObstacleProb_Obj_11_FL : 455|7@0+ (1,0) [0|127] "%" ADC
 SG_ ARC_OD_VabsY_Obj_10_FL : 43|11@0+ (0.125,-128) [-128|127.875] "m/s" ADC
 SG_ ARC_OD_ID_10_FL : 463|8@0+ (1,0) [0|255] "" ADC
 SG_ ARC_OD_ID_11_FL : 471|8@0+ (1,0) [0|255] "" ADC
 SG_ ARC_OD_MsgCounter_Obj_10_11_FL : 491|4@0+ (1,0) [0|15] "" ADC
 SG_ ARC_OD_CRC8_Obj_10_11_FL : 511|8@0+ (1,0) [0|256] "" ADC
 SG_ ARC_OD_AabsY_Obj_10_FL : 48|9@0+ (0.125,-31.875) [-31.875|32] "m/s^2" ADC
 SG_ ARC_OD_DistXStd_Obj_10_FL : 71|8@0+ (0.05,0) [0|12.75] "m" ADC
 SG_ ARC_OD_DistYStd_Obj_10_FL : 79|8@0+ (0.1,0) [0|25.5] "m" ADC
 SG_ ARC_OD_VabsXStd_Obj_10_FL : 87|7@0+ (0.1,0) [0|12.7] "m/s" ADC
 SG_ ARC_OD_VabsYStd_Obj_10_FL : 80|7@0+ (0.2,0) [0|25.4] "m/s" ADC
 SG_ ARC_OD_AabsXStd_Obj_10_FL : 89|7@0+ (0.25,0) [0|31.75] "m/s^2" ADC

BO_ 1621 ARC_OD_08_09_FL: 64 ARC
 SG_ DistHeight_Obj_09_FL : 487|8@0+ (0.2,-10) [-10|41] "m" ADC
 SG_ DistHeight_Obj_08_FL : 479|8@0+ (0.2,-10) [-10|41] "m" ADC
 SG_ ARC_OD_DistX_Obj_08_FL : 7|12@0+ (0.1,-152) [-152|257.5] "m" ADC
 SG_ ARC_OD_Classification_Obj_08_FL : 98|3@0+ (1,0) [0|7] "" ADC
 SG_ ARC_OD_AabsYStd_Obj_08_FL : 111|8@0+ (0.25,0) [0|63.75] "m/s^2" ADC
 SG_ ARC_OD_ClassConf_Obj_08_FL : 119|7@0+ (1,0) [0|127] "%" ADC
 SG_ ARC_OD_ProbOfExist_Obj_08_FL : 112|7@0+ (1,0) [0|127] "%" ADC
 SG_ ARC_OD_VabsX_Obj_08_FL : 11|11@0+ (0.125,-128) [-128|127.875] "m/s" ADC
 SG_ ARC_OD_DynProp_Obj_08_FL : 130|3@0+ (1,0) [0|7] "" ADC
 SG_ ARC_OD_Length_Obj_08_FL : 136|7@0+ (0.2,0) [0|25.4] "m" ADC
 SG_ ARC_OD_MaintenanceState_Obj_08_F : 145|2@0+ (1,0) [0|3] "" ADC
 SG_ ARC_OD_Width_Obj_08_FL : 159|7@0+ (0.2,0) [0|25.4] "m" ADC
 SG_ ARC_OD_RCS_Obj_08_FL : 152|9@0+ (0.2,-51.1) [-51.1|51.1] "dBsm" ADC
 SG_ ARC_OD_Orientation_Obj_08_FL : 175|10@0+ (0.01,-5.11) [-5.11|5.12] "rad" ADC
 SG_ ARC_OD_LifeCycle_Obj_08_FL : 207|16@0+ (1,0) [0|65535] "" ADC
 SG_ ARC_OD_DistX_Obj_09_FL : 223|12@0+ (0.1,-152) [-152|257.5] "m" ADC
 SG_ ARC_OD_VabsX_Obj_09_FL : 227|11@0+ (0.125,-128) [-128|127.875] "m/s" ADC
 SG_ ARC_OD_AabsX_Obj_09_FL : 232|9@0+ (0.125,-31.875) [-31.875|32] "m/s^2" ADC
 SG_ ARC_OD_AabsX_Obj_08_FL : 16|9@0+ (0.125,-31.875) [-31.875|32] "m/s^2" ADC
 SG_ ARC_OD_DistY_Obj_09_FL : 255|12@0+ (0.0875,-179.113) [-179.113|179.2] "m" ADC
 SG_ ARC_OD_VabsY_Obj_09_FL : 259|11@0+ (0.125,-128) [-128|127.875] "m/s" ADC
 SG_ ARC_OD_AabsY_Obj_09_FL : 264|9@0+ (0.125,-31.875) [-31.875|32] "m/s^2" ADC
 SG_ ARC_OD_DistXStd_Obj_09_FL : 287|8@0+ (0.05,0) [0|12.75] "m" ADC
 SG_ ARC_OD_DistYStd_Obj_09_FL : 295|8@0+ (0.1,0) [0|25.5] "m" ADC
 SG_ ARC_OD_VabsXStd_Obj_09_FL : 303|7@0+ (0.1,0) [0|12.7] "m/s" ADC
 SG_ ARC_OD_VabsYStd_Obj_09_FL : 296|7@0+ (0.2,0) [0|25.4] "m/s" ADC
 SG_ ARC_OD_AabsXStd_Obj_09_FL : 305|7@0+ (0.25,0) [0|31.75] "m/s^2" ADC
 SG_ ARC_OD_Classification_Obj_09_FL : 314|3@0+ (1,0) [0|7] "" ADC
 SG_ ARC_OD_AabsYStd_Obj_09_FL : 327|8@0+ (0.25,0) [0|63.75] "m/s^2" ADC
 SG_ ARC_OD_ClassConf_Obj_09_FL : 335|7@0+ (1,0) [0|127] "%" ADC
 SG_ ARC_OD_DistY_Obj_08_FL : 39|12@0+ (0.0875,-179.113) [-179.113|179.2] "m" ADC
 SG_ ARC_OD_ProbOfExist_Obj_09_FL : 328|7@0+ (1,0) [0|127] "%" ADC
 SG_ ARC_OD_DynProp_Obj_09_FL : 346|3@0+ (1,0) [0|7] "" ADC
 SG_ ARC_OD_Length_Obj_09_FL : 352|7@0+ (0.2,0) [0|25.4] "m" ADC
 SG_ ARC_OD_MaintenanceState_Obj_09_F : 361|2@0+ (1,0) [0|3] "" ADC
 SG_ ARC_OD_Width_Obj_09_FL : 375|7@0+ (0.2,0) [0|25.4] "m" ADC
 SG_ ARC_OD_RCS_Obj_09_FL : 368|9@0+ (0.2,-51.1) [-51.1|51.1] "dBsm" ADC
 SG_ ARC_OD_Orientation_Obj_09_FL : 391|10@0+ (0.01,-5.11) [-5.11|5.12] "rad" ADC
 SG_ ARC_OD_LifeCycle_Obj_09_FL : 423|16@0+ (1,0) [0|65535] "" ADC
 SG_ ARC_OD_ObstacleProb_Obj_08_FL : 447|7@0+ (1,0) [0|127] "%" ADC
 SG_ ARC_OD_ObstacleProb_Obj_09_FL : 455|7@0+ (1,0) [0|127] "%" ADC
 SG_ ARC_OD_VabsY_Obj_08_FL : 43|11@0+ (0.125,-128) [-128|127.875] "m/s" ADC
 SG_ ARC_OD_ID_08_FL : 463|8@0+ (1,0) [0|255] "" ADC
 SG_ ARC_OD_ID_09_FL : 471|8@0+ (1,0) [0|255] "" ADC
 SG_ ARC_OD_MsgCounter_Obj_08_09_FL : 491|4@0+ (1,0) [0|15] "" ADC
 SG_ ARC_OD_CRC8_Obj_08_09_FL : 511|8@0+ (1,0) [0|256] "" ADC
 SG_ ARC_OD_AabsY_Obj_08_FL : 48|9@0+ (0.125,-31.875) [-31.875|32] "m/s^2" ADC
 SG_ ARC_OD_DistXStd_Obj_08_FL : 71|8@0+ (0.05,0) [0|12.75] "m" ADC
 SG_ ARC_OD_DistYStd_Obj_08_FL : 79|8@0+ (0.1,0) [0|25.5] "m" ADC
 SG_ ARC_OD_VabsXStd_Obj_08_FL : 87|7@0+ (0.1,0) [0|12.7] "m/s" ADC
 SG_ ARC_OD_VabsYStd_Obj_08_FL : 80|7@0+ (0.2,0) [0|25.4] "m/s" ADC
 SG_ ARC_OD_AabsXStd_Obj_08_FL : 89|7@0+ (0.25,0) [0|31.75] "m/s^2" ADC

BO_ 1620 ARC_OD_06_07_FL: 64 ARC
 SG_ DistHeight_Obj_07_FL : 487|8@0+ (0.2,-10) [-10|41] "m" ADC
 SG_ DistHeight_Obj_06_FL : 479|8@0+ (0.2,-10) [-10|41] "m" ADC
 SG_ ARC_OD_DistX_Obj_06_FL : 7|12@0+ (0.1,-152) [-152|257.5] "m" ADC
 SG_ ARC_OD_Classification_Obj_06_FL : 98|3@0+ (1,0) [0|7] "" ADC
 SG_ ARC_OD_AabsYStd_Obj_06_FL : 111|8@0+ (0.25,0) [0|63.75] "m/s^2" ADC
 SG_ ARC_OD_ClassConf_Obj_06_FL : 119|7@0+ (1,0) [0|127] "%" ADC
 SG_ ARC_OD_ProbOfExist_Obj_06_FL : 112|7@0+ (1,0) [0|127] "%" ADC
 SG_ ARC_OD_VabsX_Obj_06_FL : 11|11@0+ (0.125,-128) [-128|127.875] "m/s" ADC
 SG_ ARC_OD_DynProp_Obj_06_FL : 130|3@0+ (1,0) [0|7] "" ADC
 SG_ ARC_OD_Length_Obj_06_FL : 136|7@0+ (0.2,0) [0|25.4] "m" ADC
 SG_ ARC_OD_MaintenanceState_Obj_06_F : 145|2@0+ (1,0) [0|3] "" ADC
 SG_ ARC_OD_Width_Obj_06_FL : 159|7@0+ (0.2,0) [0|25.4] "m" ADC
 SG_ ARC_OD_RCS_Obj_06_FL : 152|9@0+ (0.2,-51.1) [-51.1|51.1] "dBsm" ADC
 SG_ ARC_OD_Orientation_Obj_06_FL : 175|10@0+ (0.01,-5.11) [-5.11|5.12] "rad" ADC
 SG_ ARC_OD_LifeCycle_Obj_06_FL : 207|16@0+ (1,0) [0|65535] "" ADC
 SG_ ARC_OD_DistX_Obj_07_FL : 223|12@0+ (0.1,-152) [-152|257.5] "m" ADC
 SG_ ARC_OD_VabsX_Obj_07_FL : 227|11@0+ (0.125,-128) [-128|127.875] "m/s" ADC
 SG_ ARC_OD_AabsX_Obj_07_FL : 232|9@0+ (0.125,-31.875) [-31.875|32] "m/s^2" ADC
 SG_ ARC_OD_AabsX_Obj_06_FL : 16|9@0+ (0.125,-31.875) [-31.875|32] "m/s^2" ADC
 SG_ ARC_OD_DistY_Obj_07_FL : 255|12@0+ (0.0875,-179.113) [-179.113|179.2] "m" ADC
 SG_ ARC_OD_VabsY_Obj_07_FL : 259|11@0+ (0.125,-128) [-128|127.875] "m/s" ADC
 SG_ ARC_OD_AabsY_Obj_07_FL : 264|9@0+ (0.125,-31.875) [-31.875|32] "m/s^2" ADC
 SG_ ARC_OD_DistXStd_Obj_07_FL : 287|8@0+ (0.05,0) [0|12.75] "m" ADC
 SG_ ARC_OD_DistYStd_Obj_07_FL : 295|8@0+ (0.1,0) [0|25.5] "m" ADC
 SG_ ARC_OD_VabsXStd_Obj_07_FL : 303|7@0+ (0.1,0) [0|12.7] "m/s" ADC
 SG_ ARC_OD_VabsYStd_Obj_07_FL : 296|7@0+ (0.2,0) [0|25.4] "m/s" ADC
 SG_ ARC_OD_AabsXStd_Obj_07_FL : 305|7@0+ (0.25,0) [0|31.75] "m/s^2" ADC
 SG_ ARC_OD_Classification_Obj_07_FL : 314|3@0+ (1,0) [0|7] "" ADC
 SG_ ARC_OD_AabsYStd_Obj_07_FL : 327|8@0+ (0.25,0) [0|63.75] "m/s^2" ADC
 SG_ ARC_OD_ClassConf_Obj_07_FL : 335|7@0+ (1,0) [0|127] "%" ADC
 SG_ ARC_OD_DistY_Obj_06_FL : 39|12@0+ (0.0875,-179.113) [-179.113|179.2] "m" ADC
 SG_ ARC_OD_ProbOfExist_Obj_07_FL : 328|7@0+ (1,0) [0|127] "%" ADC
 SG_ ARC_OD_DynProp_Obj_07_FL : 346|3@0+ (1,0) [0|7] "" ADC
 SG_ ARC_OD_Length_Obj_07_FL : 352|7@0+ (0.2,0) [0|25.4] "m" ADC
 SG_ ARC_OD_MaintenanceState_Obj_07_F : 361|2@0+ (1,0) [0|3] "" ADC
 SG_ ARC_OD_Width_Obj_07_FL : 375|7@0+ (0.2,0) [0|25.4] "m" ADC
 SG_ ARC_OD_RCS_Obj_07_FL : 368|9@0+ (0.2,-51.1) [-51.1|51.1] "dBsm" ADC
 SG_ ARC_OD_Orientation_Obj_07_FL : 391|10@0+ (0.01,-5.11) [-5.11|5.12] "rad" ADC
 SG_ ARC_OD_LifeCycle_Obj_07_FL : 423|16@0+ (1,0) [0|65535] "" ADC
 SG_ ARC_OD_ObstacleProb_Obj_06_FL : 447|7@0+ (1,0) [0|127] "%" ADC
 SG_ ARC_OD_ObstacleProb_Obj_07_FL : 455|7@0+ (1,0) [0|127] "%" ADC
 SG_ ARC_OD_VabsY_Obj_06_FL : 43|11@0+ (0.125,-128) [-128|127.875] "m/s" ADC
 SG_ ARC_OD_ID_06_FL : 463|8@0+ (1,0) [0|255] "" ADC
 SG_ ARC_OD_ID_07_FL : 471|8@0+ (1,0) [0|255] "" ADC
 SG_ ARC_OD_MsgCounter_Obj_06_07_FL : 491|4@0+ (1,0) [0|15] "" ADC
 SG_ ARC_OD_CRC8_Obj_06_07_FL : 511|8@0+ (1,0) [0|256] "" ADC
 SG_ ARC_OD_AabsY_Obj_06_FL : 48|9@0+ (0.125,-31.875) [-31.875|32] "m/s^2" ADC
 SG_ ARC_OD_DistXStd_Obj_06_FL : 71|8@0+ (0.05,0) [0|12.75] "m" ADC
 SG_ ARC_OD_DistYStd_Obj_06_FL : 79|8@0+ (0.1,0) [0|25.5] "m" ADC
 SG_ ARC_OD_VabsXStd_Obj_06_FL : 87|7@0+ (0.1,0) [0|12.7] "m/s" ADC
 SG_ ARC_OD_VabsYStd_Obj_06_FL : 80|7@0+ (0.2,0) [0|25.4] "m/s" ADC
 SG_ ARC_OD_AabsXStd_Obj_06_FL : 89|7@0+ (0.25,0) [0|31.75] "m/s^2" ADC

BO_ 1619 ARC_OD_04_05_FL: 64 ARC
 SG_ DistHeight_Obj_05_FL : 487|8@0+ (0.2,-10) [-10|41] "m" ADC
 SG_ DistHeight_Obj_04_FL : 479|8@0+ (0.2,-10) [-10|41] "m" ADC
 SG_ ARC_OD_DistX_Obj_04_FL : 7|12@0+ (0.1,-152) [-152|257.5] "m" ADC
 SG_ ARC_OD_Classification_Obj_04_FL : 98|3@0+ (1,0) [0|7] "" ADC
 SG_ ARC_OD_AabsYStd_Obj_04_FL : 111|8@0+ (0.25,0) [0|63.75] "m/s^2" ADC
 SG_ ARC_OD_ClassConf_Obj_04_FL : 119|7@0+ (1,0) [0|127] "%" ADC
 SG_ ARC_OD_ProbOfExist_Obj_04_FL : 112|7@0+ (1,0) [0|127] "%" ADC
 SG_ ARC_OD_VabsX_Obj_04_FL : 11|11@0+ (0.125,-128) [-128|127.875] "m/s" ADC
 SG_ ARC_OD_DynProp_Obj_04_FL : 130|3@0+ (1,0) [0|7] "" ADC
 SG_ ARC_OD_Length_Obj_04_FL : 136|7@0+ (0.2,0) [0|25.4] "m" ADC
 SG_ ARC_OD_MaintenanceState_Obj_04_F : 145|2@0+ (1,0) [0|3] "" ADC
 SG_ ARC_OD_Width_Obj_04_FL : 159|7@0+ (0.2,0) [0|25.4] "m" ADC
 SG_ ARC_OD_RCS_Obj_04_FL : 152|9@0+ (0.2,-51.1) [-51.1|51.1] "dBsm" ADC
 SG_ ARC_OD_Orientation_Obj_04_FL : 175|10@0+ (0.01,-5.11) [-5.11|5.12] "rad" ADC
 SG_ ARC_OD_LifeCycle_Obj_04_FL : 207|16@0+ (1,0) [0|65535] "" ADC
 SG_ ARC_OD_DistX_Obj_05_FL : 223|12@0+ (0.1,-152) [-152|257.5] "m" ADC
 SG_ ARC_OD_VabsX_Obj_05_FL : 227|11@0+ (0.125,-128) [-128|127.875] "m/s" ADC
 SG_ ARC_OD_AabsX_Obj_05_FL : 232|9@0+ (0.125,-31.875) [-31.875|32] "m/s^2" ADC
 SG_ ARC_OD_AabsX_Obj_04_FL : 16|9@0+ (0.125,-31.875) [-31.875|32] "m/s^2" ADC
 SG_ ARC_OD_DistY_Obj_05_FL : 255|12@0+ (0.0875,-179.113) [-179.113|179.2] "m" ADC
 SG_ ARC_OD_VabsY_Obj_05_FL : 259|11@0+ (0.125,-128) [-128|127.875] "m/s" ADC
 SG_ ARC_OD_AabsY_Obj_05_FL : 264|9@0+ (0.125,-31.875) [-31.875|32] "m/s^2" ADC
 SG_ ARC_OD_DistXStd_Obj_05_FL : 287|8@0+ (0.05,0) [0|12.75] "m" ADC
 SG_ ARC_OD_DistYStd_Obj_05_FL : 295|8@0+ (0.1,0) [0|25.5] "m" ADC
 SG_ ARC_OD_VabsXStd_Obj_05_FL : 303|7@0+ (0.1,0) [0|12.7] "m/s" ADC
 SG_ ARC_OD_VabsYStd_Obj_05_FL : 296|7@0+ (0.2,0) [0|25.4] "m/s" ADC
 SG_ ARC_OD_AabsXStd_Obj_05_FL : 305|7@0+ (0.25,0) [0|31.75] "m/s^2" ADC
 SG_ ARC_OD_Classification_Obj_05_FL : 314|3@0+ (1,0) [0|7] "" ADC
 SG_ ARC_OD_AabsYStd_Obj_05_FL : 327|8@0+ (0.25,0) [0|63.75] "m/s^2" ADC
 SG_ ARC_OD_ClassConf_Obj_05_FL : 335|7@0+ (1,0) [0|127] "%" ADC
 SG_ ARC_OD_DistY_Obj_04_FL : 39|12@0+ (0.0875,-179.113) [-179.113|179.2] "m" ADC
 SG_ ARC_OD_ProbOfExist_Obj_05_FL : 328|7@0+ (1,0) [0|127] "%" ADC
 SG_ ARC_OD_DynProp_Obj_05_FL : 346|3@0+ (1,0) [0|7] "" ADC
 SG_ ARC_OD_Length_Obj_05_FL : 352|7@0+ (0.2,0) [0|25.4] "m" ADC
 SG_ ARC_OD_MaintenanceState_Obj_05_F : 361|2@0+ (1,0) [0|3] "" ADC
 SG_ ARC_OD_Width_Obj_05_FL : 375|7@0+ (0.2,0) [0|25.4] "m" ADC
 SG_ ARC_OD_RCS_Obj_05_FL : 368|9@0+ (0.2,-51.1) [-51.1|51.1] "dBsm" ADC
 SG_ ARC_OD_Orientation_Obj_05_FL : 391|10@0+ (0.01,-5.11) [-5.11|5.12] "rad" ADC
 SG_ ARC_OD_LifeCycle_Obj_05_FL : 423|16@0+ (1,0) [0|65535] "" ADC
 SG_ ARC_OD_ObstacleProb_Obj_04_FL : 447|7@0+ (1,0) [0|127] "%" ADC
 SG_ ARC_OD_ObstacleProb_Obj_05_FL : 455|7@0+ (1,0) [0|127] "%" ADC
 SG_ ARC_OD_VabsY_Obj_04_FL : 43|11@0+ (0.125,-128) [-128|127.875] "m/s" ADC
 SG_ ARC_OD_ID_04_FL : 463|8@0+ (1,0) [0|255] "" ADC
 SG_ ARC_OD_ID_05_FL : 471|8@0+ (1,0) [0|255] "" ADC
 SG_ ARC_OD_MsgCounter_Obj_04_05_FL : 491|4@0+ (1,0) [0|15] "" ADC
 SG_ ARC_OD_CRC8_Obj_04_05_FL : 511|8@0+ (1,0) [0|255] "" ADC
 SG_ ARC_OD_AabsY_Obj_04_FL : 48|9@0+ (0.125,-31.875) [-31.875|32] "m/s^2" ADC
 SG_ ARC_OD_DistXStd_Obj_04_FL : 71|8@0+ (0.05,0) [0|12.75] "m" ADC
 SG_ ARC_OD_DistYStd_Obj_04_FL : 79|8@0+ (0.1,0) [0|25.5] "m" ADC
 SG_ ARC_OD_VabsXStd_Obj_04_FL : 87|7@0+ (0.1,0) [0|12.7] "m/s" ADC
 SG_ ARC_OD_VabsYStd_Obj_04_FL : 80|7@0+ (0.2,0) [0|25.4] "m/s" ADC
 SG_ ARC_OD_AabsXStd_Obj_04_FL : 89|7@0+ (0.25,0) [0|31.75] "m/s^2" ADC

BO_ 1618 ARC_OD_02_03_FL: 64 ARC
 SG_ DistHeight_Obj_03_FL : 487|8@0+ (0.2,-10) [-10|41] "m" ADC
 SG_ DistHeight_Obj_02_FL : 479|8@0+ (0.2,-10) [-10|41] "m" ADC
 SG_ ARC_OD_DistX_Obj_02_FL : 7|12@0+ (0.1,-152) [-152|257.5] "m" ADC
 SG_ ARC_OD_Classification_Obj_02_FL : 98|3@0+ (1,0) [0|7] "" ADC
 SG_ ARC_OD_AabsYStd_Obj_02_FL : 111|8@0+ (0.25,0) [0|63.75] "m/s^2" ADC
 SG_ ARC_OD_ClassConf_Obj_02_FL : 119|7@0+ (1,0) [0|127] "%" ADC
 SG_ ARC_OD_ProbOfExist_Obj_02_FL : 112|7@0+ (1,0) [0|127] "%" ADC
 SG_ ARC_OD_VabsX_Obj_02_FL : 11|11@0+ (0.125,-128) [-128|127.875] "m/s" ADC
 SG_ ARC_OD_DynProp_Obj_02_FL : 130|3@0+ (1,0) [0|7] "" ADC
 SG_ ARC_OD_Length_Obj_02_FL : 136|7@0+ (0.2,0) [0|25.4] "m" ADC
 SG_ ARC_OD_MaintenanceState_Obj_02_F : 145|2@0+ (1,0) [0|3] "" ADC
 SG_ ARC_OD_Width_Obj_02_FL : 159|7@0+ (0.2,0) [0|25.4] "m" ADC
 SG_ ARC_OD_RCS_Obj_02_FL : 152|9@0+ (0.2,-51.1) [-51.1|51.1] "dBsm" ADC
 SG_ ARC_OD_Orientation_Obj_02_FL : 175|10@0+ (0.01,-5.11) [-5.11|5.12] "rad" ADC
 SG_ ARC_OD_LifeCycle_Obj_02_FL : 207|16@0+ (1,0) [0|65535] "" ADC
 SG_ ARC_OD_DistX_Obj_03_FL : 223|12@0+ (0.1,-152) [-152|257.5] "m" ADC
 SG_ ARC_OD_VabsX_Obj_03_FL : 227|11@0+ (0.125,-128) [-128|127.875] "m/s" ADC
 SG_ ARC_OD_AabsX_Obj_03_FL : 232|9@0+ (0.125,-31.875) [-31.875|32] "m/s^2" ADC
 SG_ ARC_OD_AabsX_Obj_02_FL : 16|9@0+ (0.125,-31.875) [-31.875|32] "m/s^2" ADC
 SG_ ARC_OD_DistY_Obj_03_FL : 255|12@0+ (0.0875,-179.113) [-179.113|179.2] "m" ADC
 SG_ ARC_OD_VabsY_Obj_03_FL : 259|11@0+ (0.125,-128) [-128|127.875] "m/s" ADC
 SG_ ARC_OD_AabsY_Obj_03_FL : 264|9@0+ (0.125,-31.875) [-31.875|32] "m/s^2" ADC
 SG_ ARC_OD_DistXStd_Obj_03_FL : 287|8@0+ (0.05,0) [0|12.75] "m" ADC
 SG_ ARC_OD_DistYStd_Obj_03_FL : 295|8@0+ (0.1,0) [0|25.5] "m" ADC
 SG_ ARC_OD_VabsXStd_Obj_03_FL : 303|7@0+ (0.1,0) [0|12.7] "m/s" ADC
 SG_ ARC_OD_VabsYStd_Obj_03_FL : 296|7@0+ (0.2,0) [0|25.4] "m/s" ADC
 SG_ ARC_OD_AabsXStd_Obj_03_FL : 305|7@0+ (0.25,0) [0|31.75] "m/s^2" ADC
 SG_ ARC_OD_Classification_Obj_03_FL : 314|3@0+ (1,0) [0|7] "" ADC
 SG_ ARC_OD_AabsYStd_Obj_03_FL : 327|8@0+ (0.25,0) [0|63.75] "m/s^2" ADC
 SG_ ARC_OD_ClassConf_Obj_03_FL : 335|7@0+ (1,0) [0|127] "%" ADC
 SG_ ARC_OD_DistY_Obj_02_FL : 39|12@0+ (0.0875,-179.113) [-179.113|179.2] "m" ADC
 SG_ ARC_OD_ProbOfExist_Obj_03_FL : 328|7@0+ (1,0) [0|127] "%" ADC
 SG_ ARC_OD_DynProp_Obj_03_FL : 346|3@0+ (1,0) [0|7] "" ADC
 SG_ ARC_OD_Length_Obj_03_FL : 352|7@0+ (0.2,0) [0|25.4] "m" ADC
 SG_ ARC_OD_MaintenanceState_Obj_03_F : 361|2@0+ (1,0) [0|3] "" ADC
 SG_ ARC_OD_Width_Obj_03_FL : 375|7@0+ (0.2,0) [0|25.4] "m" ADC
 SG_ ARC_OD_RCS_Obj_03_FL : 368|9@0+ (0.2,-51.1) [-51.1|51.1] "dBsm" ADC
 SG_ ARC_OD_Orientation_Obj_03_FL : 391|10@0+ (0.01,-5.11) [-5.11|5.12] "rad" ADC
 SG_ ARC_OD_LifeCycle_Obj_03_FL : 423|16@0+ (1,0) [0|65535] "" ADC
 SG_ ARC_OD_ObstacleProb_Obj_02_FL : 447|7@0+ (1,0) [0|127] "%" ADC
 SG_ ARC_OD_ObstacleProb_Obj_03_FL : 455|7@0+ (1,0) [0|127] "%" ADC
 SG_ ARC_OD_VabsY_Obj_02_FL : 43|11@0+ (0.125,-128) [-128|127.875] "m/s" ADC
 SG_ ARC_OD_ID_02_FL : 463|8@0+ (1,0) [0|255] "" ADC
 SG_ ARC_OD_ID_03_FL : 471|8@0+ (1,0) [0|255] "" ADC
 SG_ ARC_OD_MsgCounter_Obj_02_03_FL : 491|4@0+ (1,0) [0|15] "" ADC
 SG_ ARC_OD_CRC8_Obj_02_03_FL : 511|8@0+ (1,0) [0|255] "" ADC
 SG_ ARC_OD_AabsY_Obj_02_FL : 48|9@0+ (0.125,-31.875) [-31.875|32] "m/s^2" ADC
 SG_ ARC_OD_DistXStd_Obj_02_FL : 71|8@0+ (0.05,0) [0|12.75] "m" ADC
 SG_ ARC_OD_DistYStd_Obj_02_FL : 79|8@0+ (0.1,0) [0|25.5] "m" ADC
 SG_ ARC_OD_VabsXStd_Obj_02_FL : 87|7@0+ (0.1,0) [0|12.7] "m/s" ADC
 SG_ ARC_OD_VabsYStd_Obj_02_FL : 80|7@0+ (0.2,0) [0|25.4] "m/s" ADC
 SG_ ARC_OD_AabsXStd_Obj_02_FL : 89|7@0+ (0.25,0) [0|31.75] "m/s^2" ADC

BO_ 1617 ARC_OD_00_01_FL: 64 ARC
 SG_ DistHeight_Obj_01_FL : 487|8@0+ (0.2,-10) [-10|41] "m" ADC
 SG_ DistHeight_Obj_00_FL : 479|8@0+ (0.2,-10) [-10|41] "m" ADC
 SG_ ARC_OD_DistX_Obj_00_FL : 7|12@0+ (0.1,-152) [-152|257.5] "m" ADC
 SG_ ARC_OD_Classification_Obj_00_FL : 98|3@0+ (1,0) [0|7] "" ADC
 SG_ ARC_OD_AabsYStd_Obj_00_FL : 111|8@0+ (0.25,0) [0|63.75] "m/s^2" ADC
 SG_ ARC_OD_ClassConf_Obj_00_FL : 119|7@0+ (1,0) [0|127] "%" ADC
 SG_ ARC_OD_ProbOfExist_Obj_00_FL : 112|7@0+ (1,0) [0|127] "%" ADC
 SG_ ARC_OD_VabsX_Obj_00_FL : 11|11@0+ (0.125,-128) [-128|127.875] "m/s" ADC
 SG_ ARC_OD_DynProp_Obj_00_FL : 130|3@0+ (1,0) [0|7] "" ADC
 SG_ ARC_OD_Length_Obj_00_FL : 136|7@0+ (0.2,0) [0|25.4] "m" ADC
 SG_ ARC_OD_MaintenanceState_Obj_00_F : 145|2@0+ (1,0) [0|3] "" ADC
 SG_ ARC_OD_Width_Obj_00_FL : 159|7@0+ (0.2,0) [0|25.4] "m" ADC
 SG_ ARC_OD_RCS_Obj_00_FL : 152|9@0+ (0.2,-51.1) [-51.1|51.1] "dBsm" ADC
 SG_ ARC_OD_Orientation_Obj_00_FL : 175|10@0+ (0.01,-5.11) [-5.11|5.12] "rad" ADC
 SG_ ARC_OD_LifeCycle_Obj_00_FL : 207|16@0+ (1,0) [0|65535] "" ADC
 SG_ ARC_OD_DistX_Obj_01_FL : 223|12@0+ (0.1,-152) [-152|257.5] "m" ADC
 SG_ ARC_OD_VabsX_Obj_01_FL : 227|11@0+ (0.125,-128) [-128|127.875] "m/s" ADC
 SG_ ARC_OD_AabsX_Obj_01_FL : 232|9@0+ (0.125,-31.875) [-31.875|32] "m/s^2" ADC
 SG_ ARC_OD_AabsX_Obj_00_FL : 16|9@0+ (0.125,-31.875) [-31.875|32] "m/s^2" ADC
 SG_ ARC_OD_DistY_Obj_01_FL : 255|12@0+ (0.0875,-179.113) [-179.113|179.2] "m" ADC
 SG_ ARC_OD_VabsY_Obj_01_FL : 259|11@0+ (0.125,-128) [-128|127.875] "m/s" ADC
 SG_ ARC_OD_AabsY_Obj_01_FL : 264|9@0+ (0.125,-31.875) [-31.875|32] "m/s^2" ADC
 SG_ ARC_OD_DistXStd_Obj_01_FL : 287|8@0+ (0.05,0) [0|12.75] "m" ADC
 SG_ ARC_OD_DistYStd_Obj_01_FL : 295|8@0+ (0.1,0) [0|25.5] "m" ADC
 SG_ ARC_OD_VabsXStd_Obj_01_FL : 303|7@0+ (0.1,0) [0|12.7] "m/s" ADC
 SG_ ARC_OD_VabsYStd_Obj_01_FL : 296|7@0+ (0.2,0) [0|25.4] "m/s" ADC
 SG_ ARC_OD_AabsXStd_Obj_01_FL : 305|7@0+ (0.25,0) [0|31.75] "m/s^2" ADC
 SG_ ARC_OD_Classification_Obj_01_FL : 314|3@0+ (1,0) [0|7] "" ADC
 SG_ ARC_OD_AabsYStd_Obj_01_FL : 327|8@0+ (0.25,0) [0|63.75] "m/s^2" ADC
 SG_ ARC_OD_ClassConf_Obj_01_FL : 335|7@0+ (1,0) [0|127] "%" ADC
 SG_ ARC_OD_DistY_Obj_00_FL : 39|12@0+ (0.0875,-179.113) [-179.113|179.2] "m" ADC
 SG_ ARC_OD_ProbOfExist_Obj_01_FL : 328|7@0+ (1,0) [0|127] "%" ADC
 SG_ ARC_OD_DynProp_Obj_01_FL : 346|3@0+ (1,0) [0|7] "" ADC
 SG_ ARC_OD_Length_Obj_01_FL : 352|7@0+ (0.2,0) [0|25.4] "m" ADC
 SG_ ARC_OD_MaintenanceState_Obj_01_F : 361|2@0+ (1,0) [0|3] "" ADC
 SG_ ARC_OD_Width_Obj_01_FL : 375|7@0+ (0.2,0) [0|25.4] "m" ADC
 SG_ ARC_OD_RCS_Obj_01_FL : 368|9@0+ (0.2,-51.1) [-51.1|51.1] "dBsm" ADC
 SG_ ARC_OD_Orientation_Obj_01_FL : 391|10@0+ (0.01,-5.11) [-5.11|5.12] "rad" ADC
 SG_ ARC_OD_LifeCycle_Obj_01_FL : 423|16@0+ (1,0) [0|65535] "" ADC
 SG_ ARC_OD_ObstacleProb_Obj_00_FL : 447|7@0+ (1,0) [0|127] "%" ADC
 SG_ ARC_OD_ObstacleProb_Obj_01_FL : 455|7@0+ (1,0) [0|127] "%" ADC
 SG_ ARC_OD_VabsY_Obj_00_FL : 43|11@0+ (0.125,-128) [-128|127.875] "m/s" ADC
 SG_ ARC_OD_ID_00_FL : 463|8@0+ (1,0) [0|255] "" ADC
 SG_ ARC_OD_ID_01_FL : 471|8@0+ (1,0) [0|255] "" ADC
 SG_ ARC_OD_MsgCounter_Obj_00_01_FL : 491|4@0+ (1,0) [0|15] "" ADC
 SG_ ARC_OD_CRC8_Obj_00_01_FL : 511|8@0+ (1,0) [0|255] "" ADC
 SG_ ARC_OD_AabsY_Obj_00_FL : 48|9@0+ (0.125,-31.875) [-31.875|32] "m/s^2" ADC
 SG_ ARC_OD_DistXStd_Obj_00_FL : 71|8@0+ (0.05,0) [0|12.75] "m" ADC
 SG_ ARC_OD_DistYStd_Obj_00_FL : 79|8@0+ (0.1,0) [0|25.5] "m" ADC
 SG_ ARC_OD_VabsXStd_Obj_00_FL : 87|7@0+ (0.1,0) [0|12.7] "m/s" ADC
 SG_ ARC_OD_VabsYStd_Obj_00_FL : 80|7@0+ (0.2,0) [0|25.4] "m/s" ADC
 SG_ ARC_OD_AabsXStd_Obj_00_FL : 89|7@0+ (0.25,0) [0|31.75] "m/s^2" ADC

BO_ 1390 ARC_OD_58_59_FR: 64 ARC
 SG_ DistHeight_Obj_59_FR : 487|8@0+ (0.2,-10) [-10|41] "m" Vector__XXX
 SG_ DistHeight_Obj_58_FR : 479|8@0+ (0.2,-10) [-10|41] "m" Vector__XXX
 SG_ ARC_OD_DistX_Obj_58_FR : 7|12@0+ (0.1,-152) [-152|257.5] "m" ADC
 SG_ ARC_OD_Classification_Obj_58_FR : 98|3@0+ (1,0) [0|7] "" ADC
 SG_ ARC_OD_AabsYStd_Obj_58_FR : 111|8@0+ (0.25,0) [0|63.75] "m/s^2" ADC
 SG_ ARC_OD_ClassConf_Obj_58_FR : 119|7@0+ (1,0) [0|127] "%" ADC
 SG_ ARC_OD_ProbOfExist_Obj_58_FR : 112|7@0+ (1,0) [0|127] "%" ADC
 SG_ ARC_OD_VabsX_Obj_58_FR : 11|11@0+ (0.125,-128) [-128|127.875] "m/s" ADC
 SG_ ARC_OD_DynProp_Obj_58_FR : 130|3@0+ (1,0) [0|7] "" ADC
 SG_ ARC_OD_Length_Obj_58_FR : 136|7@0+ (0.2,0) [0|25.4] "m" ADC
 SG_ ARC_OD_MaintenanceState_Obj_0001 : 145|2@0+ (1,0) [0|3] "" ADC
 SG_ ARC_OD_Width_Obj_58_FR : 159|7@0+ (0.2,0) [0|25.4] "m" ADC
 SG_ ARC_OD_RCS_Obj_58_FR : 152|9@0+ (0.2,-51.1) [-51.1|51.1] "dBsm" ADC
 SG_ ARC_OD_Orientation_Obj_58_FR : 175|10@0+ (0.01,-5.11) [-5.11|5.12] "rad" ADC
 SG_ ARC_OD_LifeCycle_Obj_58_FR : 207|16@0+ (1,0) [0|65535] "" ADC
 SG_ ARC_OD_DistX_Obj_59_FR : 223|12@0+ (0.1,-152) [-152|257.5] "m" ADC
 SG_ ARC_OD_VabsX_Obj_59_FR : 227|11@0+ (0.125,-128) [-128|127.875] "m/s" ADC
 SG_ ARC_OD_AabsX_Obj_59_FR : 232|9@0+ (0.125,-31.875) [-31.875|32] "m/s^2" ADC
 SG_ ARC_OD_AabsX_Obj_58_FR : 16|9@0+ (0.125,-31.875) [-31.875|32] "m/s^2" ADC
 SG_ ARC_OD_DistY_Obj_59_FR : 255|12@0+ (0.0875,-179.113) [-179.113|179.2] "m" ADC
 SG_ ARC_OD_VabsY_Obj_59_FR : 259|11@0+ (0.125,-128) [-128|127.875] "m/s" ADC
 SG_ ARC_OD_AabsY_Obj_59_FR : 264|9@0+ (0.125,-31.875) [-31.875|32] "m/s^2" ADC
 SG_ ARC_OD_DistXStd_Obj_59_FR : 287|8@0+ (0.05,0) [0|12.75] "m" ADC
 SG_ ARC_OD_DistYStd_Obj_59_FR : 295|8@0+ (0.1,0) [0|25.5] "m" ADC
 SG_ ARC_OD_VabsXStd_Obj_59_FR : 303|7@0+ (0.1,0) [0|12.7] "m/s" ADC
 SG_ ARC_OD_VabsYStd_Obj_59_FR : 296|7@0+ (0.2,0) [0|25.4] "m/s" ADC
 SG_ ARC_OD_AabsXStd_Obj_59_FR : 305|7@0+ (0.25,0) [0|31.75] "m/s^2" ADC
 SG_ ARC_OD_Classification_Obj_59_FR : 314|3@0+ (1,0) [0|7] "" ADC
 SG_ ARC_OD_AabsYStd_Obj_59_FR : 327|8@0+ (0.25,0) [0|63.75] "m/s^2" ADC
 SG_ ARC_OD_ClassConf_Obj_59_FR : 335|7@0+ (1,0) [0|127] "%" ADC
 SG_ ARC_OD_DistY_Obj_58_FR : 39|12@0+ (0.0875,-179.113) [-179.113|179.2] "m" ADC
 SG_ ARC_OD_ProbOfExist_Obj_59_FR : 328|7@0+ (1,0) [0|127] "%" ADC
 SG_ ARC_OD_DynProp_Obj_59_FR : 346|3@0+ (1,0) [0|7] "" ADC
 SG_ ARC_OD_Length_Obj_59_FR : 352|7@0+ (0.2,0) [0|25.4] "m" ADC
 SG_ ARC_OD_MaintenanceState_Obj_0002 : 361|2@0+ (1,0) [0|3] "" ADC
 SG_ ARC_OD_Width_Obj_59_FR : 375|7@0+ (0.2,0) [0|25.4] "m" ADC
 SG_ ARC_OD_RCS_Obj_59_FR : 368|9@0+ (0.2,-51.1) [-51.1|51.1] "dBsm" ADC
 SG_ ARC_OD_Orientation_Obj_59_FR : 391|10@0+ (0.01,-5.11) [-5.11|5.12] "rad" ADC
 SG_ ARC_OD_LifeCycle_Obj_59_FR : 423|16@0+ (1,0) [0|65535] "" ADC
 SG_ ARC_OD_ObstacleProb_Obj_58_FR : 447|7@0+ (1,0) [0|127] "%" ADC
 SG_ ARC_OD_ObstacleProb_Obj_59_FR : 455|7@0+ (1,0) [0|127] "%" ADC
 SG_ ARC_OD_VabsY_Obj_58_FR : 43|11@0+ (0.125,-128) [-128|127.875] "m/s" ADC
 SG_ ARC_OD_ID_58_FR : 463|8@0+ (1,0) [0|255] "" ADC
 SG_ ARC_OD_ID_59_FR : 471|8@0+ (1,0) [0|255] "" ADC
 SG_ ARC_OD_MsgCounter_Obj_58_59_FR : 491|4@0+ (1,0) [0|15] "" ADC
 SG_ ARC_OD_CRC8_Obj_58_59_FR : 511|8@0+ (1,0) [0|256] "" ADC
 SG_ ARC_OD_AabsY_Obj_58_FR : 48|9@0+ (0.125,-31.875) [-31.875|32] "m/s^2" ADC
 SG_ ARC_OD_DistXStd_Obj_58_FR : 71|8@0+ (0.05,0) [0|12.75] "m" ADC
 SG_ ARC_OD_DistYStd_Obj_58_FR : 79|8@0+ (0.1,0) [0|25.5] "m" ADC
 SG_ ARC_OD_VabsXStd_Obj_58_FR : 87|7@0+ (0.1,0) [0|12.7] "m/s" ADC
 SG_ ARC_OD_VabsYStd_Obj_58_FR : 80|7@0+ (0.2,0) [0|25.4] "m/s" ADC
 SG_ ARC_OD_AabsXStd_Obj_58_FR : 89|7@0+ (0.25,0) [0|31.75] "m/s^2" ADC

BO_ 1389 ARC_OD_56_57_FR: 64 ARC
 SG_ DistHeight_Obj_57_FR : 487|8@0+ (0.2,-10) [-10|41] "m" Vector__XXX
 SG_ DistHeight_Obj_56_FR : 479|8@0+ (0.2,-10) [-10|41] "m" Vector__XXX
 SG_ ARC_OD_DistX_Obj_56_FR : 7|12@0+ (0.1,-152) [-152|257.5] "m" ADC
 SG_ ARC_OD_Classification_Obj_56_FR : 98|3@0+ (1,0) [0|7] "" ADC
 SG_ ARC_OD_AabsYStd_Obj_56_FR : 111|8@0+ (0.25,0) [0|63.75] "m/s^2" ADC
 SG_ ARC_OD_ClassConf_Obj_56_FR : 119|7@0+ (1,0) [0|127] "%" ADC
 SG_ ARC_OD_ProbOfExist_Obj_56_FR : 112|7@0+ (1,0) [0|127] "%" ADC
 SG_ ARC_OD_VabsX_Obj_56_FR : 11|11@0+ (0.125,-128) [-128|127.875] "m/s" ADC
 SG_ ARC_OD_DynProp_Obj_56_FR : 130|3@0+ (1,0) [0|7] "" ADC
 SG_ ARC_OD_Length_Obj_56_FR : 136|7@0+ (0.2,0) [0|25.4] "m" ADC
 SG_ ARC_OD_MaintenanceState_Obj_0003 : 145|2@0+ (1,0) [0|3] "" ADC
 SG_ ARC_OD_Width_Obj_56_FR : 159|7@0+ (0.2,0) [0|25.4] "m" ADC
 SG_ ARC_OD_RCS_Obj_56_FR : 152|9@0+ (0.2,-51.1) [-51.1|51.1] "dBsm" ADC
 SG_ ARC_OD_Orientation_Obj_56_FR : 175|10@0+ (0.01,-5.11) [-5.11|5.12] "rad" ADC
 SG_ ARC_OD_LifeCycle_Obj_56_FR : 207|16@0+ (1,0) [0|65535] "" ADC
 SG_ ARC_OD_DistX_Obj_57_FR : 223|12@0+ (0.1,-152) [-152|257.5] "m" ADC
 SG_ ARC_OD_VabsX_Obj_57_FR : 227|11@0+ (0.125,-128) [-128|127.875] "m/s" ADC
 SG_ ARC_OD_AabsX_Obj_57_FR : 232|9@0+ (0.125,-31.875) [-31.875|32] "m/s^2" ADC
 SG_ ARC_OD_AabsX_Obj_56_FR : 16|9@0+ (0.125,-31.875) [-31.875|32] "m/s^2" ADC
 SG_ ARC_OD_DistY_Obj_57_FR : 255|12@0+ (0.0875,-179.113) [-179.113|179.2] "m" ADC
 SG_ ARC_OD_VabsY_Obj_57_FR : 259|11@0+ (0.125,-128) [-128|127.875] "m/s" ADC
 SG_ ARC_OD_AabsY_Obj_57_FR : 264|9@0+ (0.125,-31.875) [-31.875|32] "m/s^2" ADC
 SG_ ARC_OD_DistXStd_Obj_57_FR : 287|8@0+ (0.05,0) [0|12.75] "m" ADC
 SG_ ARC_OD_DistYStd_Obj_57_FR : 295|8@0+ (0.1,0) [0|25.5] "m" ADC
 SG_ ARC_OD_VabsXStd_Obj_57_FR : 303|7@0+ (0.1,0) [0|12.7] "m/s" ADC
 SG_ ARC_OD_VabsYStd_Obj_57_FR : 296|7@0+ (0.2,0) [0|25.4] "m/s" ADC
 SG_ ARC_OD_AabsXStd_Obj_57_FR : 305|7@0+ (0.25,0) [0|31.75] "m/s^2" ADC
 SG_ ARC_OD_Classification_Obj_57_FR : 314|3@0+ (1,0) [0|7] "" ADC
 SG_ ARC_OD_AabsYStd_Obj_57_FR : 327|8@0+ (0.25,0) [0|63.75] "m/s^2" ADC
 SG_ ARC_OD_ClassConf_Obj_57_FR : 335|7@0+ (1,0) [0|127] "%" ADC
 SG_ ARC_OD_DistY_Obj_56_FR : 39|12@0+ (0.0875,-179.113) [-179.113|179.2] "m" ADC
 SG_ ARC_OD_ProbOfExist_Obj_57_FR : 328|7@0+ (1,0) [0|127] "%" ADC
 SG_ ARC_OD_DynProp_Obj_57_FR : 346|3@0+ (1,0) [0|7] "" ADC
 SG_ ARC_OD_Length_Obj_57_FR : 352|7@0+ (0.2,0) [0|25.4] "m" ADC
 SG_ ARC_OD_MaintenanceState_Obj_0004 : 361|2@0+ (1,0) [0|3] "" ADC
 SG_ ARC_OD_Width_Obj_57_FR : 375|7@0+ (0.2,0) [0|25.4] "m" ADC
 SG_ ARC_OD_RCS_Obj_57_FR : 368|9@0+ (0.2,-51.1) [-51.1|51.1] "dBsm" ADC
 SG_ ARC_OD_Orientation_Obj_57_FR : 391|10@0+ (0.01,-5.11) [-5.11|5.12] "rad" ADC
 SG_ ARC_OD_LifeCycle_Obj_57_FR : 423|16@0+ (1,0) [0|65535] "" ADC
 SG_ ARC_OD_ObstacleProb_Obj_56_FR : 447|7@0+ (1,0) [0|127] "%" ADC
 SG_ ARC_OD_ObstacleProb_Obj_57_FR : 455|7@0+ (1,0) [0|127] "%" ADC
 SG_ ARC_OD_VabsY_Obj_56_FR : 43|11@0+ (0.125,-128) [-128|127.875] "m/s" ADC
 SG_ ARC_OD_ID_56_FR : 463|8@0+ (1,0) [0|255] "" ADC
 SG_ ARC_OD_ID_57_FR : 471|8@0+ (1,0) [0|255] "" ADC
 SG_ ARC_OD_MsgCounter_Obj_56_57_FR : 491|4@0+ (1,0) [0|15] "" ADC
 SG_ ARC_OD_CRC8_Obj_56_57_FR : 511|8@0+ (1,0) [0|256] "" ADC
 SG_ ARC_OD_AabsY_Obj_56_FR : 48|9@0+ (0.125,-31.875) [-31.875|32] "m/s^2" ADC
 SG_ ARC_OD_DistXStd_Obj_56_FR : 71|8@0+ (0.05,0) [0|12.75] "m" ADC
 SG_ ARC_OD_DistYStd_Obj_56_FR : 79|8@0+ (0.1,0) [0|25.5] "m" ADC
 SG_ ARC_OD_VabsXStd_Obj_56_FR : 87|7@0+ (0.1,0) [0|12.7] "m/s" ADC
 SG_ ARC_OD_VabsYStd_Obj_56_FR : 80|7@0+ (0.2,0) [0|25.4] "m/s" ADC
 SG_ ARC_OD_AabsXStd_Obj_56_FR : 89|7@0+ (0.25,0) [0|31.75] "m/s^2" ADC

BO_ 1388 ARC_OD_54_55_FR: 64 ARC
 SG_ DistHeight_Obj_54_FR : 479|8@0+ (0.2,-10) [-10|41] "m" Vector__XXX
 SG_ DistHeight_Obj_55_FR : 487|8@0+ (0.2,-10) [-10|41] "m" Vector__XXX
 SG_ ARC_OD_DistX_Obj_54_FR : 7|12@0+ (0.1,-152) [-152|257.5] "m" ADC
 SG_ ARC_OD_Classification_Obj_54_FR : 98|3@0+ (1,0) [0|7] "" ADC
 SG_ ARC_OD_AabsYStd_Obj_54_FR : 111|8@0+ (0.25,0) [0|63.75] "m/s^2" ADC
 SG_ ARC_OD_ClassConf_Obj_54_FR : 119|7@0+ (1,0) [0|127] "%" ADC
 SG_ ARC_OD_ProbOfExist_Obj_54_FR : 112|7@0+ (1,0) [0|127] "%" ADC
 SG_ ARC_OD_VabsX_Obj_54_FR : 11|11@0+ (0.125,-128) [-128|127.875] "m/s" ADC
 SG_ ARC_OD_DynProp_Obj_54_FR : 130|3@0+ (1,0) [0|7] "" ADC
 SG_ ARC_OD_Length_Obj_54_FR : 136|7@0+ (0.2,0) [0|25.4] "m" ADC
 SG_ ARC_OD_MaintenanceState_Obj_0005 : 145|2@0+ (1,0) [0|3] "" ADC
 SG_ ARC_OD_Width_Obj_54_FR : 159|7@0+ (0.2,0) [0|25.4] "m" ADC
 SG_ ARC_OD_RCS_Obj_54_FR : 152|9@0+ (0.2,-51.1) [-51.1|51.1] "dBsm" ADC
 SG_ ARC_OD_Orientation_Obj_54_FR : 175|10@0+ (0.01,-5.11) [-5.11|5.12] "rad" ADC
 SG_ ARC_OD_LifeCycle_Obj_54_FR : 207|16@0+ (1,0) [0|65535] "" ADC
 SG_ ARC_OD_DistX_Obj_55_FR : 223|12@0+ (0.1,-152) [-152|257.5] "m" ADC
 SG_ ARC_OD_VabsX_Obj_55_FR : 227|11@0+ (0.125,-128) [-128|127.875] "m/s" ADC
 SG_ ARC_OD_AabsX_Obj_55_FR : 232|9@0+ (0.125,-31.875) [-31.875|32] "m/s^2" ADC
 SG_ ARC_OD_AabsX_Obj_54_FR : 16|9@0+ (0.125,-31.875) [-31.875|32] "m/s^2" ADC
 SG_ ARC_OD_DistY_Obj_55_FR : 255|12@0+ (0.0875,-179.113) [-179.113|179.2] "m" ADC
 SG_ ARC_OD_VabsY_Obj_55_FR : 259|11@0+ (0.125,-128) [-128|127.875] "m/s" ADC
 SG_ ARC_OD_AabsY_Obj_55_FR : 264|9@0+ (0.125,-31.875) [-31.875|32] "m/s^2" ADC
 SG_ ARC_OD_DistXStd_Obj_55_FR : 287|8@0+ (0.05,0) [0|12.75] "m" ADC
 SG_ ARC_OD_DistYStd_Obj_55_FR : 295|8@0+ (0.1,0) [0|25.5] "m" ADC
 SG_ ARC_OD_VabsXStd_Obj_55_FR : 303|7@0+ (0.1,0) [0|12.7] "m/s" ADC
 SG_ ARC_OD_VabsYStd_Obj_55_FR : 296|7@0+ (0.2,0) [0|25.4] "m/s" ADC
 SG_ ARC_OD_AabsXStd_Obj_55_FR : 305|7@0+ (0.25,0) [0|31.75] "m/s^2" ADC
 SG_ ARC_OD_Classification_Obj_55_FR : 314|3@0+ (1,0) [0|7] "" ADC
 SG_ ARC_OD_AabsYStd_Obj_55_FR : 327|8@0+ (0.25,0) [0|63.75] "m/s^2" ADC
 SG_ ARC_OD_ClassConf_Obj_55_FR : 335|7@0+ (1,0) [0|127] "%" ADC
 SG_ ARC_OD_DistY_Obj_54_FR : 39|12@0+ (0.0875,-179.113) [-179.113|179.2] "m" ADC
 SG_ ARC_OD_ProbOfExist_Obj_55_FR : 328|7@0+ (1,0) [0|127] "%" ADC
 SG_ ARC_OD_DynProp_Obj_55_FR : 346|3@0+ (1,0) [0|7] "" ADC
 SG_ ARC_OD_Length_Obj_55_FR : 352|7@0+ (0.2,0) [0|25.4] "m" ADC
 SG_ ARC_OD_MaintenanceState_Obj_0006 : 361|2@0+ (1,0) [0|3] "" ADC
 SG_ ARC_OD_Width_Obj_55_FR : 375|7@0+ (0.2,0) [0|25.4] "m" ADC
 SG_ ARC_OD_RCS_Obj_55_FR : 368|9@0+ (0.2,-51.1) [-51.1|51.1] "dBsm" ADC
 SG_ ARC_OD_Orientation_Obj_55_FR : 391|10@0+ (0.01,-5.11) [-5.11|5.12] "rad" ADC
 SG_ ARC_OD_LifeCycle_Obj_55_FR : 423|16@0+ (1,0) [0|65535] "" ADC
 SG_ ARC_OD_ObstacleProb_Obj_54_FR : 447|7@0+ (1,0) [0|127] "%" ADC
 SG_ ARC_OD_ObstacleProb_Obj_55_FR : 455|7@0+ (1,0) [0|127] "%" ADC
 SG_ ARC_OD_VabsY_Obj_54_FR : 43|11@0+ (0.125,-128) [-128|127.875] "m/s" ADC
 SG_ ARC_OD_ID_54_FR : 463|8@0+ (1,0) [0|255] "" ADC
 SG_ ARC_OD_ID_55_FR : 471|8@0+ (1,0) [0|255] "" ADC
 SG_ ARC_OD_MsgCounter_Obj_54_55_FR : 491|4@0+ (1,0) [0|15] "" ADC
 SG_ ARC_OD_CRC8_Obj_54_55_FR : 511|8@0+ (1,0) [0|256] "" ADC
 SG_ ARC_OD_AabsY_Obj_54_FR : 48|9@0+ (0.125,-31.875) [-31.875|32] "m/s^2" ADC
 SG_ ARC_OD_DistXStd_Obj_54_FR : 71|8@0+ (0.05,0) [0|12.75] "m" ADC
 SG_ ARC_OD_DistYStd_Obj_54_FR : 79|8@0+ (0.1,0) [0|25.5] "m" ADC
 SG_ ARC_OD_VabsXStd_Obj_54_FR : 87|7@0+ (0.1,0) [0|12.7] "m/s" ADC
 SG_ ARC_OD_VabsYStd_Obj_54_FR : 80|7@0+ (0.2,0) [0|25.4] "m/s" ADC
 SG_ ARC_OD_AabsXStd_Obj_54_FR : 89|7@0+ (0.25,0) [0|31.75] "m/s^2" ADC

BO_ 1387 ARC_OD_52_53_FR: 64 ARC
 SG_ DistHeight_Obj_53_FR : 487|8@0+ (0.2,-10) [-10|41] "m" Vector__XXX
 SG_ DistHeight_Obj_52_FR : 479|8@0+ (0.2,-10) [-10|41] "m" Vector__XXX
 SG_ ARC_OD_DistX_Obj_52_FR : 7|12@0+ (0.1,-152) [-152|257.5] "m" ADC
 SG_ ARC_OD_Classification_Obj_52_FR : 98|3@0+ (1,0) [0|7] "" ADC
 SG_ ARC_OD_AabsYStd_Obj_52_FR : 111|8@0+ (0.25,0) [0|63.75] "m/s^2" ADC
 SG_ ARC_OD_ClassConf_Obj_52_FR : 119|7@0+ (1,0) [0|127] "%" ADC
 SG_ ARC_OD_ProbOfExist_Obj_52_FR : 112|7@0+ (1,0) [0|127] "%" ADC
 SG_ ARC_OD_VabsX_Obj_52_FR : 11|11@0+ (0.125,-128) [-128|127.875] "m/s" ADC
 SG_ ARC_OD_DynProp_Obj_52_FR : 130|3@0+ (1,0) [0|7] "" ADC
 SG_ ARC_OD_Length_Obj_52_FR : 136|7@0+ (0.2,0) [0|25.4] "m" ADC
 SG_ ARC_OD_MaintenanceState_Obj_0007 : 145|2@0+ (1,0) [0|3] "" ADC
 SG_ ARC_OD_Width_Obj_52_FR : 159|7@0+ (0.2,0) [0|25.4] "m" ADC
 SG_ ARC_OD_RCS_Obj_52_FR : 152|9@0+ (0.2,-51.1) [-51.1|51.1] "dBsm" ADC
 SG_ ARC_OD_Orientation_Obj_52_FR : 175|10@0+ (0.01,-5.11) [-5.11|5.12] "rad" ADC
 SG_ ARC_OD_LifeCycle_Obj_52_FR : 207|16@0+ (1,0) [0|65535] "" ADC
 SG_ ARC_OD_DistX_Obj_53_FR : 223|12@0+ (0.1,-152) [-152|257.5] "m" ADC
 SG_ ARC_OD_VabsX_Obj_53_FR : 227|11@0+ (0.125,-128) [-128|127.875] "m/s" ADC
 SG_ ARC_OD_AabsX_Obj_53_FR : 232|9@0+ (0.125,-31.875) [-31.875|32] "m/s^2" ADC
 SG_ ARC_OD_AabsX_Obj_52_FR : 16|9@0+ (0.125,-31.875) [-31.875|32] "m/s^2" ADC
 SG_ ARC_OD_DistY_Obj_53_FR : 255|12@0+ (0.0875,-179.113) [-179.113|179.2] "m" ADC
 SG_ ARC_OD_VabsY_Obj_53_FR : 259|11@0+ (0.125,-128) [-128|127.875] "m/s" ADC
 SG_ ARC_OD_AabsY_Obj_53_FR : 264|9@0+ (0.125,-31.875) [-31.875|32] "m/s^2" ADC
 SG_ ARC_OD_DistXStd_Obj_53_FR : 287|8@0+ (0.05,0) [0|12.75] "m" ADC
 SG_ ARC_OD_DistYStd_Obj_53_FR : 295|8@0+ (0.1,0) [0|25.5] "m" ADC
 SG_ ARC_OD_VabsXStd_Obj_53_FR : 303|7@0+ (0.1,0) [0|12.7] "m/s" ADC
 SG_ ARC_OD_VabsYStd_Obj_53_FR : 296|7@0+ (0.2,0) [0|25.4] "m/s" ADC
 SG_ ARC_OD_AabsXStd_Obj_53_FR : 305|7@0+ (0.25,0) [0|31.75] "m/s^2" ADC
 SG_ ARC_OD_Classification_Obj_53_FR : 314|3@0+ (1,0) [0|7] "" ADC
 SG_ ARC_OD_AabsYStd_Obj_53_FR : 327|8@0+ (0.25,0) [0|63.75] "m/s^2" ADC
 SG_ ARC_OD_ClassConf_Obj_53_FR : 335|7@0+ (1,0) [0|127] "%" ADC
 SG_ ARC_OD_DistY_Obj_52_FR : 39|12@0+ (0.0875,-179.113) [-179.113|179.2] "m" ADC
 SG_ ARC_OD_ProbOfExist_Obj_53_FR : 328|7@0+ (1,0) [0|127] "%" ADC
 SG_ ARC_OD_DynProp_Obj_53_FR : 346|3@0+ (1,0) [0|7] "" ADC
 SG_ ARC_OD_Length_Obj_53_FR : 352|7@0+ (0.2,0) [0|25.4] "m" ADC
 SG_ ARC_OD_MaintenanceState_Obj_0008 : 361|2@0+ (1,0) [0|3] "" ADC
 SG_ ARC_OD_Width_Obj_53_FR : 375|7@0+ (0.2,0) [0|25.4] "m" ADC
 SG_ ARC_OD_RCS_Obj_53_FR : 368|9@0+ (0.2,-51.1) [-51.1|51.1] "dBsm" ADC
 SG_ ARC_OD_Orientation_Obj_53_FR : 391|10@0+ (0.01,-5.11) [-5.11|5.12] "rad" ADC
 SG_ ARC_OD_LifeCycle_Obj_53_FR : 423|16@0+ (1,0) [0|65535] "" ADC
 SG_ ARC_OD_ObstacleProb_Obj_52_FR : 447|7@0+ (1,0) [0|127] "%" ADC
 SG_ ARC_OD_ObstacleProb_Obj_53_FR : 455|7@0+ (1,0) [0|127] "%" ADC
 SG_ ARC_OD_VabsY_Obj_52_FR : 43|11@0+ (0.125,-128) [-128|127.875] "m/s" ADC
 SG_ ARC_OD_ID_52_FR : 463|8@0+ (1,0) [0|255] "" ADC
 SG_ ARC_OD_ID_53_FR : 471|8@0+ (1,0) [0|255] "" ADC
 SG_ ARC_OD_MsgCounter_Obj_52_53_FR : 491|4@0+ (1,0) [0|15] "" ADC
 SG_ ARC_OD_CRC8_Obj_52_53_FR : 511|8@0+ (1,0) [0|256] "" ADC
 SG_ ARC_OD_AabsY_Obj_52_FR : 48|9@0+ (0.125,-31.875) [-31.875|32] "m/s^2" ADC
 SG_ ARC_OD_DistXStd_Obj_52_FR : 71|8@0+ (0.05,0) [0|12.75] "m" ADC
 SG_ ARC_OD_DistYStd_Obj_52_FR : 79|8@0+ (0.1,0) [0|25.5] "m" ADC
 SG_ ARC_OD_VabsXStd_Obj_52_FR : 87|7@0+ (0.1,0) [0|12.7] "m/s" ADC
 SG_ ARC_OD_VabsYStd_Obj_52_FR : 80|7@0+ (0.2,0) [0|25.4] "m/s" ADC
 SG_ ARC_OD_AabsXStd_Obj_52_FR : 89|7@0+ (0.25,0) [0|31.75] "m/s^2" ADC

BO_ 1386 ARC_OD_50_51_FR: 64 ARC
 SG_ DistHeight_Obj_51_FR : 487|8@0+ (0.2,-10) [-10|41] "m" Vector__XXX
 SG_ DistHeight_Obj_50_FR : 479|8@0+ (0.2,-10) [-10|41] "m" Vector__XXX
 SG_ ARC_OD_DistX_Obj_50_FR : 7|12@0+ (0.1,-152) [-152|257.5] "m" ADC
 SG_ ARC_OD_Classification_Obj_50_FR : 98|3@0+ (1,0) [0|7] "" ADC
 SG_ ARC_OD_AabsYStd_Obj_50_FR : 111|8@0+ (0.25,0) [0|63.75] "m/s^2" ADC
 SG_ ARC_OD_ClassConf_Obj_50_FR : 119|7@0+ (1,0) [0|127] "%" ADC
 SG_ ARC_OD_ProbOfExist_Obj_50_FR : 112|7@0+ (1,0) [0|127] "%" ADC
 SG_ ARC_OD_VabsX_Obj_50_FR : 11|11@0+ (0.125,-128) [-128|127.875] "m/s" ADC
 SG_ ARC_OD_DynProp_Obj_50_FR : 130|3@0+ (1,0) [0|7] "" ADC
 SG_ ARC_OD_Length_Obj_50_FR : 136|7@0+ (0.2,0) [0|25.4] "m" ADC
 SG_ ARC_OD_MaintenanceState_Obj_0009 : 145|2@0+ (1,0) [0|3] "" ADC
 SG_ ARC_OD_Width_Obj_50_FR : 159|7@0+ (0.2,0) [0|25.4] "m" ADC
 SG_ ARC_OD_RCS_Obj_50_FR : 152|9@0+ (0.2,-51.1) [-51.1|51.1] "dBsm" ADC
 SG_ ARC_OD_Orientation_Obj_50_FR : 175|10@0+ (0.01,-5.11) [-5.11|5.12] "rad" ADC
 SG_ ARC_OD_LifeCycle_Obj_50_FR : 207|16@0+ (1,0) [0|65535] "" ADC
 SG_ ARC_OD_DistX_Obj_51_FR : 223|12@0+ (0.1,-152) [-152|257.5] "m" ADC
 SG_ ARC_OD_VabsX_Obj_51_FR : 227|11@0+ (0.125,-128) [-128|127.875] "m/s" ADC
 SG_ ARC_OD_AabsX_Obj_51_FR : 232|9@0+ (0.125,-31.875) [-31.875|32] "m/s^2" ADC
 SG_ ARC_OD_AabsX_Obj_50_FR : 16|9@0+ (0.125,-31.875) [-31.875|32] "m/s^2" ADC
 SG_ ARC_OD_DistY_Obj_51_FR : 255|12@0+ (0.0875,-179.113) [-179.113|179.2] "m" ADC
 SG_ ARC_OD_VabsY_Obj_51_FR : 259|11@0+ (0.125,-128) [-128|127.875] "m/s" ADC
 SG_ ARC_OD_AabsY_Obj_51_FR : 264|9@0+ (0.125,-31.875) [-31.875|32] "m/s^2" ADC
 SG_ ARC_OD_DistXStd_Obj_51_FR : 287|8@0+ (0.05,0) [0|12.75] "m" ADC
 SG_ ARC_OD_DistYStd_Obj_51_FR : 295|8@0+ (0.1,0) [0|25.5] "m" ADC
 SG_ ARC_OD_VabsXStd_Obj_51_FR : 303|7@0+ (0.1,0) [0|12.7] "m/s" ADC
 SG_ ARC_OD_VabsYStd_Obj_51_FR : 296|7@0+ (0.2,0) [0|25.4] "m/s" ADC
 SG_ ARC_OD_AabsXStd_Obj_51_FR : 305|7@0+ (0.25,0) [0|31.75] "m/s^2" ADC
 SG_ ARC_OD_Classification_Obj_51_FR : 314|3@0+ (1,0) [0|7] "" ADC
 SG_ ARC_OD_AabsYStd_Obj_51_FR : 327|8@0+ (0.25,0) [0|63.75] "m/s^2" ADC
 SG_ ARC_OD_ClassConf_Obj_51_FR : 335|7@0+ (1,0) [0|127] "%" ADC
 SG_ ARC_OD_DistY_Obj_50_FR : 39|12@0+ (0.0875,-179.113) [-179.113|179.2] "m" ADC
 SG_ ARC_OD_ProbOfExist_Obj_51_FR : 328|7@0+ (1,0) [0|127] "%" ADC
 SG_ ARC_OD_DynProp_Obj_51_FR : 346|3@0+ (1,0) [0|7] "" ADC
 SG_ ARC_OD_Length_Obj_51_FR : 352|7@0+ (0.2,0) [0|25.4] "m" ADC
 SG_ ARC_OD_MaintenanceState_Obj_0010 : 361|2@0+ (1,0) [0|3] "" ADC
 SG_ ARC_OD_Width_Obj_51_FR : 375|7@0+ (0.2,0) [0|25.4] "m" ADC
 SG_ ARC_OD_RCS_Obj_51_FR : 368|9@0+ (0.2,-51.1) [-51.1|51.1] "dBsm" ADC
 SG_ ARC_OD_Orientation_Obj_51_FR : 391|10@0+ (0.01,-5.11) [-5.11|5.12] "rad" ADC
 SG_ ARC_OD_LifeCycle_Obj_51_FR : 423|16@0+ (1,0) [0|65535] "" ADC
 SG_ ARC_OD_ObstacleProb_Obj_50_FR : 447|7@0+ (1,0) [0|127] "%" ADC
 SG_ ARC_OD_ObstacleProb_Obj_51_FR : 455|7@0+ (1,0) [0|127] "%" ADC
 SG_ ARC_OD_VabsY_Obj_50_FR : 43|11@0+ (0.125,-128) [-128|127.875] "m/s" ADC
 SG_ ARC_OD_ID_50_FR : 463|8@0+ (1,0) [0|255] "" ADC
 SG_ ARC_OD_ID_51_FR : 471|8@0+ (1,0) [0|255] "" ADC
 SG_ ARC_OD_MsgCounter_Obj_50_51_FR : 491|4@0+ (1,0) [0|15] "" ADC
 SG_ ARC_OD_CRC8_Obj_50_51_FR : 511|8@0+ (1,0) [0|256] "" ADC
 SG_ ARC_OD_AabsY_Obj_50_FR : 48|9@0+ (0.125,-31.875) [-31.875|32] "m/s^2" ADC
 SG_ ARC_OD_DistXStd_Obj_50_FR : 71|8@0+ (0.05,0) [0|12.75] "m" ADC
 SG_ ARC_OD_DistYStd_Obj_50_FR : 79|8@0+ (0.1,0) [0|25.5] "m" ADC
 SG_ ARC_OD_VabsXStd_Obj_50_FR : 87|7@0+ (0.1,0) [0|12.7] "m/s" ADC
 SG_ ARC_OD_VabsYStd_Obj_50_FR : 80|7@0+ (0.2,0) [0|25.4] "m/s" ADC
 SG_ ARC_OD_AabsXStd_Obj_50_FR : 89|7@0+ (0.25,0) [0|31.75] "m/s^2" ADC

BO_ 1385 ARC_OD_48_49_FR: 64 ARC
 SG_ DistHeight_Obj_49_FR : 487|8@0+ (0.2,-10) [-10|41] "m" Vector__XXX
 SG_ DistHeight_Obj_48_FR : 479|8@0+ (0.2,-10) [-10|41] "m" Vector__XXX
 SG_ ARC_OD_DistX_Obj_48_FR : 7|12@0+ (0.1,-152) [-152|257.5] "m" ADC
 SG_ ARC_OD_Classification_Obj_48_FR : 98|3@0+ (1,0) [0|7] "" ADC
 SG_ ARC_OD_AabsYStd_Obj_48_FR : 111|8@0+ (0.25,0) [0|63.75] "m/s^2" ADC
 SG_ ARC_OD_ClassConf_Obj_48_FR : 119|7@0+ (1,0) [0|127] "%" ADC
 SG_ ARC_OD_ProbOfExist_Obj_48_FR : 112|7@0+ (1,0) [0|127] "%" ADC
 SG_ ARC_OD_VabsX_Obj_48_FR : 11|11@0+ (0.125,-128) [-128|127.875] "m/s" ADC
 SG_ ARC_OD_DynProp_Obj_48_FR : 130|3@0+ (1,0) [0|7] "" ADC
 SG_ ARC_OD_Length_Obj_48_FR : 136|7@0+ (0.2,0) [0|25.4] "m" ADC
 SG_ ARC_OD_MaintenanceState_Obj_0011 : 145|2@0+ (1,0) [0|3] "" ADC
 SG_ ARC_OD_Width_Obj_48_FR : 159|7@0+ (0.2,0) [0|25.4] "m" ADC
 SG_ ARC_OD_RCS_Obj_48_FR : 152|9@0+ (0.2,-51.1) [-51.1|51.1] "dBsm" ADC
 SG_ ARC_OD_Orientation_Obj_48_FR : 175|10@0+ (0.01,-5.11) [-5.11|5.12] "rad" ADC
 SG_ ARC_OD_LifeCycle_Obj_48_FR : 207|16@0+ (1,0) [0|65535] "" ADC
 SG_ ARC_OD_DistX_Obj_49_FR : 223|12@0+ (0.1,-152) [-152|257.5] "m" ADC
 SG_ ARC_OD_VabsX_Obj_49_FR : 227|11@0+ (0.125,-128) [-128|127.875] "m/s" ADC
 SG_ ARC_OD_AabsX_Obj_49_FR : 232|9@0+ (0.125,-31.875) [-31.875|32] "m/s^2" ADC
 SG_ ARC_OD_AabsX_Obj_48_FR : 16|9@0+ (0.125,-31.875) [-31.875|32] "m/s^2" ADC
 SG_ ARC_OD_DistY_Obj_49_FR : 255|12@0+ (0.0875,-179.113) [-179.113|179.2] "m" ADC
 SG_ ARC_OD_VabsY_Obj_49_FR : 259|11@0+ (0.125,-128) [-128|127.875] "m/s" ADC
 SG_ ARC_OD_AabsY_Obj_49_FR : 264|9@0+ (0.125,-31.875) [-31.875|32] "m/s^2" ADC
 SG_ ARC_OD_DistXStd_Obj_49_FR : 287|8@0+ (0.05,0) [0|12.75] "m" ADC
 SG_ ARC_OD_DistYStd_Obj_49_FR : 295|8@0+ (0.1,0) [0|25.5] "m" ADC
 SG_ ARC_OD_VabsXStd_Obj_49_FR : 303|7@0+ (0.1,0) [0|12.7] "m/s" ADC
 SG_ ARC_OD_VabsYStd_Obj_49_FR : 296|7@0+ (0.2,0) [0|25.4] "m/s" ADC
 SG_ ARC_OD_AabsXStd_Obj_49_FR : 305|7@0+ (0.25,0) [0|31.75] "m/s^2" ADC
 SG_ ARC_OD_Classification_Obj_49_FR : 314|3@0+ (1,0) [0|7] "" ADC
 SG_ ARC_OD_AabsYStd_Obj_49_FR : 327|8@0+ (0.25,0) [0|63.75] "m/s^2" ADC
 SG_ ARC_OD_ClassConf_Obj_49_FR : 335|7@0+ (1,0) [0|127] "%" ADC
 SG_ ARC_OD_DistY_Obj_48_FR : 39|12@0+ (0.0875,-179.113) [-179.113|179.2] "m" ADC
 SG_ ARC_OD_ProbOfExist_Obj_49_FR : 328|7@0+ (1,0) [0|127] "%" ADC
 SG_ ARC_OD_DynProp_Obj_49_FR : 346|3@0+ (1,0) [0|7] "" ADC
 SG_ ARC_OD_Length_Obj_49_FR : 352|7@0+ (0.2,0) [0|25.4] "m" ADC
 SG_ ARC_OD_MaintenanceState_Obj_0012 : 361|2@0+ (1,0) [0|3] "" ADC
 SG_ ARC_OD_Width_Obj_49_FR : 375|7@0+ (0.2,0) [0|25.4] "m" ADC
 SG_ ARC_OD_RCS_Obj_49_FR : 368|9@0+ (0.2,-51.1) [-51.1|51.1] "dBsm" ADC
 SG_ ARC_OD_Orientation_Obj_49_FR : 391|10@0+ (0.01,-5.11) [-5.11|5.12] "rad" ADC
 SG_ ARC_OD_LifeCycle_Obj_49_FR : 423|16@0+ (1,0) [0|65535] "" ADC
 SG_ ARC_OD_ObstacleProb_Obj_48_FR : 447|7@0+ (1,0) [0|127] "%" ADC
 SG_ ARC_OD_ObstacleProb_Obj_49_FR : 455|7@0+ (1,0) [0|127] "%" ADC
 SG_ ARC_OD_VabsY_Obj_48_FR : 43|11@0+ (0.125,-128) [-128|127.875] "m/s" ADC
 SG_ ARC_OD_ID_48_FR : 463|8@0+ (1,0) [0|255] "" ADC
 SG_ ARC_OD_ID_49_FR : 471|8@0+ (1,0) [0|255] "" ADC
 SG_ ARC_OD_MsgCounter_Obj_48_49_FR : 491|4@0+ (1,0) [0|15] "" ADC
 SG_ ARC_OD_CRC8_Obj_48_49_FR : 511|8@0+ (1,0) [0|256] "" ADC
 SG_ ARC_OD_AabsY_Obj_48_FR : 48|9@0+ (0.125,-31.875) [-31.875|32] "m/s^2" ADC
 SG_ ARC_OD_DistXStd_Obj_48_FR : 71|8@0+ (0.05,0) [0|12.75] "m" ADC
 SG_ ARC_OD_DistYStd_Obj_48_FR : 79|8@0+ (0.1,0) [0|25.5] "m" ADC
 SG_ ARC_OD_VabsXStd_Obj_48_FR : 87|7@0+ (0.1,0) [0|12.7] "m/s" ADC
 SG_ ARC_OD_VabsYStd_Obj_48_FR : 80|7@0+ (0.2,0) [0|25.4] "m/s" ADC
 SG_ ARC_OD_AabsXStd_Obj_48_FR : 89|7@0+ (0.25,0) [0|31.75] "m/s^2" ADC

BO_ 1384 ARC_OD_46_47_FR: 64 ARC
 SG_ DistHeight_Obj_47_FR : 487|8@0+ (0.2,-10) [-10|41] "m" Vector__XXX
 SG_ DistHeight_Obj_46_FR : 479|8@0+ (0.2,-10) [-10|41] "m" Vector__XXX
 SG_ ARC_OD_DistX_Obj_46_FR : 7|12@0+ (0.1,-152) [-152|257.5] "m" ADC
 SG_ ARC_OD_Classification_Obj_46_FR : 98|3@0+ (1,0) [0|7] "" ADC
 SG_ ARC_OD_AabsYStd_Obj_46_FR : 111|8@0+ (0.25,0) [0|63.75] "m/s^2" ADC
 SG_ ARC_OD_ClassConf_Obj_46_FR : 119|7@0+ (1,0) [0|127] "%" ADC
 SG_ ARC_OD_ProbOfExist_Obj_46_FR : 112|7@0+ (1,0) [0|127] "%" ADC
 SG_ ARC_OD_VabsX_Obj_46_FR : 11|11@0+ (0.125,-128) [-128|127.875] "m/s" ADC
 SG_ ARC_OD_DynProp_Obj_46_FR : 130|3@0+ (1,0) [0|7] "" ADC
 SG_ ARC_OD_Length_Obj_46_FR : 136|7@0+ (0.2,0) [0|25.4] "m" ADC
 SG_ ARC_OD_MaintenanceState_Obj_0013 : 145|2@0+ (1,0) [0|3] "" ADC
 SG_ ARC_OD_Width_Obj_46_FR : 159|7@0+ (0.2,0) [0|25.4] "m" ADC
 SG_ ARC_OD_RCS_Obj_46_FR : 152|9@0+ (0.2,-51.1) [-51.1|51.1] "dBsm" ADC
 SG_ ARC_OD_Orientation_Obj_46_FR : 175|10@0+ (0.01,-5.11) [-5.11|5.12] "rad" ADC
 SG_ ARC_OD_LifeCycle_Obj_46_FR : 207|16@0+ (1,0) [0|65535] "" ADC
 SG_ ARC_OD_DistX_Obj_47_FR : 223|12@0+ (0.1,-152) [-152|257.5] "m" ADC
 SG_ ARC_OD_VabsX_Obj_47_FR : 227|11@0+ (0.125,-128) [-128|127.875] "m/s" ADC
 SG_ ARC_OD_AabsX_Obj_47_FR : 232|9@0+ (0.125,-31.875) [-31.875|32] "m/s^2" ADC
 SG_ ARC_OD_AabsX_Obj_46_FR : 16|9@0+ (0.125,-31.875) [-31.875|32] "m/s^2" ADC
 SG_ ARC_OD_DistY_Obj_47_FR : 255|12@0+ (0.0875,-179.113) [-179.113|179.2] "m" ADC
 SG_ ARC_OD_VabsY_Obj_47_FR : 259|11@0+ (0.125,-128) [-128|127.875] "m/s" ADC
 SG_ ARC_OD_AabsY_Obj_47_FR : 264|9@0+ (0.125,-31.875) [-31.875|32] "m/s^2" ADC
 SG_ ARC_OD_DistXStd_Obj_47_FR : 287|8@0+ (0.05,0) [0|12.75] "m" ADC
 SG_ ARC_OD_DistYStd_Obj_47_FR : 295|8@0+ (0.1,0) [0|25.5] "m" ADC
 SG_ ARC_OD_VabsXStd_Obj_47_FR : 303|7@0+ (0.1,0) [0|12.7] "m/s" ADC
 SG_ ARC_OD_VabsYStd_Obj_47_FR : 296|7@0+ (0.2,0) [0|25.4] "m/s" ADC
 SG_ ARC_OD_AabsXStd_Obj_47_FR : 305|7@0+ (0.25,0) [0|31.75] "m/s^2" ADC
 SG_ ARC_OD_Classification_Obj_47_FR : 314|3@0+ (1,0) [0|7] "" ADC
 SG_ ARC_OD_AabsYStd_Obj_47_FR : 327|8@0+ (0.25,0) [0|63.75] "m/s^2" ADC
 SG_ ARC_OD_ClassConf_Obj_47_FR : 335|7@0+ (1,0) [0|127] "%" ADC
 SG_ ARC_OD_DistY_Obj_46_FR : 39|12@0+ (0.0875,-179.113) [-179.113|179.2] "m" ADC
 SG_ ARC_OD_ProbOfExist_Obj_47_FR : 328|7@0+ (1,0) [0|127] "%" ADC
 SG_ ARC_OD_DynProp_Obj_47_FR : 346|3@0+ (1,0) [0|7] "" ADC
 SG_ ARC_OD_Length_Obj_47_FR : 352|7@0+ (0.2,0) [0|25.4] "m" ADC
 SG_ ARC_OD_MaintenanceState_Obj_0014 : 361|2@0+ (1,0) [0|3] "" ADC
 SG_ ARC_OD_Width_Obj_47_FR : 375|7@0+ (0.2,0) [0|25.4] "m" ADC
 SG_ ARC_OD_RCS_Obj_47_FR : 368|9@0+ (0.2,-51.1) [-51.1|51.1] "dBsm" ADC
 SG_ ARC_OD_Orientation_Obj_47_FR : 391|10@0+ (0.01,-5.11) [-5.11|5.12] "rad" ADC
 SG_ ARC_OD_LifeCycle_Obj_47_FR : 423|16@0+ (1,0) [0|65535] "" ADC
 SG_ ARC_OD_ObstacleProb_Obj_46_FR : 447|7@0+ (1,0) [0|127] "%" ADC
 SG_ ARC_OD_ObstacleProb_Obj_47_FR : 455|7@0+ (1,0) [0|127] "%" ADC
 SG_ ARC_OD_VabsY_Obj_46_FR : 43|11@0+ (0.125,-128) [-128|127.875] "m/s" ADC
 SG_ ARC_OD_ID_46_FR : 463|8@0+ (1,0) [0|255] "" ADC
 SG_ ARC_OD_ID_47_FR : 471|8@0+ (1,0) [0|255] "" ADC
 SG_ ARC_OD_MsgCounter_Obj_46_47_FR : 491|4@0+ (1,0) [0|15] "" ADC
 SG_ ARC_OD_CRC8_Obj_46_47_FR : 511|8@0+ (1,0) [0|256] "" ADC
 SG_ ARC_OD_AabsY_Obj_46_FR : 48|9@0+ (0.125,-31.875) [-31.875|32] "m/s^2" ADC
 SG_ ARC_OD_DistXStd_Obj_46_FR : 71|8@0+ (0.05,0) [0|12.75] "m" ADC
 SG_ ARC_OD_DistYStd_Obj_46_FR : 79|8@0+ (0.1,0) [0|25.5] "m" ADC
 SG_ ARC_OD_VabsXStd_Obj_46_FR : 87|7@0+ (0.1,0) [0|12.7] "m/s" ADC
 SG_ ARC_OD_VabsYStd_Obj_46_FR : 80|7@0+ (0.2,0) [0|25.4] "m/s" ADC
 SG_ ARC_OD_AabsXStd_Obj_46_FR : 89|7@0+ (0.25,0) [0|31.75] "m/s^2" ADC

BO_ 1383 ARC_OD_44_45_FR: 64 ARC
 SG_ DistHeight_Obj_45_FR : 487|8@0+ (0.2,-10) [-10|41] "m" Vector__XXX
 SG_ DistHeight_Obj_44_FR : 479|8@0+ (0.2,-10) [-10|41] "m" Vector__XXX
 SG_ ARC_OD_DistX_Obj_44_FR : 7|12@0+ (0.1,-152) [-152|257.5] "m" ADC
 SG_ ARC_OD_Classification_Obj_44_FR : 98|3@0+ (1,0) [0|7] "" ADC
 SG_ ARC_OD_AabsYStd_Obj_44_FR : 111|8@0+ (0.25,0) [0|63.75] "m/s^2" ADC
 SG_ ARC_OD_ClassConf_Obj_44_FR : 119|7@0+ (1,0) [0|127] "%" ADC
 SG_ ARC_OD_ProbOfExist_Obj_44_FR : 112|7@0+ (1,0) [0|127] "%" ADC
 SG_ ARC_OD_VabsX_Obj_44_FR : 11|11@0+ (0.125,-128) [-128|127.875] "m/s" ADC
 SG_ ARC_OD_DynProp_Obj_44_FR : 130|3@0+ (1,0) [0|7] "" ADC
 SG_ ARC_OD_Length_Obj_44_FR : 136|7@0+ (0.2,0) [0|25.4] "m" ADC
 SG_ ARC_OD_MaintenanceState_Obj_0015 : 145|2@0+ (1,0) [0|3] "" ADC
 SG_ ARC_OD_Width_Obj_44_FR : 159|7@0+ (0.2,0) [0|25.4] "m" ADC
 SG_ ARC_OD_RCS_Obj_44_FR : 152|9@0+ (0.2,-51.1) [-51.1|51.1] "dBsm" ADC
 SG_ ARC_OD_Orientation_Obj_44_FR : 175|10@0+ (0.01,-5.11) [-5.11|5.12] "rad" ADC
 SG_ ARC_OD_LifeCycle_Obj_44_FR : 207|16@0+ (1,0) [0|65535] "" ADC
 SG_ ARC_OD_DistX_Obj_45_FR : 223|12@0+ (0.1,-152) [-152|257.5] "m" ADC
 SG_ ARC_OD_VabsX_Obj_45_FR : 227|11@0+ (0.125,-128) [-128|127.875] "m/s" ADC
 SG_ ARC_OD_AabsX_Obj_45_FR : 232|9@0+ (0.125,-31.875) [-31.875|32] "m/s^2" ADC
 SG_ ARC_OD_AabsX_Obj_44_FR : 16|9@0+ (0.125,-31.875) [-31.875|32] "m/s^2" ADC
 SG_ ARC_OD_DistY_Obj_45_FR : 255|12@0+ (0.0875,-179.113) [-179.113|179.2] "m" ADC
 SG_ ARC_OD_VabsY_Obj_45_FR : 259|11@0+ (0.125,-128) [-128|127.875] "m/s" ADC
 SG_ ARC_OD_AabsY_Obj_45_FR : 264|9@0+ (0.125,-31.875) [-31.875|32] "m/s^2" ADC
 SG_ ARC_OD_DistXStd_Obj_45_FR : 287|8@0+ (0.05,0) [0|12.75] "m" ADC
 SG_ ARC_OD_DistYStd_Obj_45_FR : 295|8@0+ (0.1,0) [0|25.5] "m" ADC
 SG_ ARC_OD_VabsXStd_Obj_45_FR : 303|7@0+ (0.1,0) [0|12.7] "m/s" ADC
 SG_ ARC_OD_VabsYStd_Obj_45_FR : 296|7@0+ (0.2,0) [0|25.4] "m/s" ADC
 SG_ ARC_OD_AabsXStd_Obj_45_FR : 305|7@0+ (0.25,0) [0|31.75] "m/s^2" ADC
 SG_ ARC_OD_Classification_Obj_45_FR : 314|3@0+ (1,0) [0|7] "" ADC
 SG_ ARC_OD_AabsYStd_Obj_45_FR : 327|8@0+ (0.25,0) [0|63.75] "m/s^2" ADC
 SG_ ARC_OD_ClassConf_Obj_45_FR : 335|7@0+ (1,0) [0|127] "%" ADC
 SG_ ARC_OD_DistY_Obj_44_FR : 39|12@0+ (0.0875,-179.113) [-179.113|179.2] "m" ADC
 SG_ ARC_OD_ProbOfExist_Obj_45_FR : 328|7@0+ (1,0) [0|127] "%" ADC
 SG_ ARC_OD_DynProp_Obj_45_FR : 346|3@0+ (1,0) [0|7] "" ADC
 SG_ ARC_OD_Length_Obj_45_FR : 352|7@0+ (0.2,0) [0|25.4] "m" ADC
 SG_ ARC_OD_MaintenanceState_Obj_0016 : 361|2@0+ (1,0) [0|3] "" ADC
 SG_ ARC_OD_Width_Obj_45_FR : 375|7@0+ (0.2,0) [0|25.4] "m" ADC
 SG_ ARC_OD_RCS_Obj_45_FR : 368|9@0+ (0.2,-51.1) [-51.1|51.1] "dBsm" ADC
 SG_ ARC_OD_Orientation_Obj_45_FR : 391|10@0+ (0.01,-5.11) [-5.11|5.12] "rad" ADC
 SG_ ARC_OD_LifeCycle_Obj_45_FR : 423|16@0+ (1,0) [0|65535] "" ADC
 SG_ ARC_OD_ObstacleProb_Obj_44_FR : 447|7@0+ (1,0) [0|127] "%" ADC
 SG_ ARC_OD_ObstacleProb_Obj_45_FR : 455|7@0+ (1,0) [0|127] "%" ADC
 SG_ ARC_OD_VabsY_Obj_44_FR : 43|11@0+ (0.125,-128) [-128|127.875] "m/s" ADC
 SG_ ARC_OD_ID_44_FR : 463|8@0+ (1,0) [0|255] "" ADC
 SG_ ARC_OD_ID_45_FR : 471|8@0+ (1,0) [0|255] "" ADC
 SG_ ARC_OD_MsgCounter_Obj_44_45_FR : 491|4@0+ (1,0) [0|15] "" ADC
 SG_ ARC_OD_CRC8_Obj_44_45_FR : 511|8@0+ (1,0) [0|256] "" ADC
 SG_ ARC_OD_AabsY_Obj_44_FR : 48|9@0+ (0.125,-31.875) [-31.875|32] "m/s^2" ADC
 SG_ ARC_OD_DistXStd_Obj_44_FR : 71|8@0+ (0.05,0) [0|12.75] "m" ADC
 SG_ ARC_OD_DistYStd_Obj_44_FR : 79|8@0+ (0.1,0) [0|25.5] "m" ADC
 SG_ ARC_OD_VabsXStd_Obj_44_FR : 87|7@0+ (0.1,0) [0|12.7] "m/s" ADC
 SG_ ARC_OD_VabsYStd_Obj_44_FR : 80|7@0+ (0.2,0) [0|25.4] "m/s" ADC
 SG_ ARC_OD_AabsXStd_Obj_44_FR : 89|7@0+ (0.25,0) [0|31.75] "m/s^2" ADC

BO_ 1382 ARC_OD_42_43_FR: 64 ARC
 SG_ DistHeight_Obj_43_FR : 487|8@0+ (0.2,-10) [-10|41] "m" Vector__XXX
 SG_ DistHeight_Obj_42_FR : 479|8@0+ (0.2,-10) [-10|41] "m" Vector__XXX
 SG_ ARC_OD_DistX_Obj_42_FR : 7|12@0+ (0.1,-152) [-152|257.5] "m" ADC
 SG_ ARC_OD_Classification_Obj_42_FR : 98|3@0+ (1,0) [0|7] "" ADC
 SG_ ARC_OD_AabsYStd_Obj_42_FR : 111|8@0+ (0.25,0) [0|63.75] "m/s^2" ADC
 SG_ ARC_OD_ClassConf_Obj_42_FR : 119|7@0+ (1,0) [0|127] "%" ADC
 SG_ ARC_OD_ProbOfExist_Obj_42_FR : 112|7@0+ (1,0) [0|127] "%" ADC
 SG_ ARC_OD_VabsX_Obj_42_FR : 11|11@0+ (0.125,-128) [-128|127.875] "m/s" ADC
 SG_ ARC_OD_DynProp_Obj_42_FR : 130|3@0+ (1,0) [0|7] "" ADC
 SG_ ARC_OD_Length_Obj_42_FR : 136|7@0+ (0.2,0) [0|25.4] "m" ADC
 SG_ ARC_OD_MaintenanceState_Obj_0017 : 145|2@0+ (1,0) [0|3] "" ADC
 SG_ ARC_OD_Width_Obj_42_FR : 159|7@0+ (0.2,0) [0|25.4] "m" ADC
 SG_ ARC_OD_RCS_Obj_42_FR : 152|9@0+ (0.2,-51.1) [-51.1|51.1] "dBsm" ADC
 SG_ ARC_OD_Orientation_Obj_42_FR : 175|10@0+ (0.01,-5.11) [-5.11|5.12] "rad" ADC
 SG_ ARC_OD_LifeCycle_Obj_42_FR : 207|16@0+ (1,0) [0|65535] "" ADC
 SG_ ARC_OD_DistX_Obj_43_FR : 223|12@0+ (0.1,-152) [-152|257.5] "m" ADC
 SG_ ARC_OD_VabsX_Obj_43_FR : 227|11@0+ (0.125,-128) [-128|127.875] "m/s" ADC
 SG_ ARC_OD_AabsX_Obj_43_FR : 232|9@0+ (0.125,-31.875) [-31.875|32] "m/s^2" ADC
 SG_ ARC_OD_AabsX_Obj_42_FR : 16|9@0+ (0.125,-31.875) [-31.875|32] "m/s^2" ADC
 SG_ ARC_OD_DistY_Obj_43_FR : 255|12@0+ (0.0875,-179.113) [-179.113|179.2] "m" ADC
 SG_ ARC_OD_VabsY_Obj_43_FR : 259|11@0+ (0.125,-128) [-128|127.875] "m/s" ADC
 SG_ ARC_OD_AabsY_Obj_43_FR : 264|9@0+ (0.125,-31.875) [-31.875|32] "m/s^2" ADC
 SG_ ARC_OD_DistXStd_Obj_43_FR : 287|8@0+ (0.05,0) [0|12.75] "m" ADC
 SG_ ARC_OD_DistYStd_Obj_43_FR : 295|8@0+ (0.1,0) [0|25.5] "m" ADC
 SG_ ARC_OD_VabsXStd_Obj_43_FR : 303|7@0+ (0.1,0) [0|12.7] "m/s" ADC
 SG_ ARC_OD_VabsYStd_Obj_43_FR : 296|7@0+ (0.2,0) [0|25.4] "m/s" ADC
 SG_ ARC_OD_AabsXStd_Obj_43_FR : 305|7@0+ (0.25,0) [0|31.75] "m/s^2" ADC
 SG_ ARC_OD_Classification_Obj_43_FR : 314|3@0+ (1,0) [0|7] "" ADC
 SG_ ARC_OD_AabsYStd_Obj_43_FR : 327|8@0+ (0.25,0) [0|63.75] "m/s^2" ADC
 SG_ ARC_OD_ClassConf_Obj_43_FR : 335|7@0+ (1,0) [0|127] "%" ADC
 SG_ ARC_OD_DistY_Obj_42_FR : 39|12@0+ (0.0875,-179.113) [-179.113|179.2] "m" ADC
 SG_ ARC_OD_ProbOfExist_Obj_43_FR : 328|7@0+ (1,0) [0|127] "%" ADC
 SG_ ARC_OD_DynProp_Obj_43_FR : 346|3@0+ (1,0) [0|7] "" ADC
 SG_ ARC_OD_Length_Obj_43_FR : 352|7@0+ (0.2,0) [0|25.4] "m" ADC
 SG_ ARC_OD_MaintenanceState_Obj_0018 : 361|2@0+ (1,0) [0|3] "" ADC
 SG_ ARC_OD_Width_Obj_43_FR : 375|7@0+ (0.2,0) [0|25.4] "m" ADC
 SG_ ARC_OD_RCS_Obj_43_FR : 368|9@0+ (0.2,-51.1) [-51.1|51.1] "dBsm" ADC
 SG_ ARC_OD_Orientation_Obj_43_FR : 391|10@0+ (0.01,-5.11) [-5.11|5.12] "rad" ADC
 SG_ ARC_OD_LifeCycle_Obj_43_FR : 423|16@0+ (1,0) [0|65535] "" ADC
 SG_ ARC_OD_ObstacleProb_Obj_42_FR : 447|7@0+ (1,0) [0|127] "%" ADC
 SG_ ARC_OD_ObstacleProb_Obj_43_FR : 455|7@0+ (1,0) [0|127] "%" ADC
 SG_ ARC_OD_VabsY_Obj_42_FR : 43|11@0+ (0.125,-128) [-128|127.875] "m/s" ADC
 SG_ ARC_OD_ID_42_FR : 463|8@0+ (1,0) [0|255] "" ADC
 SG_ ARC_OD_ID_43_FR : 471|8@0+ (1,0) [0|255] "" ADC
 SG_ ARC_OD_MsgCounter_Obj_42_43_FR : 491|4@0+ (1,0) [0|15] "" ADC
 SG_ ARC_OD_CRC8_Obj_42_43_FR : 511|8@0+ (1,0) [0|256] "" ADC
 SG_ ARC_OD_AabsY_Obj_42_FR : 48|9@0+ (0.125,-31.875) [-31.875|32] "m/s^2" ADC
 SG_ ARC_OD_DistXStd_Obj_42_FR : 71|8@0+ (0.05,0) [0|12.75] "m" ADC
 SG_ ARC_OD_DistYStd_Obj_42_FR : 79|8@0+ (0.1,0) [0|25.5] "m" ADC
 SG_ ARC_OD_VabsXStd_Obj_42_FR : 87|7@0+ (0.1,0) [0|12.7] "m/s" ADC
 SG_ ARC_OD_VabsYStd_Obj_42_FR : 80|7@0+ (0.2,0) [0|25.4] "m/s" ADC
 SG_ ARC_OD_AabsXStd_Obj_42_FR : 89|7@0+ (0.25,0) [0|31.75] "m/s^2" ADC

BO_ 1381 ARC_OD_40_41_FR: 64 ARC
 SG_ DistHeight_Obj_41_FR : 487|8@0+ (0.2,-10) [-10|41] "m" ADC
 SG_ DistHeight_Obj_40_FR : 479|8@0+ (0.2,-10) [-10|41] "m" ADC
 SG_ ARC_OD_DistX_Obj_40_FR : 7|12@0+ (0.1,-152) [-152|257.5] "m" ADC
 SG_ ARC_OD_Classification_Obj_40_FR : 98|3@0+ (1,0) [0|7] "" ADC
 SG_ ARC_OD_AabsYStd_Obj_40_FR : 111|8@0+ (0.25,0) [0|63.75] "m/s^2" ADC
 SG_ ARC_OD_ClassConf_Obj_40_FR : 119|7@0+ (1,0) [0|127] "%" ADC
 SG_ ARC_OD_ProbOfExist_Obj_40_FR : 112|7@0+ (1,0) [0|127] "%" ADC
 SG_ ARC_OD_VabsX_Obj_40_FR : 11|11@0+ (0.125,-128) [-128|127.875] "m/s" ADC
 SG_ ARC_OD_DynProp_Obj_40_FR : 130|3@0+ (1,0) [0|7] "" ADC
 SG_ ARC_OD_Length_Obj_40_FR : 136|7@0+ (0.2,0) [0|25.4] "m" ADC
 SG_ ARC_OD_MaintenanceState_Obj_0019 : 145|2@0+ (1,0) [0|3] "" ADC
 SG_ ARC_OD_Width_Obj_40_FR : 159|7@0+ (0.2,0) [0|25.4] "m" ADC
 SG_ ARC_OD_RCS_Obj_40_FR : 152|9@0+ (0.2,-51.1) [-51.1|51.1] "dBsm" ADC
 SG_ ARC_OD_Orientation_Obj_40_FR : 175|10@0+ (0.01,-5.11) [-5.11|5.12] "rad" ADC
 SG_ ARC_OD_LifeCycle_Obj_40_FR : 207|16@0+ (1,0) [0|65535] "" ADC
 SG_ ARC_OD_DistX_Obj_41_FR : 223|12@0+ (0.1,-152) [-152|257.5] "m" ADC
 SG_ ARC_OD_VabsX_Obj_41_FR : 227|11@0+ (0.125,-128) [-128|127.875] "m/s" ADC
 SG_ ARC_OD_AabsX_Obj_41_FR : 232|9@0+ (0.125,-31.875) [-31.875|32] "m/s^2" ADC
 SG_ ARC_OD_AabsX_Obj_40_FR : 16|9@0+ (0.125,-31.875) [-31.875|32] "m/s^2" ADC
 SG_ ARC_OD_DistY_Obj_41_FR : 255|12@0+ (0.0875,-179.113) [-179.113|179.2] "m" ADC
 SG_ ARC_OD_VabsY_Obj_41_FR : 259|11@0+ (0.125,-128) [-128|127.875] "m/s" ADC
 SG_ ARC_OD_AabsY_Obj_41_FR : 264|9@0+ (0.125,-31.875) [-31.875|32] "m/s^2" ADC
 SG_ ARC_OD_DistXStd_Obj_41_FR : 287|8@0+ (0.05,0) [0|12.75] "m" ADC
 SG_ ARC_OD_DistYStd_Obj_41_FR : 295|8@0+ (0.1,0) [0|25.5] "m" ADC
 SG_ ARC_OD_VabsXStd_Obj_41_FR : 303|7@0+ (0.1,0) [0|12.7] "m/s" ADC
 SG_ ARC_OD_VabsYStd_Obj_41_FR : 296|7@0+ (0.2,0) [0|25.4] "m/s" ADC
 SG_ ARC_OD_AabsXStd_Obj_41_FR : 305|7@0+ (0.25,0) [0|31.75] "m/s^2" ADC
 SG_ ARC_OD_Classification_Obj_41_FR : 314|3@0+ (1,0) [0|7] "" ADC
 SG_ ARC_OD_AabsYStd_Obj_41_FR : 327|8@0+ (0.25,0) [0|63.75] "m/s^2" ADC
 SG_ ARC_OD_ClassConf_Obj_41_FR : 335|7@0+ (1,0) [0|127] "%" ADC
 SG_ ARC_OD_DistY_Obj_40_FR : 39|12@0+ (0.0875,-179.113) [-179.113|179.2] "m" ADC
 SG_ ARC_OD_ProbOfExist_Obj_41_FR : 328|7@0+ (1,0) [0|127] "%" ADC
 SG_ ARC_OD_DynProp_Obj_41_FR : 346|3@0+ (1,0) [0|7] "" ADC
 SG_ ARC_OD_Length_Obj_41_FR : 352|7@0+ (0.2,0) [0|25.4] "m" ADC
 SG_ ARC_OD_MaintenanceState_Obj_0020 : 361|2@0+ (1,0) [0|3] "" ADC
 SG_ ARC_OD_Width_Obj_41_FR : 375|7@0+ (0.2,0) [0|25.4] "m" ADC
 SG_ ARC_OD_RCS_Obj_41_FR : 368|9@0+ (0.2,-51.1) [-51.1|51.1] "dBsm" ADC
 SG_ ARC_OD_Orientation_Obj_41_FR : 391|10@0+ (0.01,-5.11) [-5.11|5.12] "rad" ADC
 SG_ ARC_OD_LifeCycle_Obj_41_FR : 423|16@0+ (1,0) [0|65535] "" ADC
 SG_ ARC_OD_ObstacleProb_Obj_40_FR : 447|7@0+ (1,0) [0|127] "%" ADC
 SG_ ARC_OD_ObstacleProb_Obj_41_FR : 455|7@0+ (1,0) [0|127] "%" ADC
 SG_ ARC_OD_VabsY_Obj_40_FR : 43|11@0+ (0.125,-128) [-128|127.875] "m/s" ADC
 SG_ ARC_OD_ID_40_FR : 463|8@0+ (1,0) [0|255] "" ADC
 SG_ ARC_OD_ID_41_FR : 471|8@0+ (1,0) [0|255] "" ADC
 SG_ ARC_OD_MsgCounter_Obj_40_41_FR : 491|4@0+ (1,0) [0|15] "" ADC
 SG_ ARC_OD_CRC8_Obj_40_41_FR : 511|8@0+ (1,0) [0|256] "" ADC
 SG_ ARC_OD_AabsY_Obj_40_FR : 48|9@0+ (0.125,-31.875) [-31.875|32] "m/s^2" ADC
 SG_ ARC_OD_DistXStd_Obj_40_FR : 71|8@0+ (0.05,0) [0|12.75] "m" ADC
 SG_ ARC_OD_DistYStd_Obj_40_FR : 79|8@0+ (0.1,0) [0|25.5] "m" ADC
 SG_ ARC_OD_VabsXStd_Obj_40_FR : 87|7@0+ (0.1,0) [0|12.7] "m/s" ADC
 SG_ ARC_OD_VabsYStd_Obj_40_FR : 80|7@0+ (0.2,0) [0|25.4] "m/s" ADC
 SG_ ARC_OD_AabsXStd_Obj_40_FR : 89|7@0+ (0.25,0) [0|31.75] "m/s^2" ADC

BO_ 1380 ARC_OD_38_39_FR: 64 ARC
 SG_ DistHeight_Obj_39_FR : 487|8@0+ (0.2,-10) [-10|41] "m" ADC
 SG_ DistHeight_Obj_38_FR : 479|8@0+ (0.2,-10) [-10|41] "m" ADC
 SG_ ARC_OD_DistX_Obj_38_FR : 7|12@0+ (0.1,-152) [-152|257.5] "m" ADC
 SG_ ARC_OD_Classification_Obj_38_FR : 98|3@0+ (1,0) [0|7] "" ADC
 SG_ ARC_OD_AabsYStd_Obj_38_FR : 111|8@0+ (0.25,0) [0|63.75] "m/s^2" ADC
 SG_ ARC_OD_ClassConf_Obj_38_FR : 119|7@0+ (1,0) [0|127] "%" ADC
 SG_ ARC_OD_ProbOfExist_Obj_38_FR : 112|7@0+ (1,0) [0|127] "%" ADC
 SG_ ARC_OD_VabsX_Obj_38_FR : 11|11@0+ (0.125,-128) [-128|127.875] "m/s" ADC
 SG_ ARC_OD_DynProp_Obj_38_FR : 130|3@0+ (1,0) [0|7] "" ADC
 SG_ ARC_OD_Length_Obj_38_FR : 136|7@0+ (0.2,0) [0|25.4] "m" ADC
 SG_ ARC_OD_MaintenanceState_Obj_0021 : 145|2@0+ (1,0) [0|3] "" ADC
 SG_ ARC_OD_Width_Obj_38_FR : 159|7@0+ (0.2,0) [0|25.4] "m" ADC
 SG_ ARC_OD_RCS_Obj_38_FR : 152|9@0+ (0.2,-51.1) [-51.1|51.1] "dBsm" ADC
 SG_ ARC_OD_Orientation_Obj_38_FR : 175|10@0+ (0.01,-5.11) [-5.11|5.12] "rad" ADC
 SG_ ARC_OD_LifeCycle_Obj_38_FR : 207|16@0+ (1,0) [0|65535] "" ADC
 SG_ ARC_OD_DistX_Obj_39_FR : 223|12@0+ (0.1,-152) [-152|257.5] "m" ADC
 SG_ ARC_OD_VabsX_Obj_39_FR : 227|11@0+ (0.125,-128) [-128|127.875] "m/s" ADC
 SG_ ARC_OD_AabsX_Obj_39_FR : 232|9@0+ (0.125,-31.875) [-31.875|32] "m/s^2" ADC
 SG_ ARC_OD_AabsX_Obj_38_FR : 16|9@0+ (0.125,-31.875) [-31.875|32] "m/s^2" ADC
 SG_ ARC_OD_DistY_Obj_39_FR : 255|12@0+ (0.0875,-179.113) [-179.113|179.2] "m" ADC
 SG_ ARC_OD_VabsY_Obj_39_FR : 259|11@0+ (0.125,-128) [-128|127.875] "m/s" ADC
 SG_ ARC_OD_AabsY_Obj_39_FR : 264|9@0+ (0.125,-31.875) [-31.875|32] "m/s^2" ADC
 SG_ ARC_OD_DistXStd_Obj_39_FR : 287|8@0+ (0.05,0) [0|12.75] "m" ADC
 SG_ ARC_OD_DistYStd_Obj_39_FR : 295|8@0+ (0.1,0) [0|25.5] "m" ADC
 SG_ ARC_OD_VabsXStd_Obj_39_FR : 303|7@0+ (0.1,0) [0|12.7] "m/s" ADC
 SG_ ARC_OD_VabsYStd_Obj_39_FR : 296|7@0+ (0.2,0) [0|25.4] "m/s" ADC
 SG_ ARC_OD_AabsXStd_Obj_39_FR : 305|7@0+ (0.25,0) [0|31.75] "m/s^2" ADC
 SG_ ARC_OD_Classification_Obj_39_FR : 314|3@0+ (1,0) [0|7] "" ADC
 SG_ ARC_OD_AabsYStd_Obj_39_FR : 327|8@0+ (0.25,0) [0|63.75] "m/s^2" ADC
 SG_ ARC_OD_ClassConf_Obj_39_FR : 335|7@0+ (1,0) [0|127] "%" ADC
 SG_ ARC_OD_DistY_Obj_38_FR : 39|12@0+ (0.0875,-179.113) [-179.113|179.2] "m" ADC
 SG_ ARC_OD_ProbOfExist_Obj_39_FR : 328|7@0+ (1,0) [0|127] "%" ADC
 SG_ ARC_OD_DynProp_Obj_39_FR : 346|3@0+ (1,0) [0|7] "" ADC
 SG_ ARC_OD_Length_Obj_39_FR : 352|7@0+ (0.2,0) [0|25.4] "m" ADC
 SG_ ARC_OD_MaintenanceState_Obj_0022 : 361|2@0+ (1,0) [0|3] "" ADC
 SG_ ARC_OD_Width_Obj_39_FR : 375|7@0+ (0.2,0) [0|25.4] "m" ADC
 SG_ ARC_OD_RCS_Obj_39_FR : 368|9@0+ (0.2,-51.1) [-51.1|51.1] "dBsm" ADC
 SG_ ARC_OD_Orientation_Obj_39_FR : 391|10@0+ (0.01,-5.11) [-5.11|5.12] "rad" ADC
 SG_ ARC_OD_LifeCycle_Obj_39_FR : 423|16@0+ (1,0) [0|65535] "" ADC
 SG_ ARC_OD_ObstacleProb_Obj_38_FR : 447|7@0+ (1,0) [0|127] "%" ADC
 SG_ ARC_OD_ObstacleProb_Obj_39_FR : 455|7@0+ (1,0) [0|127] "%" ADC
 SG_ ARC_OD_VabsY_Obj_38_FR : 43|11@0+ (0.125,-128) [-128|127.875] "m/s" ADC
 SG_ ARC_OD_ID_38_FR : 463|8@0+ (1,0) [0|255] "" ADC
 SG_ ARC_OD_ID_39_FR : 471|8@0+ (1,0) [0|255] "" ADC
 SG_ ARC_OD_MsgCounter_Obj_38_39_FR : 491|4@0+ (1,0) [0|15] "" ADC
 SG_ ARC_OD_CRC8_Obj_38_39_FR : 511|8@0+ (1,0) [0|256] "" ADC
 SG_ ARC_OD_AabsY_Obj_38_FR : 48|9@0+ (0.125,-31.875) [-31.875|32] "m/s^2" ADC
 SG_ ARC_OD_DistXStd_Obj_38_FR : 71|8@0+ (0.05,0) [0|12.75] "m" ADC
 SG_ ARC_OD_DistYStd_Obj_38_FR : 79|8@0+ (0.1,0) [0|25.5] "m" ADC
 SG_ ARC_OD_VabsXStd_Obj_38_FR : 87|7@0+ (0.1,0) [0|12.7] "m/s" ADC
 SG_ ARC_OD_VabsYStd_Obj_38_FR : 80|7@0+ (0.2,0) [0|25.4] "m/s" ADC
 SG_ ARC_OD_AabsXStd_Obj_38_FR : 89|7@0+ (0.25,0) [0|31.75] "m/s^2" ADC

BO_ 1379 ARC_OD_36_37_FR: 64 ARC
 SG_ DistHeight_Obj_37_FR : 487|8@0+ (0.2,-10) [-10|41] "m" ADC
 SG_ DistHeight_Obj_36_FR : 479|8@0+ (0.2,-10) [-10|41] "m" ADC
 SG_ ARC_OD_DistX_Obj_36_FR : 7|12@0+ (0.1,-152) [-152|257.5] "m" ADC
 SG_ ARC_OD_Classification_Obj_36_FR : 98|3@0+ (1,0) [0|7] "" ADC
 SG_ ARC_OD_AabsYStd_Obj_36_FR : 111|8@0+ (0.25,0) [0|63.75] "m/s^2" ADC
 SG_ ARC_OD_ClassConf_Obj_36_FR : 119|7@0+ (1,0) [0|127] "%" ADC
 SG_ ARC_OD_ProbOfExist_Obj_36_FR : 112|7@0+ (1,0) [0|127] "%" ADC
 SG_ ARC_OD_VabsX_Obj_36_FR : 11|11@0+ (0.125,-128) [-128|127.875] "m/s" ADC
 SG_ ARC_OD_DynProp_Obj_36_FR : 130|3@0+ (1,0) [0|7] "" ADC
 SG_ ARC_OD_Length_Obj_36_FR : 136|7@0+ (0.2,0) [0|25.4] "m" ADC
 SG_ ARC_OD_MaintenanceState_Obj_0023 : 145|2@0+ (1,0) [0|3] "" ADC
 SG_ ARC_OD_Width_Obj_36_FR : 159|7@0+ (0.2,0) [0|25.4] "m" ADC
 SG_ ARC_OD_RCS_Obj_36_FR : 152|9@0+ (0.2,-51.1) [-51.1|51.1] "dBsm" ADC
 SG_ ARC_OD_Orientation_Obj_36_FR : 175|10@0+ (0.01,-5.11) [-5.11|5.12] "rad" ADC
 SG_ ARC_OD_LifeCycle_Obj_36_FR : 207|16@0+ (1,0) [0|65535] "" ADC
 SG_ ARC_OD_DistX_Obj_37_FR : 223|12@0+ (0.1,-152) [-152|257.5] "m" ADC
 SG_ ARC_OD_VabsX_Obj_37_FR : 227|11@0+ (0.125,-128) [-128|127.875] "m/s" ADC
 SG_ ARC_OD_AabsX_Obj_37_FR : 232|9@0+ (0.125,-31.875) [-31.875|32] "m/s^2" ADC
 SG_ ARC_OD_AabsX_Obj_36_FR : 16|9@0+ (0.125,-31.875) [-31.875|32] "m/s^2" ADC
 SG_ ARC_OD_DistY_Obj_37_FR : 255|12@0+ (0.0875,-179.113) [-179.113|179.2] "m" ADC
 SG_ ARC_OD_VabsY_Obj_37_FR : 259|11@0+ (0.125,-128) [-128|127.875] "m/s" ADC
 SG_ ARC_OD_AabsY_Obj_37_FR : 264|9@0+ (0.125,-31.875) [-31.875|32] "m/s^2" ADC
 SG_ ARC_OD_DistXStd_Obj_37_FR : 287|8@0+ (0.05,0) [0|12.75] "m" ADC
 SG_ ARC_OD_DistYStd_Obj_37_FR : 295|8@0+ (0.1,0) [0|25.5] "m" ADC
 SG_ ARC_OD_VabsXStd_Obj_37_FR : 303|7@0+ (0.1,0) [0|12.7] "m/s" ADC
 SG_ ARC_OD_VabsYStd_Obj_37_FR : 296|7@0+ (0.2,0) [0|25.4] "m/s" ADC
 SG_ ARC_OD_AabsXStd_Obj_37_FR : 305|7@0+ (0.25,0) [0|31.75] "m/s^2" ADC
 SG_ ARC_OD_Classification_Obj_37_FR : 314|3@0+ (1,0) [0|7] "" ADC
 SG_ ARC_OD_AabsYStd_Obj_37_FR : 327|8@0+ (0.25,0) [0|63.75] "m/s^2" ADC
 SG_ ARC_OD_ClassConf_Obj_37_FR : 335|7@0+ (1,0) [0|127] "%" ADC
 SG_ ARC_OD_DistY_Obj_36_FR : 39|12@0+ (0.0875,-179.113) [-179.113|179.2] "m" ADC
 SG_ ARC_OD_ProbOfExist_Obj_37_FR : 328|7@0+ (1,0) [0|127] "%" ADC
 SG_ ARC_OD_DynProp_Obj_37_FR : 346|3@0+ (1,0) [0|7] "" ADC
 SG_ ARC_OD_Length_Obj_37_FR : 352|7@0+ (0.2,0) [0|25.4] "m" ADC
 SG_ ARC_OD_MaintenanceState_Obj_0024 : 361|2@0+ (1,0) [0|3] "" ADC
 SG_ ARC_OD_Width_Obj_37_FR : 375|7@0+ (0.2,0) [0|25.4] "m" ADC
 SG_ ARC_OD_RCS_Obj_37_FR : 368|9@0+ (0.2,-51.1) [-51.1|51.1] "dBsm" ADC
 SG_ ARC_OD_Orientation_Obj_37_FR : 391|10@0+ (0.01,-5.11) [-5.11|5.12] "rad" ADC
 SG_ ARC_OD_LifeCycle_Obj_37_FR : 423|16@0+ (1,0) [0|65535] "" ADC
 SG_ ARC_OD_ObstacleProb_Obj_36_FR : 447|7@0+ (1,0) [0|127] "%" ADC
 SG_ ARC_OD_ObstacleProb_Obj_37_FR : 455|7@0+ (1,0) [0|127] "%" ADC
 SG_ ARC_OD_VabsY_Obj_36_FR : 43|11@0+ (0.125,-128) [-128|127.875] "m/s" ADC
 SG_ ARC_OD_ID_36_FR : 463|8@0+ (1,0) [0|255] "" ADC
 SG_ ARC_OD_ID_37_FR : 471|8@0+ (1,0) [0|255] "" ADC
 SG_ ARC_OD_MsgCounter_Obj_36_37_FR : 491|4@0+ (1,0) [0|15] "" ADC
 SG_ ARC_OD_CRC8_Obj_36_37_FR : 511|8@0+ (1,0) [0|256] "" ADC
 SG_ ARC_OD_AabsY_Obj_36_FR : 48|9@0+ (0.125,-31.875) [-31.875|32] "m/s^2" ADC
 SG_ ARC_OD_DistXStd_Obj_36_FR : 71|8@0+ (0.05,0) [0|12.75] "m" ADC
 SG_ ARC_OD_DistYStd_Obj_36_FR : 79|8@0+ (0.1,0) [0|25.5] "m" ADC
 SG_ ARC_OD_VabsXStd_Obj_36_FR : 87|7@0+ (0.1,0) [0|12.7] "m/s" ADC
 SG_ ARC_OD_VabsYStd_Obj_36_FR : 80|7@0+ (0.2,0) [0|25.4] "m/s" ADC
 SG_ ARC_OD_AabsXStd_Obj_36_FR : 89|7@0+ (0.25,0) [0|31.75] "m/s^2" ADC

BO_ 1378 ARC_OD_34_35_FR: 64 ARC
 SG_ DistHeight_Obj_35_FR : 487|8@0+ (0.2,-10) [-10|41] "m" ADC
 SG_ DistHeight_Obj_34_FR : 479|8@0+ (0.2,-10) [-10|41] "m" ADC
 SG_ ARC_OD_DistX_Obj_34_FR : 7|12@0+ (0.1,-152) [-152|257.5] "m" ADC
 SG_ ARC_OD_Classification_Obj_34_FR : 98|3@0+ (1,0) [0|7] "" ADC
 SG_ ARC_OD_AabsYStd_Obj_34_FR : 111|8@0+ (0.25,0) [0|63.75] "m/s^2" ADC
 SG_ ARC_OD_ClassConf_Obj_34_FR : 119|7@0+ (1,0) [0|127] "%" ADC
 SG_ ARC_OD_ProbOfExist_Obj_34_FR : 112|7@0+ (1,0) [0|127] "%" ADC
 SG_ ARC_OD_VabsX_Obj_34_FR : 11|11@0+ (0.125,-128) [-128|127.875] "m/s" ADC
 SG_ ARC_OD_DynProp_Obj_34_FR : 130|3@0+ (1,0) [0|7] "" ADC
 SG_ ARC_OD_Length_Obj_34_FR : 136|7@0+ (0.2,0) [0|25.4] "m" ADC
 SG_ ARC_OD_MaintenanceState_Obj_0025 : 145|2@0+ (1,0) [0|3] "" ADC
 SG_ ARC_OD_Width_Obj_34_FR : 159|7@0+ (0.2,0) [0|25.4] "m" ADC
 SG_ ARC_OD_RCS_Obj_34_FR : 152|9@0+ (0.2,-51.1) [-51.1|51.1] "dBsm" ADC
 SG_ ARC_OD_Orientation_Obj_34_FR : 175|10@0+ (0.01,-5.11) [-5.11|5.12] "rad" ADC
 SG_ ARC_OD_LifeCycle_Obj_34_FR : 207|16@0+ (1,0) [0|65535] "" ADC
 SG_ ARC_OD_DistX_Obj_35_FR : 223|12@0+ (0.1,-152) [-152|257.5] "m" ADC
 SG_ ARC_OD_VabsX_Obj_35_FR : 227|11@0+ (0.125,-128) [-128|127.875] "m/s" ADC
 SG_ ARC_OD_AabsX_Obj_35_FR : 232|9@0+ (0.125,-31.875) [-31.875|32] "m/s^2" ADC
 SG_ ARC_OD_AabsX_Obj_34_FR : 16|9@0+ (0.125,-31.875) [-31.875|32] "m/s^2" ADC
 SG_ ARC_OD_DistY_Obj_35_FR : 255|12@0+ (0.0875,-179.113) [-179.113|179.2] "m" ADC
 SG_ ARC_OD_VabsY_Obj_35_FR : 259|11@0+ (0.125,-128) [-128|127.875] "m/s" ADC
 SG_ ARC_OD_AabsY_Obj_35_FR : 264|9@0+ (0.125,-31.875) [-31.875|32] "m/s^2" ADC
 SG_ ARC_OD_DistXStd_Obj_35_FR : 287|8@0+ (0.05,0) [0|12.75] "m" ADC
 SG_ ARC_OD_DistYStd_Obj_35_FR : 295|8@0+ (0.1,0) [0|25.5] "m" ADC
 SG_ ARC_OD_VabsXStd_Obj_35_FR : 303|7@0+ (0.1,0) [0|12.7] "m/s" ADC
 SG_ ARC_OD_VabsYStd_Obj_35_FR : 296|7@0+ (0.2,0) [0|25.4] "m/s" ADC
 SG_ ARC_OD_AabsXStd_Obj_35_FR : 305|7@0+ (0.25,0) [0|31.75] "m/s^2" ADC
 SG_ ARC_OD_Classification_Obj_35_FR : 314|3@0+ (1,0) [0|7] "" ADC
 SG_ ARC_OD_AabsYStd_Obj_35_FR : 327|8@0+ (0.25,0) [0|63.75] "m/s^2" ADC
 SG_ ARC_OD_ClassConf_Obj_35_FR : 335|7@0+ (1,0) [0|127] "%" ADC
 SG_ ARC_OD_DistY_Obj_34_FR : 39|12@0+ (0.0875,-179.113) [-179.113|179.2] "m" ADC
 SG_ ARC_OD_ProbOfExist_Obj_35_FR : 328|7@0+ (1,0) [0|127] "%" ADC
 SG_ ARC_OD_DynProp_Obj_35_FR : 346|3@0+ (1,0) [0|7] "" ADC
 SG_ ARC_OD_Length_Obj_35_FR : 352|7@0+ (0.2,0) [0|25.4] "m" ADC
 SG_ ARC_OD_MaintenanceState_Obj_0026 : 361|2@0+ (1,0) [0|3] "" ADC
 SG_ ARC_OD_Width_Obj_35_FR : 375|7@0+ (0.2,0) [0|25.4] "m" ADC
 SG_ ARC_OD_RCS_Obj_35_FR : 368|9@0+ (0.2,-51.1) [-51.1|51.1] "dBsm" ADC
 SG_ ARC_OD_Orientation_Obj_35_FR : 391|10@0+ (0.01,-5.11) [-5.11|5.12] "rad" ADC
 SG_ ARC_OD_LifeCycle_Obj_35_FR : 423|16@0+ (1,0) [0|65535] "" ADC
 SG_ ARC_OD_ObstacleProb_Obj_34_FR : 447|7@0+ (1,0) [0|127] "%" ADC
 SG_ ARC_OD_ObstacleProb_Obj_35_FR : 455|7@0+ (1,0) [0|127] "%" ADC
 SG_ ARC_OD_VabsY_Obj_34_FR : 43|11@0+ (0.125,-128) [-128|127.875] "m/s" ADC
 SG_ ARC_OD_ID_34_FR : 463|8@0+ (1,0) [0|255] "" ADC
 SG_ ARC_OD_ID_35_FR : 471|8@0+ (1,0) [0|255] "" ADC
 SG_ ARC_OD_MsgCounter_Obj_34_35_FR : 491|4@0+ (1,0) [0|15] "" ADC
 SG_ ARC_OD_CRC8_Obj_34_35_FR : 511|8@0+ (1,0) [0|256] "" ADC
 SG_ ARC_OD_AabsY_Obj_34_FR : 48|9@0+ (0.125,-31.875) [-31.875|32] "m/s^2" ADC
 SG_ ARC_OD_DistXStd_Obj_34_FR : 71|8@0+ (0.05,0) [0|12.75] "m" ADC
 SG_ ARC_OD_DistYStd_Obj_34_FR : 79|8@0+ (0.1,0) [0|25.5] "m" ADC
 SG_ ARC_OD_VabsXStd_Obj_34_FR : 87|7@0+ (0.1,0) [0|12.7] "m/s" ADC
 SG_ ARC_OD_VabsYStd_Obj_34_FR : 80|7@0+ (0.2,0) [0|25.4] "m/s" ADC
 SG_ ARC_OD_AabsXStd_Obj_34_FR : 89|7@0+ (0.25,0) [0|31.75] "m/s^2" ADC

BO_ 1377 ARC_OD_32_33_FR: 64 ARC
 SG_ DistHeight_Obj_33_FR : 487|8@0+ (0.2,-10) [-10|41] "m" ADC
 SG_ DistHeight_Obj_32_FR : 479|8@0+ (0.2,-10) [-10|41] "m" ADC
 SG_ ARC_OD_DistX_Obj_32_FR : 7|12@0+ (0.1,-152) [-152|257.5] "m" ADC
 SG_ ARC_OD_Classification_Obj_32_FR : 98|3@0+ (1,0) [0|7] "" ADC
 SG_ ARC_OD_AabsYStd_Obj_32_FR : 111|8@0+ (0.25,0) [0|63.75] "m/s^2" ADC
 SG_ ARC_OD_ClassConf_Obj_32_FR : 119|7@0+ (1,0) [0|127] "%" ADC
 SG_ ARC_OD_ProbOfExist_Obj_32_FR : 112|7@0+ (1,0) [0|127] "%" ADC
 SG_ ARC_OD_VabsX_Obj_32_FR : 11|11@0+ (0.125,-128) [-128|127.875] "m/s" ADC
 SG_ ARC_OD_DynProp_Obj_32_FR : 130|3@0+ (1,0) [0|7] "" ADC
 SG_ ARC_OD_Length_Obj_32_FR : 136|7@0+ (0.2,0) [0|25.4] "m" ADC
 SG_ ARC_OD_MaintenanceState_Obj_0027 : 145|2@0+ (1,0) [0|3] "" ADC
 SG_ ARC_OD_Width_Obj_32_FR : 159|7@0+ (0.2,0) [0|25.4] "m" ADC
 SG_ ARC_OD_RCS_Obj_32_FR : 152|9@0+ (0.2,-51.1) [-51.1|51.1] "dBsm" ADC
 SG_ ARC_OD_Orientation_Obj_32_FR : 175|10@0+ (0.01,-5.11) [-5.11|5.12] "rad" ADC
 SG_ ARC_OD_LifeCycle_Obj_32_FR : 207|16@0+ (1,0) [0|65535] "" ADC
 SG_ ARC_OD_DistX_Obj_33_FR : 223|12@0+ (0.1,-152) [-152|257.5] "m" ADC
 SG_ ARC_OD_VabsX_Obj_33_FR : 227|11@0+ (0.125,-128) [-128|127.875] "m/s" ADC
 SG_ ARC_OD_AabsX_Obj_33_FR : 232|9@0+ (0.125,-31.875) [-31.875|32] "m/s^2" ADC
 SG_ ARC_OD_AabsX_Obj_32_FR : 16|9@0+ (0.125,-31.875) [-31.875|32] "m/s^2" ADC
 SG_ ARC_OD_DistY_Obj_33_FR : 255|12@0+ (0.0875,-179.113) [-179.113|179.2] "m" ADC
 SG_ ARC_OD_VabsY_Obj_33_FR : 259|11@0+ (0.125,-128) [-128|127.875] "m/s" ADC
 SG_ ARC_OD_AabsY_Obj_33_FR : 264|9@0+ (0.125,-31.875) [-31.875|32] "m/s^2" ADC
 SG_ ARC_OD_DistXStd_Obj_33_FR : 287|8@0+ (0.05,0) [0|12.75] "m" ADC
 SG_ ARC_OD_DistYStd_Obj_33_FR : 295|8@0+ (0.1,0) [0|25.5] "m" ADC
 SG_ ARC_OD_VabsXStd_Obj_33_FR : 303|7@0+ (0.1,0) [0|12.7] "m/s" ADC
 SG_ ARC_OD_VabsYStd_Obj_33_FR : 296|7@0+ (0.2,0) [0|25.4] "m/s" ADC
 SG_ ARC_OD_AabsXStd_Obj_33_FR : 305|7@0+ (0.25,0) [0|31.75] "m/s^2" ADC
 SG_ ARC_OD_Classification_Obj_33_FR : 314|3@0+ (1,0) [0|7] "" ADC
 SG_ ARC_OD_AabsYStd_Obj_33_FR : 327|8@0+ (0.25,0) [0|63.75] "m/s^2" ADC
 SG_ ARC_OD_ClassConf_Obj_33_FR : 335|7@0+ (1,0) [0|127] "%" ADC
 SG_ ARC_OD_DistY_Obj_32_FR : 39|12@0+ (0.0875,-179.113) [-179.113|179.2] "m" ADC
 SG_ ARC_OD_ProbOfExist_Obj_33_FR : 328|7@0+ (1,0) [0|127] "%" ADC
 SG_ ARC_OD_DynProp_Obj_33_FR : 346|3@0+ (1,0) [0|7] "" ADC
 SG_ ARC_OD_Length_Obj_33_FR : 352|7@0+ (0.2,0) [0|25.4] "m" ADC
 SG_ ARC_OD_MaintenanceState_Obj_0028 : 361|2@0+ (1,0) [0|3] "" ADC
 SG_ ARC_OD_Width_Obj_33_FR : 375|7@0+ (0.2,0) [0|25.4] "m" ADC
 SG_ ARC_OD_RCS_Obj_33_FR : 368|9@0+ (0.2,-51.1) [-51.1|51.1] "dBsm" ADC
 SG_ ARC_OD_Orientation_Obj_33_FR : 391|10@0+ (0.01,-5.11) [-5.11|5.12] "rad" ADC
 SG_ ARC_OD_LifeCycle_Obj_33_FR : 423|16@0+ (1,0) [0|65535] "" ADC
 SG_ ARC_OD_ObstacleProb_Obj_32_FR : 447|7@0+ (1,0) [0|127] "%" ADC
 SG_ ARC_OD_ObstacleProb_Obj_33_FR : 455|7@0+ (1,0) [0|127] "%" ADC
 SG_ ARC_OD_VabsY_Obj_32_FR : 43|11@0+ (0.125,-128) [-128|127.875] "m/s" ADC
 SG_ ARC_OD_ID_32_FR : 463|8@0+ (1,0) [0|255] "" ADC
 SG_ ARC_OD_ID_33_FR : 471|8@0+ (1,0) [0|255] "" ADC
 SG_ ARC_OD_MsgCounter_Obj_32_33_FR : 491|4@0+ (1,0) [0|15] "" ADC
 SG_ ARC_OD_CRC8_Obj_32_33_FR : 511|8@0+ (1,0) [0|256] "" ADC
 SG_ ARC_OD_AabsY_Obj_32_FR : 48|9@0+ (0.125,-31.875) [-31.875|32] "m/s^2" ADC
 SG_ ARC_OD_DistXStd_Obj_32_FR : 71|8@0+ (0.05,0) [0|12.75] "m" ADC
 SG_ ARC_OD_DistYStd_Obj_32_FR : 79|8@0+ (0.1,0) [0|25.5] "m" ADC
 SG_ ARC_OD_VabsXStd_Obj_32_FR : 87|7@0+ (0.1,0) [0|12.7] "m/s" ADC
 SG_ ARC_OD_VabsYStd_Obj_32_FR : 80|7@0+ (0.2,0) [0|25.4] "m/s" ADC
 SG_ ARC_OD_AabsXStd_Obj_32_FR : 89|7@0+ (0.25,0) [0|31.75] "m/s^2" ADC

BO_ 1376 ARC_OD_30_31_FR: 64 ARC
 SG_ DistHeight_Obj_31_FR : 487|8@0+ (0.2,-10) [-10|41] "m" ADC
 SG_ DistHeight_Obj_30_FR : 479|8@0+ (0.2,-10) [-10|41] "m" ADC
 SG_ ARC_OD_DistX_Obj_30_FR : 7|12@0+ (0.1,-152) [-152|257.5] "m" ADC
 SG_ ARC_OD_Classification_Obj_30_FR : 98|3@0+ (1,0) [0|7] "" ADC
 SG_ ARC_OD_AabsYStd_Obj_30_FR : 111|8@0+ (0.25,0) [0|63.75] "m/s^2" ADC
 SG_ ARC_OD_ClassConf_Obj_30_FR : 119|7@0+ (1,0) [0|127] "%" ADC
 SG_ ARC_OD_ProbOfExist_Obj_30_FR : 112|7@0+ (1,0) [0|127] "%" ADC
 SG_ ARC_OD_VabsX_Obj_30_FR : 11|11@0+ (0.125,-128) [-128|127.875] "m/s" ADC
 SG_ ARC_OD_DynProp_Obj_30_FR : 130|3@0+ (1,0) [0|7] "" ADC
 SG_ ARC_OD_Length_Obj_30_FR : 136|7@0+ (0.2,0) [0|25.4] "m" ADC
 SG_ ARC_OD_MaintenanceState_Obj_0029 : 145|2@0+ (1,0) [0|3] "" ADC
 SG_ ARC_OD_Width_Obj_30_FR : 159|7@0+ (0.2,0) [0|25.4] "m" ADC
 SG_ ARC_OD_RCS_Obj_30_FR : 152|9@0+ (0.2,-51.1) [-51.1|51.1] "dBsm" ADC
 SG_ ARC_OD_Orientation_Obj_30_FR : 175|10@0+ (0.01,-5.11) [-5.11|5.12] "rad" ADC
 SG_ ARC_OD_LifeCycle_Obj_30_FR : 207|16@0+ (1,0) [0|65535] "" ADC
 SG_ ARC_OD_DistX_Obj_31_FR : 223|12@0+ (0.1,-152) [-152|257.5] "m" ADC
 SG_ ARC_OD_VabsX_Obj_31_FR : 227|11@0+ (0.125,-128) [-128|127.875] "m/s" ADC
 SG_ ARC_OD_AabsX_Obj_31_FR : 232|9@0+ (0.125,-31.875) [-31.875|32] "m/s^2" ADC
 SG_ ARC_OD_AabsX_Obj_30_FR : 16|9@0+ (0.125,-31.875) [-31.875|32] "m/s^2" ADC
 SG_ ARC_OD_DistY_Obj_31_FR : 255|12@0+ (0.0875,-179.113) [-179.113|179.2] "m" ADC
 SG_ ARC_OD_VabsY_Obj_31_FR : 259|11@0+ (0.125,-128) [-128|127.875] "m/s" ADC
 SG_ ARC_OD_AabsY_Obj_31_FR : 264|9@0+ (0.125,-31.875) [-31.875|32] "m/s^2" ADC
 SG_ ARC_OD_DistXStd_Obj_31_FR : 287|8@0+ (0.05,0) [0|12.75] "m" ADC
 SG_ ARC_OD_DistYStd_Obj_31_FR : 295|8@0+ (0.1,0) [0|25.5] "m" ADC
 SG_ ARC_OD_VabsXStd_Obj_31_FR : 303|7@0+ (0.1,0) [0|12.7] "m/s" ADC
 SG_ ARC_OD_VabsYStd_Obj_31_FR : 296|7@0+ (0.2,0) [0|25.4] "m/s" ADC
 SG_ ARC_OD_AabsXStd_Obj_31_FR : 305|7@0+ (0.25,0) [0|31.75] "m/s^2" ADC
 SG_ ARC_OD_Classification_Obj_31_FR : 314|3@0+ (1,0) [0|7] "" ADC
 SG_ ARC_OD_AabsYStd_Obj_31_FR : 327|8@0+ (0.25,0) [0|63.75] "m/s^2" ADC
 SG_ ARC_OD_ClassConf_Obj_31_FR : 335|7@0+ (1,0) [0|127] "%" ADC
 SG_ ARC_OD_DistY_Obj_30_FR : 39|12@0+ (0.0875,-179.113) [-179.113|179.2] "m" ADC
 SG_ ARC_OD_ProbOfExist_Obj_31_FR : 328|7@0+ (1,0) [0|127] "%" ADC
 SG_ ARC_OD_DynProp_Obj_31_FR : 346|3@0+ (1,0) [0|7] "" ADC
 SG_ ARC_OD_Length_Obj_31_FR : 352|7@0+ (0.2,0) [0|25.4] "m" ADC
 SG_ ARC_OD_MaintenanceState_Obj_0030 : 361|2@0+ (1,0) [0|3] "" ADC
 SG_ ARC_OD_Width_Obj_31_FR : 375|7@0+ (0.2,0) [0|25.4] "m" ADC
 SG_ ARC_OD_RCS_Obj_31_FR : 368|9@0+ (0.2,-51.1) [-51.1|51.1] "dBsm" ADC
 SG_ ARC_OD_Orientation_Obj_31_FR : 391|10@0+ (0.01,-5.11) [-5.11|5.12] "rad" ADC
 SG_ ARC_OD_LifeCycle_Obj_31_FR : 423|16@0+ (1,0) [0|65535] "" ADC
 SG_ ARC_OD_ObstacleProb_Obj_30_FR : 447|7@0+ (1,0) [0|127] "%" ADC
 SG_ ARC_OD_ObstacleProb_Obj_31_FR : 455|7@0+ (1,0) [0|127] "%" ADC
 SG_ ARC_OD_VabsY_Obj_30_FR : 43|11@0+ (0.125,-128) [-128|127.875] "m/s" ADC
 SG_ ARC_OD_ID_30_FR : 463|8@0+ (1,0) [0|255] "" ADC
 SG_ ARC_OD_ID_31_FR : 471|8@0+ (1,0) [0|255] "" ADC
 SG_ ARC_OD_MsgCounter_Obj_30_31_FR : 491|4@0+ (1,0) [0|15] "" ADC
 SG_ ARC_OD_CRC8_Obj_30_31_FR : 511|8@0+ (1,0) [0|256] "" ADC
 SG_ ARC_OD_AabsY_Obj_30_FR : 48|9@0+ (0.125,-31.875) [-31.875|32] "m/s^2" ADC
 SG_ ARC_OD_DistXStd_Obj_30_FR : 71|8@0+ (0.05,0) [0|12.75] "m" ADC
 SG_ ARC_OD_DistYStd_Obj_30_FR : 79|8@0+ (0.1,0) [0|25.5] "m" ADC
 SG_ ARC_OD_VabsXStd_Obj_30_FR : 87|7@0+ (0.1,0) [0|12.7] "m/s" ADC
 SG_ ARC_OD_VabsYStd_Obj_30_FR : 80|7@0+ (0.2,0) [0|25.4] "m/s" ADC
 SG_ ARC_OD_AabsXStd_Obj_30_FR : 89|7@0+ (0.25,0) [0|31.75] "m/s^2" ADC

BO_ 1375 ARC_OD_28_29_FR: 64 ARC
 SG_ DistHeight_Obj_29_FR : 487|8@0+ (0.2,-10) [-10|41] "m" ADC
 SG_ DistHeight_Obj_28_FR : 479|8@0+ (0.2,-10) [-10|41] "m" ADC
 SG_ ARC_OD_DistX_Obj_28_FR : 7|12@0+ (0.1,-152) [-152|257.5] "m" ADC
 SG_ ARC_OD_Classification_Obj_28_FR : 98|3@0+ (1,0) [0|7] "" ADC
 SG_ ARC_OD_AabsYStd_Obj_28_FR : 111|8@0+ (0.25,0) [0|63.75] "m/s^2" ADC
 SG_ ARC_OD_ClassConf_Obj_28_FR : 119|7@0+ (1,0) [0|127] "%" ADC
 SG_ ARC_OD_ProbOfExist_Obj_28_FR : 112|7@0+ (1,0) [0|127] "%" ADC
 SG_ ARC_OD_VabsX_Obj_28_FR : 11|11@0+ (0.125,-128) [-128|127.875] "m/s" ADC
 SG_ ARC_OD_DynProp_Obj_28_FR : 130|3@0+ (1,0) [0|7] "" ADC
 SG_ ARC_OD_Length_Obj_28_FR : 136|7@0+ (0.2,0) [0|25.4] "m" ADC
 SG_ ARC_OD_MaintenanceState_Obj_0031 : 145|2@0+ (1,0) [0|3] "" ADC
 SG_ ARC_OD_Width_Obj_28_FR : 159|7@0+ (0.2,0) [0|25.4] "m" ADC
 SG_ ARC_OD_RCS_Obj_28_FR : 152|9@0+ (0.2,-51.1) [-51.1|51.1] "dBsm" ADC
 SG_ ARC_OD_Orientation_Obj_28_FR : 175|10@0+ (0.01,-5.11) [-5.11|5.12] "rad" ADC
 SG_ ARC_OD_LifeCycle_Obj_28_FR : 207|16@0+ (1,0) [0|65535] "" ADC
 SG_ ARC_OD_DistX_Obj_29_FR : 223|12@0+ (0.1,-152) [-152|257.5] "m" ADC
 SG_ ARC_OD_VabsX_Obj_29_FR : 227|11@0+ (0.125,-128) [-128|127.875] "m/s" ADC
 SG_ ARC_OD_AabsX_Obj_29_FR : 232|9@0+ (0.125,-31.875) [-31.875|32] "m/s^2" ADC
 SG_ ARC_OD_AabsX_Obj_28_FR : 16|9@0+ (0.125,-31.875) [-31.875|32] "m/s^2" ADC
 SG_ ARC_OD_DistY_Obj_29_FR : 255|12@0+ (0.0875,-179.113) [-179.113|179.2] "m" ADC
 SG_ ARC_OD_VabsY_Obj_29_FR : 259|11@0+ (0.125,-128) [-128|127.875] "m/s" ADC
 SG_ ARC_OD_AabsY_Obj_29_FR : 264|9@0+ (0.125,-31.875) [-31.875|32] "m/s^2" ADC
 SG_ ARC_OD_DistXStd_Obj_29_FR : 287|8@0+ (0.05,0) [0|12.75] "m" ADC
 SG_ ARC_OD_DistYStd_Obj_29_FR : 295|8@0+ (0.1,0) [0|25.5] "m" ADC
 SG_ ARC_OD_VabsXStd_Obj_29_FR : 303|7@0+ (0.1,0) [0|12.7] "m/s" ADC
 SG_ ARC_OD_VabsYStd_Obj_29_FR : 296|7@0+ (0.2,0) [0|25.4] "m/s" ADC
 SG_ ARC_OD_AabsXStd_Obj_29_FR : 305|7@0+ (0.25,0) [0|31.75] "m/s^2" ADC
 SG_ ARC_OD_Classification_Obj_29_FR : 314|3@0+ (1,0) [0|7] "" ADC
 SG_ ARC_OD_AabsYStd_Obj_29_FR : 327|8@0+ (0.25,0) [0|63.75] "m/s^2" ADC
 SG_ ARC_OD_ClassConf_Obj_29_FR : 335|7@0+ (1,0) [0|127] "%" ADC
 SG_ ARC_OD_DistY_Obj_28_FR : 39|12@0+ (0.0875,-179.113) [-179.113|179.2] "m" ADC
 SG_ ARC_OD_ProbOfExist_Obj_29_FR : 328|7@0+ (1,0) [0|127] "%" ADC
 SG_ ARC_OD_DynProp_Obj_29_FR : 346|3@0+ (1,0) [0|7] "" ADC
 SG_ ARC_OD_Length_Obj_29_FR : 352|7@0+ (0.2,0) [0|25.4] "m" ADC
 SG_ ARC_OD_MaintenanceState_Obj_0032 : 361|2@0+ (1,0) [0|3] "" ADC
 SG_ ARC_OD_Width_Obj_29_FR : 375|7@0+ (0.2,0) [0|25.4] "m" ADC
 SG_ ARC_OD_RCS_Obj_29_FR : 368|9@0+ (0.2,-51.1) [-51.1|51.1] "dBsm" ADC
 SG_ ARC_OD_Orientation_Obj_29_FR : 391|10@0+ (0.01,-5.11) [-5.11|5.12] "rad" ADC
 SG_ ARC_OD_LifeCycle_Obj_29_FR : 423|16@0+ (1,0) [0|65535] "" ADC
 SG_ ARC_OD_ObstacleProb_Obj_28_FR : 447|7@0+ (1,0) [0|127] "%" ADC
 SG_ ARC_OD_ObstacleProb_Obj_29_FR : 455|7@0+ (1,0) [0|127] "%" ADC
 SG_ ARC_OD_VabsY_Obj_28_FR : 43|11@0+ (0.125,-128) [-128|127.875] "m/s" ADC
 SG_ ARC_OD_ID_28_FR : 463|8@0+ (1,0) [0|255] "" ADC
 SG_ ARC_OD_ID_29_FR : 471|8@0+ (1,0) [0|255] "" ADC
 SG_ ARC_OD_MsgCounter_Obj_28_29_FR : 491|4@0+ (1,0) [0|15] "" ADC
 SG_ ARC_OD_CRC8_Obj_28_29_FR : 511|8@0+ (1,0) [0|256] "" ADC
 SG_ ARC_OD_AabsY_Obj_28_FR : 48|9@0+ (0.125,-31.875) [-31.875|32] "m/s^2" ADC
 SG_ ARC_OD_DistXStd_Obj_28_FR : 71|8@0+ (0.05,0) [0|12.75] "m" ADC
 SG_ ARC_OD_DistYStd_Obj_28_FR : 79|8@0+ (0.1,0) [0|25.5] "m" ADC
 SG_ ARC_OD_VabsXStd_Obj_28_FR : 87|7@0+ (0.1,0) [0|12.7] "m/s" ADC
 SG_ ARC_OD_VabsYStd_Obj_28_FR : 80|7@0+ (0.2,0) [0|25.4] "m/s" ADC
 SG_ ARC_OD_AabsXStd_Obj_28_FR : 89|7@0+ (0.25,0) [0|31.75] "m/s^2" ADC

BO_ 1374 ARC_OD_26_27_FR: 64 ARC
 SG_ DistHeight_Obj_27_FR : 487|8@0+ (0.2,-10) [-10|41] "m" ADC
 SG_ DistHeight_Obj_26_FR : 479|8@0+ (0.2,-10) [-10|41] "m" ADC
 SG_ ARC_OD_DistX_Obj_26_FR : 7|12@0+ (0.1,-152) [-152|257.5] "m" ADC
 SG_ ARC_OD_Classification_Obj_26_FR : 98|3@0+ (1,0) [0|7] "" ADC
 SG_ ARC_OD_AabsYStd_Obj_26_FR : 111|8@0+ (0.25,0) [0|63.75] "m/s^2" ADC
 SG_ ARC_OD_ClassConf_Obj_26_FR : 119|7@0+ (1,0) [0|127] "%" ADC
 SG_ ARC_OD_ProbOfExist_Obj_26_FR : 112|7@0+ (1,0) [0|127] "%" ADC
 SG_ ARC_OD_VabsX_Obj_26_FR : 11|11@0+ (0.125,-128) [-128|127.875] "m/s" ADC
 SG_ ARC_OD_DynProp_Obj_26_FR : 130|3@0+ (1,0) [0|7] "" ADC
 SG_ ARC_OD_Length_Obj_26_FR : 136|7@0+ (0.2,0) [0|25.4] "m" ADC
 SG_ ARC_OD_MaintenanceState_Obj_0033 : 145|2@0+ (1,0) [0|3] "" ADC
 SG_ ARC_OD_Width_Obj_26_FR : 159|7@0+ (0.2,0) [0|25.4] "m" ADC
 SG_ ARC_OD_RCS_Obj_26_FR : 152|9@0+ (0.2,-51.1) [-51.1|51.1] "dBsm" ADC
 SG_ ARC_OD_Orientation_Obj_26_FR : 175|10@0+ (0.01,-5.11) [-5.11|5.12] "rad" ADC
 SG_ ARC_OD_LifeCycle_Obj_26_FR : 207|16@0+ (1,0) [0|65535] "" ADC
 SG_ ARC_OD_DistX_Obj_27_FR : 223|12@0+ (0.1,-152) [-152|257.5] "m" ADC
 SG_ ARC_OD_VabsX_Obj_27_FR : 227|11@0+ (0.125,-128) [-128|127.875] "m/s" ADC
 SG_ ARC_OD_AabsX_Obj_27_FR : 232|9@0+ (0.125,-31.875) [-31.875|32] "m/s^2" ADC
 SG_ ARC_OD_AabsX_Obj_26_FR : 16|9@0+ (0.125,-31.875) [-31.875|32] "m/s^2" ADC
 SG_ ARC_OD_DistY_Obj_27_FR : 255|12@0+ (0.0875,-179.113) [-179.113|179.2] "m" ADC
 SG_ ARC_OD_VabsY_Obj_27_FR : 259|11@0+ (0.125,-128) [-128|127.875] "m/s" ADC
 SG_ ARC_OD_AabsY_Obj_27_FR : 264|9@0+ (0.125,-31.875) [-31.875|32] "m/s^2" ADC
 SG_ ARC_OD_DistXStd_Obj_27_FR : 287|8@0+ (0.05,0) [0|12.75] "m" ADC
 SG_ ARC_OD_DistYStd_Obj_27_FR : 295|8@0+ (0.1,0) [0|25.5] "m" ADC
 SG_ ARC_OD_VabsXStd_Obj_27_FR : 303|7@0+ (0.1,0) [0|12.7] "m/s" ADC
 SG_ ARC_OD_VabsYStd_Obj_27_FR : 296|7@0+ (0.2,0) [0|25.4] "m/s" ADC
 SG_ ARC_OD_AabsXStd_Obj_27_FR : 305|7@0+ (0.25,0) [0|31.75] "m/s^2" ADC
 SG_ ARC_OD_Classification_Obj_27_FR : 314|3@0+ (1,0) [0|7] "" ADC
 SG_ ARC_OD_AabsYStd_Obj_27_FR : 327|8@0+ (0.25,0) [0|63.75] "m/s^2" ADC
 SG_ ARC_OD_ClassConf_Obj_27_FR : 335|7@0+ (1,0) [0|127] "%" ADC
 SG_ ARC_OD_DistY_Obj_26_FR : 39|12@0+ (0.0875,-179.113) [-179.113|179.2] "m" ADC
 SG_ ARC_OD_ProbOfExist_Obj_27_FR : 328|7@0+ (1,0) [0|127] "%" ADC
 SG_ ARC_OD_DynProp_Obj_27_FR : 346|3@0+ (1,0) [0|7] "" ADC
 SG_ ARC_OD_Length_Obj_27_FR : 352|7@0+ (0.2,0) [0|25.4] "m" ADC
 SG_ ARC_OD_MaintenanceState_Obj_0034 : 361|2@0+ (1,0) [0|3] "" ADC
 SG_ ARC_OD_Width_Obj_27_FR : 375|7@0+ (0.2,0) [0|25.4] "m" ADC
 SG_ ARC_OD_RCS_Obj_27_FR : 368|9@0+ (0.2,-51.1) [-51.1|51.1] "dBsm" ADC
 SG_ ARC_OD_Orientation_Obj_27_FR : 391|10@0+ (0.01,-5.11) [-5.11|5.12] "rad" ADC
 SG_ ARC_OD_LifeCycle_Obj_27_FR : 423|16@0+ (1,0) [0|65535] "" ADC
 SG_ ARC_OD_ObstacleProb_Obj_26_FR : 447|7@0+ (1,0) [0|127] "%" ADC
 SG_ ARC_OD_ObstacleProb_Obj_27_FR : 455|7@0+ (1,0) [0|127] "%" ADC
 SG_ ARC_OD_VabsY_Obj_26_FR : 43|11@0+ (0.125,-128) [-128|127.875] "m/s" ADC
 SG_ ARC_OD_ID_26_FR : 463|8@0+ (1,0) [0|255] "" ADC
 SG_ ARC_OD_ID_27_FR : 471|8@0+ (1,0) [0|255] "" ADC
 SG_ ARC_OD_MsgCounter_Obj_26_27_FR : 491|4@0+ (1,0) [0|15] "" ADC
 SG_ ARC_OD_CRC8_Obj_26_27_FR : 511|8@0+ (1,0) [0|256] "" ADC
 SG_ ARC_OD_AabsY_Obj_26_FR : 48|9@0+ (0.125,-31.875) [-31.875|32] "m/s^2" ADC
 SG_ ARC_OD_DistXStd_Obj_26_FR : 71|8@0+ (0.05,0) [0|12.75] "m" ADC
 SG_ ARC_OD_DistYStd_Obj_26_FR : 79|8@0+ (0.1,0) [0|25.5] "m" ADC
 SG_ ARC_OD_VabsXStd_Obj_26_FR : 87|7@0+ (0.1,0) [0|12.7] "m/s" ADC
 SG_ ARC_OD_VabsYStd_Obj_26_FR : 80|7@0+ (0.2,0) [0|25.4] "m/s" ADC
 SG_ ARC_OD_AabsXStd_Obj_26_FR : 89|7@0+ (0.25,0) [0|31.75] "m/s^2" ADC

BO_ 1373 ARC_OD_24_25_FR: 64 ARC
 SG_ DistHeight_Obj_25_FR : 487|8@0+ (0.2,-10) [-10|41] "m" ADC
 SG_ DistHeight_Obj_24_FR : 479|8@0+ (0.2,-10) [-10|41] "m" ADC
 SG_ ARC_OD_DistX_Obj_24_FR : 7|12@0+ (0.1,-152) [-152|257.5] "m" ADC
 SG_ ARC_OD_Classification_Obj_24_FR : 98|3@0+ (1,0) [0|7] "" ADC
 SG_ ARC_OD_AabsYStd_Obj_24_FR : 111|8@0+ (0.25,0) [0|63.75] "m/s^2" ADC
 SG_ ARC_OD_ClassConf_Obj_24_FR : 119|7@0+ (1,0) [0|127] "%" ADC
 SG_ ARC_OD_ProbOfExist_Obj_24_FR : 112|7@0+ (1,0) [0|127] "%" ADC
 SG_ ARC_OD_VabsX_Obj_24_FR : 11|11@0+ (0.125,-128) [-128|127.875] "m/s" ADC
 SG_ ARC_OD_DynProp_Obj_24_FR : 130|3@0+ (1,0) [0|7] "" ADC
 SG_ ARC_OD_Length_Obj_24_FR : 136|7@0+ (0.2,0) [0|25.4] "m" ADC
 SG_ ARC_OD_MaintenanceState_Obj_0035 : 145|2@0+ (1,0) [0|3] "" ADC
 SG_ ARC_OD_Width_Obj_24_FR : 159|7@0+ (0.2,0) [0|25.4] "m" ADC
 SG_ ARC_OD_RCS_Obj_24_FR : 152|9@0+ (0.2,-51.1) [-51.1|51.1] "dBsm" ADC
 SG_ ARC_OD_Orientation_Obj_24_FR : 175|10@0+ (0.01,-5.11) [-5.11|5.12] "rad" ADC
 SG_ ARC_OD_LifeCycle_Obj_24_FR : 207|16@0+ (1,0) [0|65535] "" ADC
 SG_ ARC_OD_DistX_Obj_25_FR : 223|12@0+ (0.1,-152) [-152|257.5] "m" ADC
 SG_ ARC_OD_VabsX_Obj_25_FR : 227|11@0+ (0.125,-128) [-128|127.875] "m/s" ADC
 SG_ ARC_OD_AabsX_Obj_25_FR : 232|9@0+ (0.125,-31.875) [-31.875|32] "m/s^2" ADC
 SG_ ARC_OD_AabsX_Obj_24_FR : 16|9@0+ (0.125,-31.875) [-31.875|32] "m/s^2" ADC
 SG_ ARC_OD_DistY_Obj_25_FR : 255|12@0+ (0.0875,-179.113) [-179.113|179.2] "m" ADC
 SG_ ARC_OD_VabsY_Obj_25_FR : 259|11@0+ (0.125,-128) [-128|127.875] "m/s" ADC
 SG_ ARC_OD_AabsY_Obj_25_FR : 264|9@0+ (0.125,-31.875) [-31.875|32] "m/s^2" ADC
 SG_ ARC_OD_DistXStd_Obj_25_FR : 287|8@0+ (0.05,0) [0|12.75] "m" ADC
 SG_ ARC_OD_DistYStd_Obj_25_FR : 295|8@0+ (0.1,0) [0|25.5] "m" ADC
 SG_ ARC_OD_VabsXStd_Obj_25_FR : 303|7@0+ (0.1,0) [0|12.7] "m/s" ADC
 SG_ ARC_OD_VabsYStd_Obj_25_FR : 296|7@0+ (0.2,0) [0|25.4] "m/s" ADC
 SG_ ARC_OD_AabsXStd_Obj_25_FR : 305|7@0+ (0.25,0) [0|31.75] "m/s^2" ADC
 SG_ ARC_OD_Classification_Obj_25_FR : 314|3@0+ (1,0) [0|7] "" ADC
 SG_ ARC_OD_AabsYStd_Obj_25_FR : 327|8@0+ (0.25,0) [0|63.75] "m/s^2" ADC
 SG_ ARC_OD_ClassConf_Obj_25_FR : 335|7@0+ (1,0) [0|127] "%" ADC
 SG_ ARC_OD_DistY_Obj_24_FR : 39|12@0+ (0.0875,-179.113) [-179.113|179.2] "m" ADC
 SG_ ARC_OD_ProbOfExist_Obj_25_FR : 328|7@0+ (1,0) [0|127] "%" ADC
 SG_ ARC_OD_DynProp_Obj_25_FR : 346|3@0+ (1,0) [0|7] "" ADC
 SG_ ARC_OD_Length_Obj_25_FR : 352|7@0+ (0.2,0) [0|25.4] "m" ADC
 SG_ ARC_OD_MaintenanceState_Obj_0036 : 361|2@0+ (1,0) [0|3] "" ADC
 SG_ ARC_OD_Width_Obj_25_FR : 375|7@0+ (0.2,0) [0|25.4] "m" ADC
 SG_ ARC_OD_RCS_Obj_25_FR : 368|9@0+ (0.2,-51.1) [-51.1|51.1] "dBsm" ADC
 SG_ ARC_OD_Orientation_Obj_25_FR : 391|10@0+ (0.01,-5.11) [-5.11|5.12] "rad" ADC
 SG_ ARC_OD_LifeCycle_Obj_25_FR : 423|16@0+ (1,0) [0|65535] "" ADC
 SG_ ARC_OD_ObstacleProb_Obj_24_FR : 447|7@0+ (1,0) [0|127] "%" ADC
 SG_ ARC_OD_ObstacleProb_Obj_25_FR : 455|7@0+ (1,0) [0|127] "%" ADC
 SG_ ARC_OD_VabsY_Obj_24_FR : 43|11@0+ (0.125,-128) [-128|127.875] "m/s" ADC
 SG_ ARC_OD_ID_24_FR : 463|8@0+ (1,0) [0|255] "" ADC
 SG_ ARC_OD_ID_25_FR : 471|8@0+ (1,0) [0|255] "" ADC
 SG_ ARC_OD_MsgCounter_Obj_24_25_FR : 491|4@0+ (1,0) [0|15] "" ADC
 SG_ ARC_OD_CRC8_Obj_24_25_FR : 511|8@0+ (1,0) [0|256] "" ADC
 SG_ ARC_OD_AabsY_Obj_24_FR : 48|9@0+ (0.125,-31.875) [-31.875|32] "m/s^2" ADC
 SG_ ARC_OD_DistXStd_Obj_24_FR : 71|8@0+ (0.05,0) [0|12.75] "m" ADC
 SG_ ARC_OD_DistYStd_Obj_24_FR : 79|8@0+ (0.1,0) [0|25.5] "m" ADC
 SG_ ARC_OD_VabsXStd_Obj_24_FR : 87|7@0+ (0.1,0) [0|12.7] "m/s" ADC
 SG_ ARC_OD_VabsYStd_Obj_24_FR : 80|7@0+ (0.2,0) [0|25.4] "m/s" ADC
 SG_ ARC_OD_AabsXStd_Obj_24_FR : 89|7@0+ (0.25,0) [0|31.75] "m/s^2" ADC

CM_ SG_ 1618 ARC_OD_DistX_Obj_02_FL "111";

BA_DEF_ BO_ "GenMsgCycleTime" INT 0 65535;
BA_DEF_ BO_ "GenMsgSendType" ENUM "Cycle","OnChange","OnWrite","OnWriteWithRepetition","OnChangeWithRepetition","IfActive","IfActiveWithRepetition","NoMsgSendType";
BA_DEF_ BO_ "VFrameFormat" ENUM "StandardCAN","ExtendedCAN","reserved","reserved","reserved","reserved","reserved","reserved","reserved","reserved","reserved","reserved","reserved","reserved","StandardCAN_FD","ExtendedCAN_FD";
BA_DEF_ SG_ "GenSigILSupport" ENUM "No","Yes";
BA_DEF_ SG_ "GenSigInactiveValue" HEX 0 0;
BA_DEF_ SG_ "GenSigSendType" ENUM "Cycle","OnWrite","OnWriteWithRepetition","OnChange","OnChangeWithRepetition","IfActive","IfActiveWithRepetition","NoSigSendType","vector_leerstring";
BA_DEF_ SG_ "GenSigStartValue" FLOAT 0 100000000000;
BA_DEF_DEF_ "GenMsgCycleTime" 0;
BA_DEF_DEF_ "GenMsgSendType" "Cycle";
BA_DEF_DEF_ "VFrameFormat" "StandardCAN";
BA_DEF_DEF_ "GenSigILSupport" "Yes";
BA_DEF_DEF_ "GenSigSendType" "NoSigSendType";
BA_DEF_DEF_ "GenSigStartValue" 0;
BA_DEF_DEF_ "GenSigInactiveValue" 0;
BA_ "GenMsgCycleTime" BO_ 1623 50;
BA_ "VFrameFormat" BO_ 1623 14;
BA_ "GenMsgCycleTime" BO_ 1622 50;
BA_ "VFrameFormat" BO_ 1622 14;
BA_ "GenMsgCycleTime" BO_ 1621 50;
BA_ "VFrameFormat" BO_ 1621 14;
BA_ "GenMsgCycleTime" BO_ 1620 50;
BA_ "VFrameFormat" BO_ 1620 14;
BA_ "GenMsgCycleTime" BO_ 1619 50;
BA_ "VFrameFormat" BO_ 1619 14;
BA_ "GenMsgCycleTime" BO_ 1618 50;
BA_ "VFrameFormat" BO_ 1618 14;
BA_ "GenMsgCycleTime" BO_ 1617 50;
BA_ "VFrameFormat" BO_ 1617 14;
BA_ "GenMsgCycleTime" BO_ 1390 50;
BA_ "VFrameFormat" BO_ 1390 14;
BA_ "GenMsgCycleTime" BO_ 1389 50;
BA_ "VFrameFormat" BO_ 1389 14;
BA_ "GenMsgCycleTime" BO_ 1388 50;
BA_ "VFrameFormat" BO_ 1388 14;
BA_ "GenMsgCycleTime" BO_ 1387 50;
BA_ "VFrameFormat" BO_ 1387 14;
BA_ "GenMsgCycleTime" BO_ 1386 50;
BA_ "VFrameFormat" BO_ 1386 14;
BA_ "GenMsgCycleTime" BO_ 1385 50;
BA_ "VFrameFormat" BO_ 1385 14;
BA_ "GenMsgCycleTime" BO_ 1384 50;
BA_ "VFrameFormat" BO_ 1384 14;
BA_ "GenMsgCycleTime" BO_ 1383 50;
BA_ "VFrameFormat" BO_ 1383 14;
BA_ "GenMsgCycleTime" BO_ 1382 50;
BA_ "VFrameFormat" BO_ 1382 14;
BA_ "GenMsgCycleTime" BO_ 1381 50;
BA_ "VFrameFormat" BO_ 1381 14;
BA_ "GenMsgCycleTime" BO_ 1380 50;
BA_ "VFrameFormat" BO_ 1380 14;
BA_ "GenMsgCycleTime" BO_ 1379 50;
BA_ "VFrameFormat" BO_ 1379 14;
BA_ "GenMsgCycleTime" BO_ 1378 50;
BA_ "VFrameFormat" BO_ 1378 14;
BA_ "GenMsgCycleTime" BO_ 1377 50;
BA_ "VFrameFormat" BO_ 1377 14;
BA_ "GenMsgCycleTime" BO_ 1376 50;
BA_ "VFrameFormat" BO_ 1376 14;
BA_ "GenMsgCycleTime" BO_ 1375 50;
BA_ "VFrameFormat" BO_ 1375 14;
BA_ "GenMsgCycleTime" BO_ 1374 50;
BA_ "VFrameFormat" BO_ 1374 14;
BA_ "GenMsgCycleTime" BO_ 1373 50;
BA_ "VFrameFormat" BO_ 1373 14;
BA_ "GenSigSendType" SG_ 1623 ARC_OD_Length_Obj_12_FL 8;
BA_ "GenSigSendType" SG_ 1623 ARC_OD_DistY_Obj_13_FL 8;
BA_ "GenSigSendType" SG_ 1623 ARC_OD_AabsXStd_Obj_13_FL 8;
BA_ "GenSigSendType" SG_ 1623 ARC_OD_AabsY_Obj_12_FL 8;
BA_ "GenSigSendType" SG_ 1623 DistHeight_Obj_13_FL 8;
BA_ "GenSigSendType" SG_ 1623 DistHeight_Obj_12_FL 8;
BA_ "GenSigSendType" SG_ 1623 ARC_OD_DistX_Obj_12_FL 8;
BA_ "GenSigSendType" SG_ 1623 ARC_OD_Classification_Obj_12_FL 8;
BA_ "GenSigSendType" SG_ 1623 ARC_OD_AabsYStd_Obj_12_FL 8;
BA_ "GenSigSendType" SG_ 1623 ARC_OD_ClassConf_Obj_12_FL 8;
BA_ "GenSigSendType" SG_ 1623 ARC_OD_ProbOfExist_Obj_12_FL 8;
BA_ "GenSigSendType" SG_ 1623 ARC_OD_VabsX_Obj_12_FL 8;
BA_ "GenSigSendType" SG_ 1623 ARC_OD_DynProp_Obj_12_FL 8;
BA_ "GenSigSendType" SG_ 1623 ARC_OD_MaintenanceState_Obj_12_F 8;
BA_ "GenSigSendType" SG_ 1623 ARC_OD_Width_Obj_12_FL 8;
BA_ "GenSigSendType" SG_ 1623 ARC_OD_RCS_Obj_12_FL 8;
BA_ "GenSigSendType" SG_ 1623 ARC_OD_Orientation_Obj_12_FL 8;
BA_ "GenSigSendType" SG_ 1623 ARC_OD_LifeCycle_Obj_12_FL 8;
BA_ "GenSigSendType" SG_ 1623 ARC_OD_DistX_Obj_13_FL 8;
BA_ "GenSigSendType" SG_ 1623 ARC_OD_VabsX_Obj_13_FL 8;
BA_ "GenSigSendType" SG_ 1623 ARC_OD_AabsX_Obj_13_FL 8;
BA_ "GenSigSendType" SG_ 1623 ARC_OD_AabsX_Obj_12_FL 8;
BA_ "GenSigSendType" SG_ 1623 ARC_OD_VabsY_Obj_13_FL 8;
BA_ "GenSigSendType" SG_ 1623 ARC_OD_AabsY_Obj_13_FL 8;
BA_ "GenSigSendType" SG_ 1623 ARC_OD_DistXStd_Obj_13_FL 8;
BA_ "GenSigSendType" SG_ 1623 ARC_OD_DistYStd_Obj_13_FL 8;
BA_ "GenSigSendType" SG_ 1623 ARC_OD_VabsXStd_Obj_13_FL 8;
BA_ "GenSigSendType" SG_ 1623 ARC_OD_VabsYStd_Obj_13_FL 8;
BA_ "GenSigSendType" SG_ 1623 ARC_OD_Classification_Obj_13_FL 8;
BA_ "GenSigSendType" SG_ 1623 ARC_OD_AabsYStd_Obj_13_FL 8;
BA_ "GenSigSendType" SG_ 1623 ARC_OD_ClassConf_Obj_13_FL 8;
BA_ "GenSigSendType" SG_ 1623 ARC_OD_DistY_Obj_12_FL 8;
BA_ "GenSigSendType" SG_ 1623 ARC_OD_ProbOfExist_Obj_13_FL 8;
BA_ "GenSigSendType" SG_ 1623 ARC_OD_DynProp_Obj_13_FL 8;
BA_ "GenSigSendType" SG_ 1623 ARC_OD_Length_Obj_13_FL 8;
BA_ "GenSigSendType" SG_ 1623 ARC_OD_MaintenanceState_Obj_13_F 8;
BA_ "GenSigSendType" SG_ 1623 ARC_OD_Width_Obj_13_FL 8;
BA_ "GenSigSendType" SG_ 1623 ARC_OD_RCS_Obj_13_FL 8;
BA_ "GenSigSendType" SG_ 1623 ARC_OD_Orientation_Obj_13_FL 8;
BA_ "GenSigSendType" SG_ 1623 ARC_OD_LifeCycle_Obj_13_FL 8;
BA_ "GenSigSendType" SG_ 1623 ARC_OD_ObstacleProb_Obj_12_FL 8;
BA_ "GenSigSendType" SG_ 1623 ARC_OD_ObstacleProb_Obj_13_FL 8;
BA_ "GenSigSendType" SG_ 1623 ARC_OD_VabsY_Obj_12_FL 8;
BA_ "GenSigSendType" SG_ 1623 ARC_OD_ID_13_FL 8;
BA_ "GenSigSendType" SG_ 1623 ARC_OD_MsgCounter_Obj_12_13_FL 8;
BA_ "GenSigSendType" SG_ 1623 ARC_OD_CRC8_Obj_12_13_FL 8;
BA_ "GenSigSendType" SG_ 1623 ARC_OD_DistXStd_Obj_12_FL 8;
BA_ "GenSigSendType" SG_ 1623 ARC_OD_DistYStd_Obj_12_FL 8;
BA_ "GenSigSendType" SG_ 1623 ARC_OD_VabsXStd_Obj_12_FL 8;
BA_ "GenSigSendType" SG_ 1623 ARC_OD_VabsYStd_Obj_12_FL 8;
BA_ "GenSigSendType" SG_ 1623 ARC_OD_AabsXStd_Obj_12_FL 8;
BA_ "GenSigSendType" SG_ 1622 DistHeight_Obj_11_FL 8;
BA_ "GenSigSendType" SG_ 1622 DistHeight_Obj_10_FL 8;
BA_ "GenSigSendType" SG_ 1622 ARC_OD_DistX_Obj_10_FL 8;
BA_ "GenSigSendType" SG_ 1622 ARC_OD_Classification_Obj_10_FL 8;
BA_ "GenSigSendType" SG_ 1622 ARC_OD_AabsYStd_Obj_10_FL 8;
BA_ "GenSigSendType" SG_ 1622 ARC_OD_ClassConf_Obj_10_FL 8;
BA_ "GenSigSendType" SG_ 1622 ARC_OD_ProbOfExist_Obj_10_FL 8;
BA_ "GenSigSendType" SG_ 1622 ARC_OD_VabsX_Obj_10_FL 8;
BA_ "GenSigSendType" SG_ 1622 ARC_OD_DynProp_Obj_10_FL 8;
BA_ "GenSigSendType" SG_ 1622 ARC_OD_Length_Obj_10_FL 8;
BA_ "GenSigSendType" SG_ 1622 ARC_OD_Width_Obj_10_FL 8;
BA_ "GenSigSendType" SG_ 1622 ARC_OD_RCS_Obj_10_FL 8;
BA_ "GenSigSendType" SG_ 1622 ARC_OD_Orientation_Obj_10_FL 8;
BA_ "GenSigSendType" SG_ 1622 ARC_OD_LifeCycle_Obj_10_FL 8;
BA_ "GenSigSendType" SG_ 1622 ARC_OD_DistX_Obj_11_FL 8;
BA_ "GenSigSendType" SG_ 1622 ARC_OD_VabsX_Obj_11_FL 8;
BA_ "GenSigSendType" SG_ 1622 ARC_OD_AabsX_Obj_11_FL 8;
BA_ "GenSigSendType" SG_ 1622 ARC_OD_AabsX_Obj_10_FL 8;
BA_ "GenSigSendType" SG_ 1622 ARC_OD_DistY_Obj_11_FL 8;
BA_ "GenSigSendType" SG_ 1622 ARC_OD_VabsY_Obj_11_FL 8;
BA_ "GenSigSendType" SG_ 1622 ARC_OD_AabsY_Obj_11_FL 8;
BA_ "GenSigSendType" SG_ 1622 ARC_OD_DistXStd_Obj_11_FL 8;
BA_ "GenSigSendType" SG_ 1622 ARC_OD_DistYStd_Obj_11_FL 8;
BA_ "GenSigSendType" SG_ 1622 ARC_OD_VabsXStd_Obj_11_FL 8;
BA_ "GenSigSendType" SG_ 1622 ARC_OD_VabsYStd_Obj_11_FL 8;
BA_ "GenSigSendType" SG_ 1622 ARC_OD_AabsXStd_Obj_11_FL 8;
BA_ "GenSigSendType" SG_ 1622 ARC_OD_Classification_Obj_11_FL 8;
BA_ "GenSigSendType" SG_ 1622 ARC_OD_AabsYStd_Obj_11_FL 8;
BA_ "GenSigSendType" SG_ 1622 ARC_OD_ClassConf_Obj_11_FL 8;
BA_ "GenSigSendType" SG_ 1622 ARC_OD_DistY_Obj_10_FL 8;
BA_ "GenSigSendType" SG_ 1622 ARC_OD_ProbOfExist_Obj_11_FL 8;
BA_ "GenSigSendType" SG_ 1622 ARC_OD_DynProp_Obj_11_FL 8;
BA_ "GenSigSendType" SG_ 1622 ARC_OD_Length_Obj_11_FL 8;
BA_ "GenSigSendType" SG_ 1622 ARC_OD_MaintenanceState_Obj_11_F 8;
BA_ "GenSigSendType" SG_ 1622 ARC_OD_Width_Obj_11_FL 8;
BA_ "GenSigSendType" SG_ 1622 ARC_OD_RCS_Obj_11_FL 8;
BA_ "GenSigSendType" SG_ 1622 ARC_OD_Orientation_Obj_11_FL 8;
BA_ "GenSigSendType" SG_ 1622 ARC_OD_LifeCycle_Obj_11_FL 8;
BA_ "GenSigSendType" SG_ 1622 ARC_OD_ObstacleProb_Obj_10_FL 8;
BA_ "GenSigSendType" SG_ 1622 ARC_OD_ObstacleProb_Obj_11_FL 8;
BA_ "GenSigSendType" SG_ 1622 ARC_OD_VabsY_Obj_10_FL 8;
BA_ "GenSigSendType" SG_ 1622 ARC_OD_ID_10_FL 8;
BA_ "GenSigSendType" SG_ 1622 ARC_OD_ID_11_FL 8;
BA_ "GenSigSendType" SG_ 1622 ARC_OD_MsgCounter_Obj_10_11_FL 8;
BA_ "GenSigSendType" SG_ 1622 ARC_OD_CRC8_Obj_10_11_FL 8;
BA_ "GenSigSendType" SG_ 1622 ARC_OD_AabsY_Obj_10_FL 8;
BA_ "GenSigSendType" SG_ 1622 ARC_OD_DistXStd_Obj_10_FL 8;
BA_ "GenSigSendType" SG_ 1622 ARC_OD_DistYStd_Obj_10_FL 8;
BA_ "GenSigSendType" SG_ 1622 ARC_OD_VabsXStd_Obj_10_FL 8;
BA_ "GenSigSendType" SG_ 1622 ARC_OD_VabsYStd_Obj_10_FL 8;
BA_ "GenSigSendType" SG_ 1622 ARC_OD_AabsXStd_Obj_10_FL 8;
BA_ "GenSigSendType" SG_ 1621 DistHeight_Obj_09_FL 8;
BA_ "GenSigSendType" SG_ 1621 DistHeight_Obj_08_FL 8;
BA_ "GenSigSendType" SG_ 1621 ARC_OD_DistX_Obj_08_FL 8;
BA_ "GenSigSendType" SG_ 1621 ARC_OD_Classification_Obj_08_FL 8;
BA_ "GenSigSendType" SG_ 1621 ARC_OD_AabsYStd_Obj_08_FL 8;
BA_ "GenSigSendType" SG_ 1621 ARC_OD_ClassConf_Obj_08_FL 8;
BA_ "GenSigSendType" SG_ 1621 ARC_OD_ProbOfExist_Obj_08_FL 8;
BA_ "GenSigSendType" SG_ 1621 ARC_OD_VabsX_Obj_08_FL 8;
BA_ "GenSigSendType" SG_ 1621 ARC_OD_DynProp_Obj_08_FL 8;
BA_ "GenSigSendType" SG_ 1621 ARC_OD_Length_Obj_08_FL 8;
BA_ "GenSigSendType" SG_ 1621 ARC_OD_MaintenanceState_Obj_08_F 8;
BA_ "GenSigSendType" SG_ 1621 ARC_OD_Width_Obj_08_FL 8;
BA_ "GenSigSendType" SG_ 1621 ARC_OD_RCS_Obj_08_FL 8;
BA_ "GenSigSendType" SG_ 1621 ARC_OD_Orientation_Obj_08_FL 8;
BA_ "GenSigSendType" SG_ 1621 ARC_OD_LifeCycle_Obj_08_FL 8;
BA_ "GenSigSendType" SG_ 1621 ARC_OD_DistX_Obj_09_FL 8;
BA_ "GenSigSendType" SG_ 1621 ARC_OD_VabsX_Obj_09_FL 8;
BA_ "GenSigSendType" SG_ 1621 ARC_OD_AabsX_Obj_09_FL 8;
BA_ "GenSigSendType" SG_ 1621 ARC_OD_AabsX_Obj_08_FL 8;
BA_ "GenSigSendType" SG_ 1621 ARC_OD_DistY_Obj_09_FL 8;
BA_ "GenSigSendType" SG_ 1621 ARC_OD_VabsY_Obj_09_FL 8;
BA_ "GenSigSendType" SG_ 1621 ARC_OD_AabsY_Obj_09_FL 8;
BA_ "GenSigSendType" SG_ 1621 ARC_OD_DistXStd_Obj_09_FL 8;
BA_ "GenSigSendType" SG_ 1621 ARC_OD_DistYStd_Obj_09_FL 8;
BA_ "GenSigSendType" SG_ 1621 ARC_OD_VabsXStd_Obj_09_FL 8;
BA_ "GenSigSendType" SG_ 1621 ARC_OD_VabsYStd_Obj_09_FL 8;
BA_ "GenSigSendType" SG_ 1621 ARC_OD_AabsXStd_Obj_09_FL 8;
BA_ "GenSigSendType" SG_ 1621 ARC_OD_Classification_Obj_09_FL 8;
BA_ "GenSigSendType" SG_ 1621 ARC_OD_AabsYStd_Obj_09_FL 8;
BA_ "GenSigSendType" SG_ 1621 ARC_OD_ClassConf_Obj_09_FL 8;
BA_ "GenSigSendType" SG_ 1621 ARC_OD_DistY_Obj_08_FL 8;
BA_ "GenSigSendType" SG_ 1621 ARC_OD_ProbOfExist_Obj_09_FL 8;
BA_ "GenSigSendType" SG_ 1621 ARC_OD_DynProp_Obj_09_FL 8;
BA_ "GenSigSendType" SG_ 1621 ARC_OD_Length_Obj_09_FL 8;
BA_ "GenSigSendType" SG_ 1621 ARC_OD_MaintenanceState_Obj_09_F 8;
BA_ "GenSigSendType" SG_ 1621 ARC_OD_Width_Obj_09_FL 8;
BA_ "GenSigSendType" SG_ 1621 ARC_OD_RCS_Obj_09_FL 8;
BA_ "GenSigSendType" SG_ 1621 ARC_OD_Orientation_Obj_09_FL 8;
BA_ "GenSigSendType" SG_ 1621 ARC_OD_LifeCycle_Obj_09_FL 8;
BA_ "GenSigSendType" SG_ 1621 ARC_OD_ObstacleProb_Obj_08_FL 8;
BA_ "GenSigSendType" SG_ 1621 ARC_OD_ObstacleProb_Obj_09_FL 8;
BA_ "GenSigSendType" SG_ 1621 ARC_OD_VabsY_Obj_08_FL 8;
BA_ "GenSigSendType" SG_ 1621 ARC_OD_ID_08_FL 8;
BA_ "GenSigSendType" SG_ 1621 ARC_OD_ID_09_FL 8;
BA_ "GenSigSendType" SG_ 1621 ARC_OD_MsgCounter_Obj_08_09_FL 8;
BA_ "GenSigSendType" SG_ 1621 ARC_OD_CRC8_Obj_08_09_FL 8;
BA_ "GenSigSendType" SG_ 1621 ARC_OD_AabsY_Obj_08_FL 8;
BA_ "GenSigSendType" SG_ 1621 ARC_OD_DistXStd_Obj_08_FL 8;
BA_ "GenSigSendType" SG_ 1621 ARC_OD_DistYStd_Obj_08_FL 8;
BA_ "GenSigSendType" SG_ 1621 ARC_OD_VabsXStd_Obj_08_FL 8;
BA_ "GenSigSendType" SG_ 1621 ARC_OD_VabsYStd_Obj_08_FL 8;
BA_ "GenSigSendType" SG_ 1621 ARC_OD_AabsXStd_Obj_08_FL 8;
BA_ "GenSigSendType" SG_ 1620 DistHeight_Obj_07_FL 8;
BA_ "GenSigSendType" SG_ 1620 DistHeight_Obj_06_FL 8;
BA_ "GenSigSendType" SG_ 1620 ARC_OD_DistX_Obj_06_FL 8;
BA_ "GenSigSendType" SG_ 1620 ARC_OD_Classification_Obj_06_FL 8;
BA_ "GenSigSendType" SG_ 1620 ARC_OD_AabsYStd_Obj_06_FL 8;
BA_ "GenSigSendType" SG_ 1620 ARC_OD_ClassConf_Obj_06_FL 8;
BA_ "GenSigSendType" SG_ 1620 ARC_OD_ProbOfExist_Obj_06_FL 8;
BA_ "GenSigSendType" SG_ 1620 ARC_OD_VabsX_Obj_06_FL 8;
BA_ "GenSigSendType" SG_ 1620 ARC_OD_DynProp_Obj_06_FL 8;
BA_ "GenSigSendType" SG_ 1620 ARC_OD_Length_Obj_06_FL 8;
BA_ "GenSigSendType" SG_ 1620 ARC_OD_MaintenanceState_Obj_06_F 8;
BA_ "GenSigSendType" SG_ 1620 ARC_OD_Width_Obj_06_FL 8;
BA_ "GenSigSendType" SG_ 1620 ARC_OD_RCS_Obj_06_FL 8;
BA_ "GenSigSendType" SG_ 1620 ARC_OD_Orientation_Obj_06_FL 8;
BA_ "GenSigSendType" SG_ 1620 ARC_OD_LifeCycle_Obj_06_FL 8;
BA_ "GenSigSendType" SG_ 1620 ARC_OD_DistX_Obj_07_FL 8;
BA_ "GenSigSendType" SG_ 1620 ARC_OD_VabsX_Obj_07_FL 8;
BA_ "GenSigSendType" SG_ 1620 ARC_OD_AabsX_Obj_07_FL 8;
BA_ "GenSigSendType" SG_ 1620 ARC_OD_AabsX_Obj_06_FL 8;
BA_ "GenSigSendType" SG_ 1620 ARC_OD_DistY_Obj_07_FL 8;
BA_ "GenSigSendType" SG_ 1620 ARC_OD_VabsY_Obj_07_FL 8;
BA_ "GenSigSendType" SG_ 1620 ARC_OD_AabsY_Obj_07_FL 8;
BA_ "GenSigSendType" SG_ 1620 ARC_OD_DistXStd_Obj_07_FL 8;
BA_ "GenSigSendType" SG_ 1620 ARC_OD_DistYStd_Obj_07_FL 8;
BA_ "GenSigSendType" SG_ 1620 ARC_OD_VabsXStd_Obj_07_FL 8;
BA_ "GenSigSendType" SG_ 1620 ARC_OD_VabsYStd_Obj_07_FL 8;
BA_ "GenSigSendType" SG_ 1620 ARC_OD_AabsXStd_Obj_07_FL 8;
BA_ "GenSigSendType" SG_ 1620 ARC_OD_Classification_Obj_07_FL 8;
BA_ "GenSigSendType" SG_ 1620 ARC_OD_AabsYStd_Obj_07_FL 8;
BA_ "GenSigSendType" SG_ 1620 ARC_OD_ClassConf_Obj_07_FL 8;
BA_ "GenSigSendType" SG_ 1620 ARC_OD_DistY_Obj_06_FL 8;
BA_ "GenSigSendType" SG_ 1620 ARC_OD_ProbOfExist_Obj_07_FL 8;
BA_ "GenSigSendType" SG_ 1620 ARC_OD_DynProp_Obj_07_FL 8;
BA_ "GenSigSendType" SG_ 1620 ARC_OD_Length_Obj_07_FL 8;
BA_ "GenSigSendType" SG_ 1620 ARC_OD_MaintenanceState_Obj_07_F 8;
BA_ "GenSigSendType" SG_ 1620 ARC_OD_Width_Obj_07_FL 8;
BA_ "GenSigSendType" SG_ 1620 ARC_OD_RCS_Obj_07_FL 8;
BA_ "GenSigSendType" SG_ 1620 ARC_OD_Orientation_Obj_07_FL 8;
BA_ "GenSigSendType" SG_ 1620 ARC_OD_LifeCycle_Obj_07_FL 8;
BA_ "GenSigSendType" SG_ 1620 ARC_OD_ObstacleProb_Obj_06_FL 8;
BA_ "GenSigSendType" SG_ 1620 ARC_OD_ObstacleProb_Obj_07_FL 8;
BA_ "GenSigSendType" SG_ 1620 ARC_OD_VabsY_Obj_06_FL 8;
BA_ "GenSigSendType" SG_ 1620 ARC_OD_ID_06_FL 8;
BA_ "GenSigSendType" SG_ 1620 ARC_OD_ID_07_FL 8;
BA_ "GenSigSendType" SG_ 1620 ARC_OD_MsgCounter_Obj_06_07_FL 8;
BA_ "GenSigSendType" SG_ 1620 ARC_OD_CRC8_Obj_06_07_FL 8;
BA_ "GenSigSendType" SG_ 1620 ARC_OD_AabsY_Obj_06_FL 8;
BA_ "GenSigSendType" SG_ 1620 ARC_OD_DistXStd_Obj_06_FL 8;
BA_ "GenSigSendType" SG_ 1620 ARC_OD_DistYStd_Obj_06_FL 8;
BA_ "GenSigSendType" SG_ 1620 ARC_OD_VabsXStd_Obj_06_FL 8;
BA_ "GenSigSendType" SG_ 1620 ARC_OD_VabsYStd_Obj_06_FL 8;
BA_ "GenSigSendType" SG_ 1620 ARC_OD_AabsXStd_Obj_06_FL 8;
BA_ "GenSigSendType" SG_ 1619 DistHeight_Obj_05_FL 8;
BA_ "GenSigSendType" SG_ 1619 DistHeight_Obj_04_FL 8;
BA_ "GenSigSendType" SG_ 1619 ARC_OD_DistX_Obj_04_FL 8;
BA_ "GenSigSendType" SG_ 1619 ARC_OD_Classification_Obj_04_FL 8;
BA_ "GenSigSendType" SG_ 1619 ARC_OD_AabsYStd_Obj_04_FL 8;
BA_ "GenSigSendType" SG_ 1619 ARC_OD_ClassConf_Obj_04_FL 8;
BA_ "GenSigSendType" SG_ 1619 ARC_OD_ProbOfExist_Obj_04_FL 8;
BA_ "GenSigSendType" SG_ 1619 ARC_OD_VabsX_Obj_04_FL 8;
BA_ "GenSigSendType" SG_ 1619 ARC_OD_DynProp_Obj_04_FL 8;
BA_ "GenSigSendType" SG_ 1619 ARC_OD_Length_Obj_04_FL 8;
BA_ "GenSigSendType" SG_ 1619 ARC_OD_MaintenanceState_Obj_04_F 8;
BA_ "GenSigSendType" SG_ 1619 ARC_OD_Width_Obj_04_FL 8;
BA_ "GenSigSendType" SG_ 1619 ARC_OD_RCS_Obj_04_FL 8;
BA_ "GenSigSendType" SG_ 1619 ARC_OD_Orientation_Obj_04_FL 8;
BA_ "GenSigSendType" SG_ 1619 ARC_OD_LifeCycle_Obj_04_FL 8;
BA_ "GenSigSendType" SG_ 1619 ARC_OD_DistX_Obj_05_FL 8;
BA_ "GenSigSendType" SG_ 1619 ARC_OD_VabsX_Obj_05_FL 8;
BA_ "GenSigSendType" SG_ 1619 ARC_OD_AabsX_Obj_05_FL 8;
BA_ "GenSigSendType" SG_ 1619 ARC_OD_AabsX_Obj_04_FL 8;
BA_ "GenSigSendType" SG_ 1619 ARC_OD_DistY_Obj_05_FL 8;
BA_ "GenSigSendType" SG_ 1619 ARC_OD_VabsY_Obj_05_FL 8;
BA_ "GenSigSendType" SG_ 1619 ARC_OD_AabsY_Obj_05_FL 8;
BA_ "GenSigSendType" SG_ 1619 ARC_OD_DistXStd_Obj_05_FL 8;
BA_ "GenSigSendType" SG_ 1619 ARC_OD_DistYStd_Obj_05_FL 8;
BA_ "GenSigSendType" SG_ 1619 ARC_OD_VabsXStd_Obj_05_FL 8;
BA_ "GenSigSendType" SG_ 1619 ARC_OD_VabsYStd_Obj_05_FL 8;
BA_ "GenSigSendType" SG_ 1619 ARC_OD_AabsXStd_Obj_05_FL 8;
BA_ "GenSigSendType" SG_ 1619 ARC_OD_Classification_Obj_05_FL 8;
BA_ "GenSigSendType" SG_ 1619 ARC_OD_AabsYStd_Obj_05_FL 8;
BA_ "GenSigSendType" SG_ 1619 ARC_OD_ClassConf_Obj_05_FL 8;
BA_ "GenSigSendType" SG_ 1619 ARC_OD_DistY_Obj_04_FL 8;
BA_ "GenSigSendType" SG_ 1619 ARC_OD_ProbOfExist_Obj_05_FL 8;
BA_ "GenSigSendType" SG_ 1619 ARC_OD_DynProp_Obj_05_FL 8;
BA_ "GenSigSendType" SG_ 1619 ARC_OD_Length_Obj_05_FL 8;
BA_ "GenSigSendType" SG_ 1619 ARC_OD_MaintenanceState_Obj_05_F 8;
BA_ "GenSigSendType" SG_ 1619 ARC_OD_Width_Obj_05_FL 8;
BA_ "GenSigSendType" SG_ 1619 ARC_OD_RCS_Obj_05_FL 8;
BA_ "GenSigSendType" SG_ 1619 ARC_OD_Orientation_Obj_05_FL 8;
BA_ "GenSigSendType" SG_ 1619 ARC_OD_LifeCycle_Obj_05_FL 8;
BA_ "GenSigSendType" SG_ 1619 ARC_OD_ObstacleProb_Obj_04_FL 8;
BA_ "GenSigSendType" SG_ 1619 ARC_OD_ObstacleProb_Obj_05_FL 8;
BA_ "GenSigSendType" SG_ 1619 ARC_OD_VabsY_Obj_04_FL 8;
BA_ "GenSigSendType" SG_ 1619 ARC_OD_ID_04_FL 8;
BA_ "GenSigSendType" SG_ 1619 ARC_OD_ID_05_FL 8;
BA_ "GenSigSendType" SG_ 1619 ARC_OD_MsgCounter_Obj_04_05_FL 8;
BA_ "GenSigSendType" SG_ 1619 ARC_OD_CRC8_Obj_04_05_FL 8;
BA_ "GenSigSendType" SG_ 1619 ARC_OD_AabsY_Obj_04_FL 8;
BA_ "GenSigSendType" SG_ 1619 ARC_OD_DistXStd_Obj_04_FL 8;
BA_ "GenSigSendType" SG_ 1619 ARC_OD_DistYStd_Obj_04_FL 8;
BA_ "GenSigSendType" SG_ 1619 ARC_OD_VabsXStd_Obj_04_FL 8;
BA_ "GenSigSendType" SG_ 1619 ARC_OD_VabsYStd_Obj_04_FL 8;
BA_ "GenSigSendType" SG_ 1619 ARC_OD_AabsXStd_Obj_04_FL 8;
BA_ "GenSigSendType" SG_ 1618 DistHeight_Obj_03_FL 8;
BA_ "GenSigSendType" SG_ 1618 DistHeight_Obj_02_FL 8;
BA_ "GenSigSendType" SG_ 1618 ARC_OD_DistX_Obj_02_FL 8;
BA_ "GenSigSendType" SG_ 1618 ARC_OD_Classification_Obj_02_FL 8;
BA_ "GenSigSendType" SG_ 1618 ARC_OD_AabsYStd_Obj_02_FL 8;
BA_ "GenSigSendType" SG_ 1618 ARC_OD_ClassConf_Obj_02_FL 8;
BA_ "GenSigSendType" SG_ 1618 ARC_OD_ProbOfExist_Obj_02_FL 8;
BA_ "GenSigSendType" SG_ 1618 ARC_OD_VabsX_Obj_02_FL 8;
BA_ "GenSigSendType" SG_ 1618 ARC_OD_DynProp_Obj_02_FL 8;
BA_ "GenSigSendType" SG_ 1618 ARC_OD_Length_Obj_02_FL 8;
BA_ "GenSigSendType" SG_ 1618 ARC_OD_MaintenanceState_Obj_02_F 8;
BA_ "GenSigSendType" SG_ 1618 ARC_OD_Width_Obj_02_FL 8;
BA_ "GenSigSendType" SG_ 1618 ARC_OD_RCS_Obj_02_FL 8;
BA_ "GenSigSendType" SG_ 1618 ARC_OD_Orientation_Obj_02_FL 8;
BA_ "GenSigSendType" SG_ 1618 ARC_OD_LifeCycle_Obj_02_FL 8;
BA_ "GenSigSendType" SG_ 1618 ARC_OD_DistX_Obj_03_FL 8;
BA_ "GenSigSendType" SG_ 1618 ARC_OD_VabsX_Obj_03_FL 8;
BA_ "GenSigSendType" SG_ 1618 ARC_OD_AabsX_Obj_03_FL 8;
BA_ "GenSigSendType" SG_ 1618 ARC_OD_AabsX_Obj_02_FL 8;
BA_ "GenSigSendType" SG_ 1618 ARC_OD_DistY_Obj_03_FL 8;
BA_ "GenSigSendType" SG_ 1618 ARC_OD_VabsY_Obj_03_FL 8;
BA_ "GenSigSendType" SG_ 1618 ARC_OD_AabsY_Obj_03_FL 8;
BA_ "GenSigSendType" SG_ 1618 ARC_OD_DistXStd_Obj_03_FL 8;
BA_ "GenSigSendType" SG_ 1618 ARC_OD_DistYStd_Obj_03_FL 8;
BA_ "GenSigSendType" SG_ 1618 ARC_OD_VabsXStd_Obj_03_FL 8;
BA_ "GenSigSendType" SG_ 1618 ARC_OD_VabsYStd_Obj_03_FL 8;
BA_ "GenSigSendType" SG_ 1618 ARC_OD_AabsXStd_Obj_03_FL 8;
BA_ "GenSigSendType" SG_ 1618 ARC_OD_Classification_Obj_03_FL 8;
BA_ "GenSigSendType" SG_ 1618 ARC_OD_AabsYStd_Obj_03_FL 8;
BA_ "GenSigSendType" SG_ 1618 ARC_OD_ClassConf_Obj_03_FL 8;
BA_ "GenSigSendType" SG_ 1618 ARC_OD_DistY_Obj_02_FL 8;
BA_ "GenSigSendType" SG_ 1618 ARC_OD_ProbOfExist_Obj_03_FL 8;
BA_ "GenSigSendType" SG_ 1618 ARC_OD_DynProp_Obj_03_FL 8;
BA_ "GenSigSendType" SG_ 1618 ARC_OD_Length_Obj_03_FL 8;
BA_ "GenSigSendType" SG_ 1618 ARC_OD_MaintenanceState_Obj_03_F 8;
BA_ "GenSigSendType" SG_ 1618 ARC_OD_Width_Obj_03_FL 8;
BA_ "GenSigSendType" SG_ 1618 ARC_OD_RCS_Obj_03_FL 8;
BA_ "GenSigSendType" SG_ 1618 ARC_OD_Orientation_Obj_03_FL 8;
BA_ "GenSigSendType" SG_ 1618 ARC_OD_LifeCycle_Obj_03_FL 8;
BA_ "GenSigSendType" SG_ 1618 ARC_OD_ObstacleProb_Obj_02_FL 8;
BA_ "GenSigSendType" SG_ 1618 ARC_OD_ObstacleProb_Obj_03_FL 8;
BA_ "GenSigSendType" SG_ 1618 ARC_OD_VabsY_Obj_02_FL 8;
BA_ "GenSigSendType" SG_ 1618 ARC_OD_ID_02_FL 8;
BA_ "GenSigSendType" SG_ 1618 ARC_OD_ID_03_FL 8;
BA_ "GenSigSendType" SG_ 1618 ARC_OD_MsgCounter_Obj_02_03_FL 8;
BA_ "GenSigSendType" SG_ 1618 ARC_OD_CRC8_Obj_02_03_FL 8;
BA_ "GenSigSendType" SG_ 1618 ARC_OD_AabsY_Obj_02_FL 8;
BA_ "GenSigSendType" SG_ 1618 ARC_OD_DistXStd_Obj_02_FL 8;
BA_ "GenSigSendType" SG_ 1618 ARC_OD_DistYStd_Obj_02_FL 8;
BA_ "GenSigSendType" SG_ 1618 ARC_OD_VabsXStd_Obj_02_FL 8;
BA_ "GenSigSendType" SG_ 1618 ARC_OD_VabsYStd_Obj_02_FL 8;
BA_ "GenSigSendType" SG_ 1618 ARC_OD_AabsXStd_Obj_02_FL 8;
BA_ "GenSigSendType" SG_ 1617 DistHeight_Obj_01_FL 8;
BA_ "GenSigSendType" SG_ 1617 DistHeight_Obj_00_FL 8;
BA_ "GenSigSendType" SG_ 1617 ARC_OD_DistX_Obj_00_FL 8;
BA_ "GenSigSendType" SG_ 1617 ARC_OD_Classification_Obj_00_FL 8;
BA_ "GenSigSendType" SG_ 1617 ARC_OD_AabsYStd_Obj_00_FL 8;
BA_ "GenSigSendType" SG_ 1617 ARC_OD_ClassConf_Obj_00_FL 8;
BA_ "GenSigSendType" SG_ 1617 ARC_OD_ProbOfExist_Obj_00_FL 8;
BA_ "GenSigSendType" SG_ 1617 ARC_OD_VabsX_Obj_00_FL 8;
BA_ "GenSigSendType" SG_ 1617 ARC_OD_DynProp_Obj_00_FL 8;
BA_ "GenSigSendType" SG_ 1617 ARC_OD_Length_Obj_00_FL 8;
BA_ "GenSigSendType" SG_ 1617 ARC_OD_MaintenanceState_Obj_00_F 8;
BA_ "GenSigSendType" SG_ 1617 ARC_OD_Width_Obj_00_FL 8;
BA_ "GenSigSendType" SG_ 1617 ARC_OD_RCS_Obj_00_FL 8;
BA_ "GenSigSendType" SG_ 1617 ARC_OD_Orientation_Obj_00_FL 8;
BA_ "GenSigSendType" SG_ 1617 ARC_OD_LifeCycle_Obj_00_FL 8;
BA_ "GenSigSendType" SG_ 1617 ARC_OD_DistX_Obj_01_FL 8;
BA_ "GenSigSendType" SG_ 1617 ARC_OD_VabsX_Obj_01_FL 8;
BA_ "GenSigSendType" SG_ 1617 ARC_OD_AabsX_Obj_01_FL 8;
BA_ "GenSigSendType" SG_ 1617 ARC_OD_AabsX_Obj_00_FL 8;
BA_ "GenSigSendType" SG_ 1617 ARC_OD_DistY_Obj_01_FL 8;
BA_ "GenSigSendType" SG_ 1617 ARC_OD_VabsY_Obj_01_FL 8;
BA_ "GenSigSendType" SG_ 1617 ARC_OD_AabsY_Obj_01_FL 8;
BA_ "GenSigSendType" SG_ 1617 ARC_OD_DistXStd_Obj_01_FL 8;
BA_ "GenSigSendType" SG_ 1617 ARC_OD_DistYStd_Obj_01_FL 8;
BA_ "GenSigSendType" SG_ 1617 ARC_OD_VabsXStd_Obj_01_FL 8;
BA_ "GenSigSendType" SG_ 1617 ARC_OD_VabsYStd_Obj_01_FL 8;
BA_ "GenSigSendType" SG_ 1617 ARC_OD_AabsXStd_Obj_01_FL 8;
BA_ "GenSigSendType" SG_ 1617 ARC_OD_Classification_Obj_01_FL 8;
BA_ "GenSigSendType" SG_ 1617 ARC_OD_AabsYStd_Obj_01_FL 8;
BA_ "GenSigSendType" SG_ 1617 ARC_OD_ClassConf_Obj_01_FL 8;
BA_ "GenSigSendType" SG_ 1617 ARC_OD_DistY_Obj_00_FL 8;
BA_ "GenSigSendType" SG_ 1617 ARC_OD_ProbOfExist_Obj_01_FL 8;
BA_ "GenSigSendType" SG_ 1617 ARC_OD_DynProp_Obj_01_FL 8;
BA_ "GenSigSendType" SG_ 1617 ARC_OD_Length_Obj_01_FL 8;
BA_ "GenSigSendType" SG_ 1617 ARC_OD_MaintenanceState_Obj_01_F 8;
BA_ "GenSigSendType" SG_ 1617 ARC_OD_Width_Obj_01_FL 8;
BA_ "GenSigSendType" SG_ 1617 ARC_OD_RCS_Obj_01_FL 8;
BA_ "GenSigSendType" SG_ 1617 ARC_OD_Orientation_Obj_01_FL 8;
BA_ "GenSigSendType" SG_ 1617 ARC_OD_LifeCycle_Obj_01_FL 8;
BA_ "GenSigSendType" SG_ 1617 ARC_OD_ObstacleProb_Obj_00_FL 8;
BA_ "GenSigSendType" SG_ 1617 ARC_OD_ObstacleProb_Obj_01_FL 8;
BA_ "GenSigSendType" SG_ 1617 ARC_OD_VabsY_Obj_00_FL 8;
BA_ "GenSigSendType" SG_ 1617 ARC_OD_ID_00_FL 8;
BA_ "GenSigSendType" SG_ 1617 ARC_OD_ID_01_FL 8;
BA_ "GenSigSendType" SG_ 1617 ARC_OD_MsgCounter_Obj_00_01_FL 8;
BA_ "GenSigSendType" SG_ 1617 ARC_OD_CRC8_Obj_00_01_FL 8;
BA_ "GenSigSendType" SG_ 1617 ARC_OD_AabsY_Obj_00_FL 8;
BA_ "GenSigSendType" SG_ 1617 ARC_OD_DistXStd_Obj_00_FL 8;
BA_ "GenSigSendType" SG_ 1617 ARC_OD_DistYStd_Obj_00_FL 8;
BA_ "GenSigSendType" SG_ 1617 ARC_OD_VabsXStd_Obj_00_FL 8;
BA_ "GenSigSendType" SG_ 1617 ARC_OD_VabsYStd_Obj_00_FL 8;
BA_ "GenSigSendType" SG_ 1617 ARC_OD_AabsXStd_Obj_00_FL 8;
BA_ "GenSigSendType" SG_ 1390 DistHeight_Obj_59_FR 8;
BA_ "GenSigSendType" SG_ 1390 DistHeight_Obj_58_FR 8;
BA_ "GenSigSendType" SG_ 1390 ARC_OD_DistX_Obj_58_FR 8;
BA_ "GenSigSendType" SG_ 1390 ARC_OD_Classification_Obj_58_FR 8;
BA_ "GenSigSendType" SG_ 1390 ARC_OD_AabsYStd_Obj_58_FR 8;
BA_ "GenSigSendType" SG_ 1390 ARC_OD_ClassConf_Obj_58_FR 8;
BA_ "GenSigSendType" SG_ 1390 ARC_OD_ProbOfExist_Obj_58_FR 8;
BA_ "GenSigSendType" SG_ 1390 ARC_OD_VabsX_Obj_58_FR 8;
BA_ "GenSigSendType" SG_ 1390 ARC_OD_DynProp_Obj_58_FR 8;
BA_ "GenSigSendType" SG_ 1390 ARC_OD_Length_Obj_58_FR 8;
BA_ "GenSigSendType" SG_ 1390 ARC_OD_MaintenanceState_Obj_0001 8;
BA_ "GenSigSendType" SG_ 1390 ARC_OD_Width_Obj_58_FR 8;
BA_ "GenSigSendType" SG_ 1390 ARC_OD_RCS_Obj_58_FR 8;
BA_ "GenSigSendType" SG_ 1390 ARC_OD_Orientation_Obj_58_FR 8;
BA_ "GenSigSendType" SG_ 1390 ARC_OD_LifeCycle_Obj_58_FR 8;
BA_ "GenSigSendType" SG_ 1390 ARC_OD_DistX_Obj_59_FR 8;
BA_ "GenSigSendType" SG_ 1390 ARC_OD_VabsX_Obj_59_FR 8;
BA_ "GenSigSendType" SG_ 1390 ARC_OD_AabsX_Obj_59_FR 8;
BA_ "GenSigSendType" SG_ 1390 ARC_OD_AabsX_Obj_58_FR 8;
BA_ "GenSigSendType" SG_ 1390 ARC_OD_DistY_Obj_59_FR 8;
BA_ "GenSigSendType" SG_ 1390 ARC_OD_VabsY_Obj_59_FR 8;
BA_ "GenSigSendType" SG_ 1390 ARC_OD_AabsY_Obj_59_FR 8;
BA_ "GenSigSendType" SG_ 1390 ARC_OD_DistXStd_Obj_59_FR 8;
BA_ "GenSigSendType" SG_ 1390 ARC_OD_DistYStd_Obj_59_FR 8;
BA_ "GenSigSendType" SG_ 1390 ARC_OD_VabsXStd_Obj_59_FR 8;
BA_ "GenSigSendType" SG_ 1390 ARC_OD_VabsYStd_Obj_59_FR 8;
BA_ "GenSigSendType" SG_ 1390 ARC_OD_AabsXStd_Obj_59_FR 8;
BA_ "GenSigSendType" SG_ 1390 ARC_OD_Classification_Obj_59_FR 8;
BA_ "GenSigSendType" SG_ 1390 ARC_OD_AabsYStd_Obj_59_FR 8;
BA_ "GenSigSendType" SG_ 1390 ARC_OD_ClassConf_Obj_59_FR 8;
BA_ "GenSigSendType" SG_ 1390 ARC_OD_DistY_Obj_58_FR 8;
BA_ "GenSigSendType" SG_ 1390 ARC_OD_ProbOfExist_Obj_59_FR 8;
BA_ "GenSigSendType" SG_ 1390 ARC_OD_DynProp_Obj_59_FR 8;
BA_ "GenSigSendType" SG_ 1390 ARC_OD_Length_Obj_59_FR 8;
BA_ "GenSigSendType" SG_ 1390 ARC_OD_MaintenanceState_Obj_0002 8;
BA_ "GenSigSendType" SG_ 1390 ARC_OD_Width_Obj_59_FR 8;
BA_ "GenSigSendType" SG_ 1390 ARC_OD_RCS_Obj_59_FR 8;
BA_ "GenSigSendType" SG_ 1390 ARC_OD_Orientation_Obj_59_FR 8;
BA_ "GenSigSendType" SG_ 1390 ARC_OD_LifeCycle_Obj_59_FR 8;
BA_ "GenSigSendType" SG_ 1390 ARC_OD_ObstacleProb_Obj_58_FR 8;
BA_ "GenSigSendType" SG_ 1390 ARC_OD_ObstacleProb_Obj_59_FR 8;
BA_ "GenSigSendType" SG_ 1390 ARC_OD_VabsY_Obj_58_FR 8;
BA_ "GenSigSendType" SG_ 1390 ARC_OD_ID_58_FR 8;
BA_ "GenSigSendType" SG_ 1390 ARC_OD_ID_59_FR 8;
BA_ "GenSigSendType" SG_ 1390 ARC_OD_MsgCounter_Obj_58_59_FR 8;
BA_ "GenSigSendType" SG_ 1390 ARC_OD_CRC8_Obj_58_59_FR 8;
BA_ "GenSigSendType" SG_ 1390 ARC_OD_AabsY_Obj_58_FR 8;
BA_ "GenSigSendType" SG_ 1390 ARC_OD_DistXStd_Obj_58_FR 8;
BA_ "GenSigSendType" SG_ 1390 ARC_OD_DistYStd_Obj_58_FR 8;
BA_ "GenSigSendType" SG_ 1390 ARC_OD_VabsXStd_Obj_58_FR 8;
BA_ "GenSigSendType" SG_ 1390 ARC_OD_VabsYStd_Obj_58_FR 8;
BA_ "GenSigSendType" SG_ 1390 ARC_OD_AabsXStd_Obj_58_FR 8;
BA_ "GenSigSendType" SG_ 1389 DistHeight_Obj_57_FR 8;
BA_ "GenSigSendType" SG_ 1389 DistHeight_Obj_56_FR 8;
BA_ "GenSigSendType" SG_ 1389 ARC_OD_DistX_Obj_56_FR 8;
BA_ "GenSigSendType" SG_ 1389 ARC_OD_Classification_Obj_56_FR 8;
BA_ "GenSigSendType" SG_ 1389 ARC_OD_AabsYStd_Obj_56_FR 8;
BA_ "GenSigSendType" SG_ 1389 ARC_OD_ClassConf_Obj_56_FR 8;
BA_ "GenSigSendType" SG_ 1389 ARC_OD_ProbOfExist_Obj_56_FR 8;
BA_ "GenSigSendType" SG_ 1389 ARC_OD_VabsX_Obj_56_FR 8;
BA_ "GenSigSendType" SG_ 1389 ARC_OD_DynProp_Obj_56_FR 8;
BA_ "GenSigSendType" SG_ 1389 ARC_OD_Length_Obj_56_FR 8;
BA_ "GenSigSendType" SG_ 1389 ARC_OD_MaintenanceState_Obj_0003 8;
BA_ "GenSigSendType" SG_ 1389 ARC_OD_Width_Obj_56_FR 8;
BA_ "GenSigSendType" SG_ 1389 ARC_OD_RCS_Obj_56_FR 8;
BA_ "GenSigSendType" SG_ 1389 ARC_OD_Orientation_Obj_56_FR 8;
BA_ "GenSigSendType" SG_ 1389 ARC_OD_LifeCycle_Obj_56_FR 8;
BA_ "GenSigSendType" SG_ 1389 ARC_OD_DistX_Obj_57_FR 8;
BA_ "GenSigSendType" SG_ 1389 ARC_OD_VabsX_Obj_57_FR 8;
BA_ "GenSigSendType" SG_ 1389 ARC_OD_AabsX_Obj_57_FR 8;
BA_ "GenSigSendType" SG_ 1389 ARC_OD_AabsX_Obj_56_FR 8;
BA_ "GenSigSendType" SG_ 1389 ARC_OD_DistY_Obj_57_FR 8;
BA_ "GenSigSendType" SG_ 1389 ARC_OD_VabsY_Obj_57_FR 8;
BA_ "GenSigSendType" SG_ 1389 ARC_OD_AabsY_Obj_57_FR 8;
BA_ "GenSigSendType" SG_ 1389 ARC_OD_DistXStd_Obj_57_FR 8;
BA_ "GenSigSendType" SG_ 1389 ARC_OD_DistYStd_Obj_57_FR 8;
BA_ "GenSigSendType" SG_ 1389 ARC_OD_VabsXStd_Obj_57_FR 8;
BA_ "GenSigSendType" SG_ 1389 ARC_OD_VabsYStd_Obj_57_FR 8;
BA_ "GenSigSendType" SG_ 1389 ARC_OD_AabsXStd_Obj_57_FR 8;
BA_ "GenSigSendType" SG_ 1389 ARC_OD_Classification_Obj_57_FR 8;
BA_ "GenSigSendType" SG_ 1389 ARC_OD_AabsYStd_Obj_57_FR 8;
BA_ "GenSigSendType" SG_ 1389 ARC_OD_ClassConf_Obj_57_FR 8;
BA_ "GenSigSendType" SG_ 1389 ARC_OD_DistY_Obj_56_FR 8;
BA_ "GenSigSendType" SG_ 1389 ARC_OD_ProbOfExist_Obj_57_FR 8;
BA_ "GenSigSendType" SG_ 1389 ARC_OD_DynProp_Obj_57_FR 8;
BA_ "GenSigSendType" SG_ 1389 ARC_OD_Length_Obj_57_FR 8;
BA_ "GenSigSendType" SG_ 1389 ARC_OD_MaintenanceState_Obj_0004 8;
BA_ "GenSigSendType" SG_ 1389 ARC_OD_Width_Obj_57_FR 8;
BA_ "GenSigSendType" SG_ 1389 ARC_OD_RCS_Obj_57_FR 8;
BA_ "GenSigSendType" SG_ 1389 ARC_OD_Orientation_Obj_57_FR 8;
BA_ "GenSigSendType" SG_ 1389 ARC_OD_LifeCycle_Obj_57_FR 8;
BA_ "GenSigSendType" SG_ 1389 ARC_OD_ObstacleProb_Obj_56_FR 8;
BA_ "GenSigSendType" SG_ 1389 ARC_OD_ObstacleProb_Obj_57_FR 8;
BA_ "GenSigSendType" SG_ 1389 ARC_OD_VabsY_Obj_56_FR 8;
BA_ "GenSigSendType" SG_ 1389 ARC_OD_ID_56_FR 8;
BA_ "GenSigSendType" SG_ 1389 ARC_OD_ID_57_FR 8;
BA_ "GenSigSendType" SG_ 1389 ARC_OD_MsgCounter_Obj_56_57_FR 8;
BA_ "GenSigSendType" SG_ 1389 ARC_OD_CRC8_Obj_56_57_FR 8;
BA_ "GenSigSendType" SG_ 1389 ARC_OD_AabsY_Obj_56_FR 8;
BA_ "GenSigSendType" SG_ 1389 ARC_OD_DistXStd_Obj_56_FR 8;
BA_ "GenSigSendType" SG_ 1389 ARC_OD_DistYStd_Obj_56_FR 8;
BA_ "GenSigSendType" SG_ 1389 ARC_OD_VabsXStd_Obj_56_FR 8;
BA_ "GenSigSendType" SG_ 1389 ARC_OD_VabsYStd_Obj_56_FR 8;
BA_ "GenSigSendType" SG_ 1389 ARC_OD_AabsXStd_Obj_56_FR 8;
BA_ "GenSigSendType" SG_ 1388 DistHeight_Obj_54_FR 8;
BA_ "GenSigSendType" SG_ 1388 DistHeight_Obj_55_FR 8;
BA_ "GenSigSendType" SG_ 1388 ARC_OD_DistX_Obj_54_FR 8;
BA_ "GenSigSendType" SG_ 1388 ARC_OD_Classification_Obj_54_FR 8;
BA_ "GenSigSendType" SG_ 1388 ARC_OD_AabsYStd_Obj_54_FR 8;
BA_ "GenSigSendType" SG_ 1388 ARC_OD_ClassConf_Obj_54_FR 8;
BA_ "GenSigSendType" SG_ 1388 ARC_OD_ProbOfExist_Obj_54_FR 8;
BA_ "GenSigSendType" SG_ 1388 ARC_OD_VabsX_Obj_54_FR 8;
BA_ "GenSigSendType" SG_ 1388 ARC_OD_DynProp_Obj_54_FR 8;
BA_ "GenSigSendType" SG_ 1388 ARC_OD_Length_Obj_54_FR 8;
BA_ "GenSigSendType" SG_ 1388 ARC_OD_MaintenanceState_Obj_0005 8;
BA_ "GenSigSendType" SG_ 1388 ARC_OD_Width_Obj_54_FR 8;
BA_ "GenSigSendType" SG_ 1388 ARC_OD_RCS_Obj_54_FR 8;
BA_ "GenSigSendType" SG_ 1388 ARC_OD_Orientation_Obj_54_FR 8;
BA_ "GenSigSendType" SG_ 1388 ARC_OD_LifeCycle_Obj_54_FR 8;
BA_ "GenSigSendType" SG_ 1388 ARC_OD_DistX_Obj_55_FR 8;
BA_ "GenSigSendType" SG_ 1388 ARC_OD_VabsX_Obj_55_FR 8;
BA_ "GenSigSendType" SG_ 1388 ARC_OD_AabsX_Obj_55_FR 8;
BA_ "GenSigSendType" SG_ 1388 ARC_OD_AabsX_Obj_54_FR 8;
BA_ "GenSigSendType" SG_ 1388 ARC_OD_DistY_Obj_55_FR 8;
BA_ "GenSigSendType" SG_ 1388 ARC_OD_VabsY_Obj_55_FR 8;
BA_ "GenSigSendType" SG_ 1388 ARC_OD_AabsY_Obj_55_FR 8;
BA_ "GenSigSendType" SG_ 1388 ARC_OD_DistXStd_Obj_55_FR 8;
BA_ "GenSigSendType" SG_ 1388 ARC_OD_DistYStd_Obj_55_FR 8;
BA_ "GenSigSendType" SG_ 1388 ARC_OD_VabsXStd_Obj_55_FR 8;
BA_ "GenSigSendType" SG_ 1388 ARC_OD_VabsYStd_Obj_55_FR 8;
BA_ "GenSigSendType" SG_ 1388 ARC_OD_AabsXStd_Obj_55_FR 8;
BA_ "GenSigSendType" SG_ 1388 ARC_OD_Classification_Obj_55_FR 8;
BA_ "GenSigSendType" SG_ 1388 ARC_OD_AabsYStd_Obj_55_FR 8;
BA_ "GenSigSendType" SG_ 1388 ARC_OD_ClassConf_Obj_55_FR 8;
BA_ "GenSigSendType" SG_ 1388 ARC_OD_DistY_Obj_54_FR 8;
BA_ "GenSigSendType" SG_ 1388 ARC_OD_ProbOfExist_Obj_55_FR 8;
BA_ "GenSigSendType" SG_ 1388 ARC_OD_DynProp_Obj_55_FR 8;
BA_ "GenSigSendType" SG_ 1388 ARC_OD_Length_Obj_55_FR 8;
BA_ "GenSigSendType" SG_ 1388 ARC_OD_MaintenanceState_Obj_0006 8;
BA_ "GenSigSendType" SG_ 1388 ARC_OD_Width_Obj_55_FR 8;
BA_ "GenSigSendType" SG_ 1388 ARC_OD_RCS_Obj_55_FR 8;
BA_ "GenSigSendType" SG_ 1388 ARC_OD_Orientation_Obj_55_FR 8;
BA_ "GenSigSendType" SG_ 1388 ARC_OD_LifeCycle_Obj_55_FR 8;
BA_ "GenSigSendType" SG_ 1388 ARC_OD_ObstacleProb_Obj_54_FR 8;
BA_ "GenSigSendType" SG_ 1388 ARC_OD_ObstacleProb_Obj_55_FR 8;
BA_ "GenSigSendType" SG_ 1388 ARC_OD_VabsY_Obj_54_FR 8;
BA_ "GenSigSendType" SG_ 1388 ARC_OD_ID_54_FR 8;
BA_ "GenSigSendType" SG_ 1388 ARC_OD_ID_55_FR 8;
BA_ "GenSigSendType" SG_ 1388 ARC_OD_MsgCounter_Obj_54_55_FR 8;
BA_ "GenSigSendType" SG_ 1388 ARC_OD_CRC8_Obj_54_55_FR 8;
BA_ "GenSigSendType" SG_ 1388 ARC_OD_AabsY_Obj_54_FR 8;
BA_ "GenSigSendType" SG_ 1388 ARC_OD_DistXStd_Obj_54_FR 8;
BA_ "GenSigSendType" SG_ 1388 ARC_OD_DistYStd_Obj_54_FR 8;
BA_ "GenSigSendType" SG_ 1388 ARC_OD_VabsXStd_Obj_54_FR 8;
BA_ "GenSigSendType" SG_ 1388 ARC_OD_VabsYStd_Obj_54_FR 8;
BA_ "GenSigSendType" SG_ 1388 ARC_OD_AabsXStd_Obj_54_FR 8;
BA_ "GenSigSendType" SG_ 1387 DistHeight_Obj_53_FR 8;
BA_ "GenSigSendType" SG_ 1387 DistHeight_Obj_52_FR 8;
BA_ "GenSigSendType" SG_ 1387 ARC_OD_DistX_Obj_52_FR 8;
BA_ "GenSigSendType" SG_ 1387 ARC_OD_Classification_Obj_52_FR 8;
BA_ "GenSigSendType" SG_ 1387 ARC_OD_AabsYStd_Obj_52_FR 8;
BA_ "GenSigSendType" SG_ 1387 ARC_OD_ClassConf_Obj_52_FR 8;
BA_ "GenSigSendType" SG_ 1387 ARC_OD_ProbOfExist_Obj_52_FR 8;
BA_ "GenSigSendType" SG_ 1387 ARC_OD_VabsX_Obj_52_FR 8;
BA_ "GenSigSendType" SG_ 1387 ARC_OD_DynProp_Obj_52_FR 8;
BA_ "GenSigSendType" SG_ 1387 ARC_OD_Length_Obj_52_FR 8;
BA_ "GenSigSendType" SG_ 1387 ARC_OD_MaintenanceState_Obj_0007 8;
BA_ "GenSigSendType" SG_ 1387 ARC_OD_Width_Obj_52_FR 8;
BA_ "GenSigSendType" SG_ 1387 ARC_OD_RCS_Obj_52_FR 8;
BA_ "GenSigSendType" SG_ 1387 ARC_OD_Orientation_Obj_52_FR 8;
BA_ "GenSigSendType" SG_ 1387 ARC_OD_LifeCycle_Obj_52_FR 8;
BA_ "GenSigSendType" SG_ 1387 ARC_OD_DistX_Obj_53_FR 8;
BA_ "GenSigSendType" SG_ 1387 ARC_OD_VabsX_Obj_53_FR 8;
BA_ "GenSigSendType" SG_ 1387 ARC_OD_AabsX_Obj_53_FR 8;
BA_ "GenSigSendType" SG_ 1387 ARC_OD_AabsX_Obj_52_FR 8;
BA_ "GenSigSendType" SG_ 1387 ARC_OD_DistY_Obj_53_FR 8;
BA_ "GenSigSendType" SG_ 1387 ARC_OD_VabsY_Obj_53_FR 8;
BA_ "GenSigSendType" SG_ 1387 ARC_OD_AabsY_Obj_53_FR 8;
BA_ "GenSigSendType" SG_ 1387 ARC_OD_DistXStd_Obj_53_FR 8;
BA_ "GenSigSendType" SG_ 1387 ARC_OD_DistYStd_Obj_53_FR 8;
BA_ "GenSigSendType" SG_ 1387 ARC_OD_VabsXStd_Obj_53_FR 8;
BA_ "GenSigSendType" SG_ 1387 ARC_OD_VabsYStd_Obj_53_FR 8;
BA_ "GenSigSendType" SG_ 1387 ARC_OD_AabsXStd_Obj_53_FR 8;
BA_ "GenSigSendType" SG_ 1387 ARC_OD_Classification_Obj_53_FR 8;
BA_ "GenSigSendType" SG_ 1387 ARC_OD_AabsYStd_Obj_53_FR 8;
BA_ "GenSigSendType" SG_ 1387 ARC_OD_ClassConf_Obj_53_FR 8;
BA_ "GenSigSendType" SG_ 1387 ARC_OD_DistY_Obj_52_FR 8;
BA_ "GenSigSendType" SG_ 1387 ARC_OD_ProbOfExist_Obj_53_FR 8;
BA_ "GenSigSendType" SG_ 1387 ARC_OD_DynProp_Obj_53_FR 8;
BA_ "GenSigSendType" SG_ 1387 ARC_OD_Length_Obj_53_FR 8;
BA_ "GenSigSendType" SG_ 1387 ARC_OD_MaintenanceState_Obj_0008 8;
BA_ "GenSigSendType" SG_ 1387 ARC_OD_Width_Obj_53_FR 8;
BA_ "GenSigSendType" SG_ 1387 ARC_OD_RCS_Obj_53_FR 8;
BA_ "GenSigSendType" SG_ 1387 ARC_OD_Orientation_Obj_53_FR 8;
BA_ "GenSigSendType" SG_ 1387 ARC_OD_LifeCycle_Obj_53_FR 8;
BA_ "GenSigSendType" SG_ 1387 ARC_OD_ObstacleProb_Obj_52_FR 8;
BA_ "GenSigSendType" SG_ 1387 ARC_OD_ObstacleProb_Obj_53_FR 8;
BA_ "GenSigSendType" SG_ 1387 ARC_OD_VabsY_Obj_52_FR 8;
BA_ "GenSigSendType" SG_ 1387 ARC_OD_ID_52_FR 8;
BA_ "GenSigSendType" SG_ 1387 ARC_OD_ID_53_FR 8;
BA_ "GenSigSendType" SG_ 1387 ARC_OD_MsgCounter_Obj_52_53_FR 8;
BA_ "GenSigSendType" SG_ 1387 ARC_OD_CRC8_Obj_52_53_FR 8;
BA_ "GenSigSendType" SG_ 1387 ARC_OD_AabsY_Obj_52_FR 8;
BA_ "GenSigSendType" SG_ 1387 ARC_OD_DistXStd_Obj_52_FR 8;
BA_ "GenSigSendType" SG_ 1387 ARC_OD_DistYStd_Obj_52_FR 8;
BA_ "GenSigSendType" SG_ 1387 ARC_OD_VabsXStd_Obj_52_FR 8;
BA_ "GenSigSendType" SG_ 1387 ARC_OD_VabsYStd_Obj_52_FR 8;
BA_ "GenSigSendType" SG_ 1387 ARC_OD_AabsXStd_Obj_52_FR 8;
BA_ "GenSigSendType" SG_ 1386 DistHeight_Obj_51_FR 8;
BA_ "GenSigSendType" SG_ 1386 DistHeight_Obj_50_FR 8;
BA_ "GenSigSendType" SG_ 1386 ARC_OD_DistX_Obj_50_FR 8;
BA_ "GenSigSendType" SG_ 1386 ARC_OD_Classification_Obj_50_FR 8;
BA_ "GenSigSendType" SG_ 1386 ARC_OD_AabsYStd_Obj_50_FR 8;
BA_ "GenSigSendType" SG_ 1386 ARC_OD_ClassConf_Obj_50_FR 8;
BA_ "GenSigSendType" SG_ 1386 ARC_OD_ProbOfExist_Obj_50_FR 8;
BA_ "GenSigSendType" SG_ 1386 ARC_OD_VabsX_Obj_50_FR 8;
BA_ "GenSigSendType" SG_ 1386 ARC_OD_DynProp_Obj_50_FR 8;
BA_ "GenSigSendType" SG_ 1386 ARC_OD_Length_Obj_50_FR 8;
BA_ "GenSigSendType" SG_ 1386 ARC_OD_MaintenanceState_Obj_0009 8;
BA_ "GenSigSendType" SG_ 1386 ARC_OD_Width_Obj_50_FR 8;
BA_ "GenSigSendType" SG_ 1386 ARC_OD_RCS_Obj_50_FR 8;
BA_ "GenSigSendType" SG_ 1386 ARC_OD_Orientation_Obj_50_FR 8;
BA_ "GenSigSendType" SG_ 1386 ARC_OD_LifeCycle_Obj_50_FR 8;
BA_ "GenSigSendType" SG_ 1386 ARC_OD_DistX_Obj_51_FR 8;
BA_ "GenSigSendType" SG_ 1386 ARC_OD_VabsX_Obj_51_FR 8;
BA_ "GenSigSendType" SG_ 1386 ARC_OD_AabsX_Obj_51_FR 8;
BA_ "GenSigSendType" SG_ 1386 ARC_OD_AabsX_Obj_50_FR 8;
BA_ "GenSigSendType" SG_ 1386 ARC_OD_DistY_Obj_51_FR 8;
BA_ "GenSigSendType" SG_ 1386 ARC_OD_VabsY_Obj_51_FR 8;
BA_ "GenSigSendType" SG_ 1386 ARC_OD_AabsY_Obj_51_FR 8;
BA_ "GenSigSendType" SG_ 1386 ARC_OD_DistXStd_Obj_51_FR 8;
BA_ "GenSigSendType" SG_ 1386 ARC_OD_DistYStd_Obj_51_FR 8;
BA_ "GenSigSendType" SG_ 1386 ARC_OD_VabsXStd_Obj_51_FR 8;
BA_ "GenSigSendType" SG_ 1386 ARC_OD_VabsYStd_Obj_51_FR 8;
BA_ "GenSigSendType" SG_ 1386 ARC_OD_AabsXStd_Obj_51_FR 8;
BA_ "GenSigSendType" SG_ 1386 ARC_OD_Classification_Obj_51_FR 8;
BA_ "GenSigSendType" SG_ 1386 ARC_OD_AabsYStd_Obj_51_FR 8;
BA_ "GenSigSendType" SG_ 1386 ARC_OD_ClassConf_Obj_51_FR 8;
BA_ "GenSigSendType" SG_ 1386 ARC_OD_DistY_Obj_50_FR 8;
BA_ "GenSigSendType" SG_ 1386 ARC_OD_ProbOfExist_Obj_51_FR 8;
BA_ "GenSigSendType" SG_ 1386 ARC_OD_DynProp_Obj_51_FR 8;
BA_ "GenSigSendType" SG_ 1386 ARC_OD_Length_Obj_51_FR 8;
BA_ "GenSigSendType" SG_ 1386 ARC_OD_MaintenanceState_Obj_0010 8;
BA_ "GenSigSendType" SG_ 1386 ARC_OD_Width_Obj_51_FR 8;
BA_ "GenSigSendType" SG_ 1386 ARC_OD_RCS_Obj_51_FR 8;
BA_ "GenSigSendType" SG_ 1386 ARC_OD_Orientation_Obj_51_FR 8;
BA_ "GenSigSendType" SG_ 1386 ARC_OD_LifeCycle_Obj_51_FR 8;
BA_ "GenSigSendType" SG_ 1386 ARC_OD_ObstacleProb_Obj_50_FR 8;
BA_ "GenSigSendType" SG_ 1386 ARC_OD_ObstacleProb_Obj_51_FR 8;
BA_ "GenSigSendType" SG_ 1386 ARC_OD_VabsY_Obj_50_FR 8;
BA_ "GenSigSendType" SG_ 1386 ARC_OD_ID_50_FR 8;
BA_ "GenSigSendType" SG_ 1386 ARC_OD_ID_51_FR 8;
BA_ "GenSigSendType" SG_ 1386 ARC_OD_MsgCounter_Obj_50_51_FR 8;
BA_ "GenSigSendType" SG_ 1386 ARC_OD_CRC8_Obj_50_51_FR 8;
BA_ "GenSigSendType" SG_ 1386 ARC_OD_AabsY_Obj_50_FR 8;
BA_ "GenSigSendType" SG_ 1386 ARC_OD_DistXStd_Obj_50_FR 8;
BA_ "GenSigSendType" SG_ 1386 ARC_OD_DistYStd_Obj_50_FR 8;
BA_ "GenSigSendType" SG_ 1386 ARC_OD_VabsXStd_Obj_50_FR 8;
BA_ "GenSigSendType" SG_ 1386 ARC_OD_VabsYStd_Obj_50_FR 8;
BA_ "GenSigSendType" SG_ 1386 ARC_OD_AabsXStd_Obj_50_FR 8;
BA_ "GenSigSendType" SG_ 1385 DistHeight_Obj_49_FR 8;
BA_ "GenSigSendType" SG_ 1385 DistHeight_Obj_48_FR 8;
BA_ "GenSigSendType" SG_ 1385 ARC_OD_DistX_Obj_48_FR 8;
BA_ "GenSigSendType" SG_ 1385 ARC_OD_Classification_Obj_48_FR 8;
BA_ "GenSigSendType" SG_ 1385 ARC_OD_AabsYStd_Obj_48_FR 8;
BA_ "GenSigSendType" SG_ 1385 ARC_OD_ClassConf_Obj_48_FR 8;
BA_ "GenSigSendType" SG_ 1385 ARC_OD_ProbOfExist_Obj_48_FR 8;
BA_ "GenSigSendType" SG_ 1385 ARC_OD_VabsX_Obj_48_FR 8;
BA_ "GenSigSendType" SG_ 1385 ARC_OD_DynProp_Obj_48_FR 8;
BA_ "GenSigSendType" SG_ 1385 ARC_OD_Length_Obj_48_FR 8;
BA_ "GenSigSendType" SG_ 1385 ARC_OD_MaintenanceState_Obj_0011 8;
BA_ "GenSigSendType" SG_ 1385 ARC_OD_Width_Obj_48_FR 8;
BA_ "GenSigSendType" SG_ 1385 ARC_OD_RCS_Obj_48_FR 8;
BA_ "GenSigSendType" SG_ 1385 ARC_OD_Orientation_Obj_48_FR 8;
BA_ "GenSigSendType" SG_ 1385 ARC_OD_LifeCycle_Obj_48_FR 8;
BA_ "GenSigSendType" SG_ 1385 ARC_OD_DistX_Obj_49_FR 8;
BA_ "GenSigSendType" SG_ 1385 ARC_OD_VabsX_Obj_49_FR 8;
BA_ "GenSigSendType" SG_ 1385 ARC_OD_AabsX_Obj_49_FR 8;
BA_ "GenSigSendType" SG_ 1385 ARC_OD_AabsX_Obj_48_FR 8;
BA_ "GenSigSendType" SG_ 1385 ARC_OD_DistY_Obj_49_FR 8;
BA_ "GenSigSendType" SG_ 1385 ARC_OD_VabsY_Obj_49_FR 8;
BA_ "GenSigSendType" SG_ 1385 ARC_OD_AabsY_Obj_49_FR 8;
BA_ "GenSigSendType" SG_ 1385 ARC_OD_DistXStd_Obj_49_FR 8;
BA_ "GenSigSendType" SG_ 1385 ARC_OD_DistYStd_Obj_49_FR 8;
BA_ "GenSigSendType" SG_ 1385 ARC_OD_VabsXStd_Obj_49_FR 8;
BA_ "GenSigSendType" SG_ 1385 ARC_OD_VabsYStd_Obj_49_FR 8;
BA_ "GenSigSendType" SG_ 1385 ARC_OD_AabsXStd_Obj_49_FR 8;
BA_ "GenSigSendType" SG_ 1385 ARC_OD_Classification_Obj_49_FR 8;
BA_ "GenSigSendType" SG_ 1385 ARC_OD_AabsYStd_Obj_49_FR 8;
BA_ "GenSigSendType" SG_ 1385 ARC_OD_ClassConf_Obj_49_FR 8;
BA_ "GenSigSendType" SG_ 1385 ARC_OD_DistY_Obj_48_FR 8;
BA_ "GenSigSendType" SG_ 1385 ARC_OD_ProbOfExist_Obj_49_FR 8;
BA_ "GenSigSendType" SG_ 1385 ARC_OD_DynProp_Obj_49_FR 8;
BA_ "GenSigSendType" SG_ 1385 ARC_OD_Length_Obj_49_FR 8;
BA_ "GenSigSendType" SG_ 1385 ARC_OD_MaintenanceState_Obj_0012 8;
BA_ "GenSigSendType" SG_ 1385 ARC_OD_Width_Obj_49_FR 8;
BA_ "GenSigSendType" SG_ 1385 ARC_OD_RCS_Obj_49_FR 8;
BA_ "GenSigSendType" SG_ 1385 ARC_OD_Orientation_Obj_49_FR 8;
BA_ "GenSigSendType" SG_ 1385 ARC_OD_LifeCycle_Obj_49_FR 8;
BA_ "GenSigSendType" SG_ 1385 ARC_OD_ObstacleProb_Obj_48_FR 8;
BA_ "GenSigSendType" SG_ 1385 ARC_OD_ObstacleProb_Obj_49_FR 8;
BA_ "GenSigSendType" SG_ 1385 ARC_OD_VabsY_Obj_48_FR 8;
BA_ "GenSigSendType" SG_ 1385 ARC_OD_ID_48_FR 8;
BA_ "GenSigSendType" SG_ 1385 ARC_OD_ID_49_FR 8;
BA_ "GenSigSendType" SG_ 1385 ARC_OD_MsgCounter_Obj_48_49_FR 8;
BA_ "GenSigSendType" SG_ 1385 ARC_OD_CRC8_Obj_48_49_FR 8;
BA_ "GenSigSendType" SG_ 1385 ARC_OD_AabsY_Obj_48_FR 8;
BA_ "GenSigSendType" SG_ 1385 ARC_OD_DistXStd_Obj_48_FR 8;
BA_ "GenSigSendType" SG_ 1385 ARC_OD_DistYStd_Obj_48_FR 8;
BA_ "GenSigSendType" SG_ 1385 ARC_OD_VabsXStd_Obj_48_FR 8;
BA_ "GenSigSendType" SG_ 1385 ARC_OD_VabsYStd_Obj_48_FR 8;
BA_ "GenSigSendType" SG_ 1385 ARC_OD_AabsXStd_Obj_48_FR 8;
BA_ "GenSigSendType" SG_ 1384 DistHeight_Obj_47_FR 8;
BA_ "GenSigSendType" SG_ 1384 DistHeight_Obj_46_FR 8;
BA_ "GenSigSendType" SG_ 1384 ARC_OD_DistX_Obj_46_FR 8;
BA_ "GenSigSendType" SG_ 1384 ARC_OD_Classification_Obj_46_FR 8;
BA_ "GenSigSendType" SG_ 1384 ARC_OD_AabsYStd_Obj_46_FR 8;
BA_ "GenSigSendType" SG_ 1384 ARC_OD_ClassConf_Obj_46_FR 8;
BA_ "GenSigSendType" SG_ 1384 ARC_OD_ProbOfExist_Obj_46_FR 8;
BA_ "GenSigSendType" SG_ 1384 ARC_OD_VabsX_Obj_46_FR 8;
BA_ "GenSigSendType" SG_ 1384 ARC_OD_DynProp_Obj_46_FR 8;
BA_ "GenSigSendType" SG_ 1384 ARC_OD_Length_Obj_46_FR 8;
BA_ "GenSigSendType" SG_ 1384 ARC_OD_MaintenanceState_Obj_0013 8;
BA_ "GenSigSendType" SG_ 1384 ARC_OD_Width_Obj_46_FR 8;
BA_ "GenSigSendType" SG_ 1384 ARC_OD_RCS_Obj_46_FR 8;
BA_ "GenSigSendType" SG_ 1384 ARC_OD_Orientation_Obj_46_FR 8;
BA_ "GenSigSendType" SG_ 1384 ARC_OD_LifeCycle_Obj_46_FR 8;
BA_ "GenSigSendType" SG_ 1384 ARC_OD_DistX_Obj_47_FR 8;
BA_ "GenSigSendType" SG_ 1384 ARC_OD_VabsX_Obj_47_FR 8;
BA_ "GenSigSendType" SG_ 1384 ARC_OD_AabsX_Obj_47_FR 8;
BA_ "GenSigSendType" SG_ 1384 ARC_OD_AabsX_Obj_46_FR 8;
BA_ "GenSigSendType" SG_ 1384 ARC_OD_DistY_Obj_47_FR 8;
BA_ "GenSigSendType" SG_ 1384 ARC_OD_VabsY_Obj_47_FR 8;
BA_ "GenSigSendType" SG_ 1384 ARC_OD_AabsY_Obj_47_FR 8;
BA_ "GenSigSendType" SG_ 1384 ARC_OD_DistXStd_Obj_47_FR 8;
BA_ "GenSigSendType" SG_ 1384 ARC_OD_DistYStd_Obj_47_FR 8;
BA_ "GenSigSendType" SG_ 1384 ARC_OD_VabsXStd_Obj_47_FR 8;
BA_ "GenSigSendType" SG_ 1384 ARC_OD_VabsYStd_Obj_47_FR 8;
BA_ "GenSigSendType" SG_ 1384 ARC_OD_AabsXStd_Obj_47_FR 8;
BA_ "GenSigSendType" SG_ 1384 ARC_OD_Classification_Obj_47_FR 8;
BA_ "GenSigSendType" SG_ 1384 ARC_OD_AabsYStd_Obj_47_FR 8;
BA_ "GenSigSendType" SG_ 1384 ARC_OD_ClassConf_Obj_47_FR 8;
BA_ "GenSigSendType" SG_ 1384 ARC_OD_DistY_Obj_46_FR 8;
BA_ "GenSigSendType" SG_ 1384 ARC_OD_ProbOfExist_Obj_47_FR 8;
BA_ "GenSigSendType" SG_ 1384 ARC_OD_DynProp_Obj_47_FR 8;
BA_ "GenSigSendType" SG_ 1384 ARC_OD_Length_Obj_47_FR 8;
BA_ "GenSigSendType" SG_ 1384 ARC_OD_MaintenanceState_Obj_0014 8;
BA_ "GenSigSendType" SG_ 1384 ARC_OD_Width_Obj_47_FR 8;
BA_ "GenSigSendType" SG_ 1384 ARC_OD_RCS_Obj_47_FR 8;
BA_ "GenSigSendType" SG_ 1384 ARC_OD_Orientation_Obj_47_FR 8;
BA_ "GenSigSendType" SG_ 1384 ARC_OD_LifeCycle_Obj_47_FR 8;
BA_ "GenSigSendType" SG_ 1384 ARC_OD_ObstacleProb_Obj_46_FR 8;
BA_ "GenSigSendType" SG_ 1384 ARC_OD_ObstacleProb_Obj_47_FR 8;
BA_ "GenSigSendType" SG_ 1384 ARC_OD_VabsY_Obj_46_FR 8;
BA_ "GenSigSendType" SG_ 1384 ARC_OD_ID_46_FR 8;
BA_ "GenSigSendType" SG_ 1384 ARC_OD_ID_47_FR 8;
BA_ "GenSigSendType" SG_ 1384 ARC_OD_MsgCounter_Obj_46_47_FR 8;
BA_ "GenSigSendType" SG_ 1384 ARC_OD_CRC8_Obj_46_47_FR 8;
BA_ "GenSigSendType" SG_ 1384 ARC_OD_AabsY_Obj_46_FR 8;
BA_ "GenSigSendType" SG_ 1384 ARC_OD_DistXStd_Obj_46_FR 8;
BA_ "GenSigSendType" SG_ 1384 ARC_OD_DistYStd_Obj_46_FR 8;
BA_ "GenSigSendType" SG_ 1384 ARC_OD_VabsXStd_Obj_46_FR 8;
BA_ "GenSigSendType" SG_ 1384 ARC_OD_VabsYStd_Obj_46_FR 8;
BA_ "GenSigSendType" SG_ 1384 ARC_OD_AabsXStd_Obj_46_FR 8;
BA_ "GenSigSendType" SG_ 1383 DistHeight_Obj_45_FR 8;
BA_ "GenSigSendType" SG_ 1383 DistHeight_Obj_44_FR 8;
BA_ "GenSigSendType" SG_ 1383 ARC_OD_DistX_Obj_44_FR 8;
BA_ "GenSigSendType" SG_ 1383 ARC_OD_Classification_Obj_44_FR 8;
BA_ "GenSigSendType" SG_ 1383 ARC_OD_AabsYStd_Obj_44_FR 8;
BA_ "GenSigSendType" SG_ 1383 ARC_OD_ClassConf_Obj_44_FR 8;
BA_ "GenSigSendType" SG_ 1383 ARC_OD_ProbOfExist_Obj_44_FR 8;
BA_ "GenSigSendType" SG_ 1383 ARC_OD_VabsX_Obj_44_FR 8;
BA_ "GenSigSendType" SG_ 1383 ARC_OD_DynProp_Obj_44_FR 8;
BA_ "GenSigSendType" SG_ 1383 ARC_OD_Length_Obj_44_FR 8;
BA_ "GenSigSendType" SG_ 1383 ARC_OD_MaintenanceState_Obj_0015 8;
BA_ "GenSigSendType" SG_ 1383 ARC_OD_Width_Obj_44_FR 8;
BA_ "GenSigSendType" SG_ 1383 ARC_OD_RCS_Obj_44_FR 8;
BA_ "GenSigSendType" SG_ 1383 ARC_OD_Orientation_Obj_44_FR 8;
BA_ "GenSigSendType" SG_ 1383 ARC_OD_LifeCycle_Obj_44_FR 8;
BA_ "GenSigSendType" SG_ 1383 ARC_OD_DistX_Obj_45_FR 8;
BA_ "GenSigSendType" SG_ 1383 ARC_OD_VabsX_Obj_45_FR 8;
BA_ "GenSigSendType" SG_ 1383 ARC_OD_AabsX_Obj_45_FR 8;
BA_ "GenSigSendType" SG_ 1383 ARC_OD_AabsX_Obj_44_FR 8;
BA_ "GenSigSendType" SG_ 1383 ARC_OD_DistY_Obj_45_FR 8;
BA_ "GenSigSendType" SG_ 1383 ARC_OD_VabsY_Obj_45_FR 8;
BA_ "GenSigSendType" SG_ 1383 ARC_OD_AabsY_Obj_45_FR 8;
BA_ "GenSigSendType" SG_ 1383 ARC_OD_DistXStd_Obj_45_FR 8;
BA_ "GenSigSendType" SG_ 1383 ARC_OD_DistYStd_Obj_45_FR 8;
BA_ "GenSigSendType" SG_ 1383 ARC_OD_VabsXStd_Obj_45_FR 8;
BA_ "GenSigSendType" SG_ 1383 ARC_OD_VabsYStd_Obj_45_FR 8;
BA_ "GenSigSendType" SG_ 1383 ARC_OD_AabsXStd_Obj_45_FR 8;
BA_ "GenSigSendType" SG_ 1383 ARC_OD_Classification_Obj_45_FR 8;
BA_ "GenSigSendType" SG_ 1383 ARC_OD_AabsYStd_Obj_45_FR 8;
BA_ "GenSigSendType" SG_ 1383 ARC_OD_ClassConf_Obj_45_FR 8;
BA_ "GenSigSendType" SG_ 1383 ARC_OD_DistY_Obj_44_FR 8;
BA_ "GenSigSendType" SG_ 1383 ARC_OD_ProbOfExist_Obj_45_FR 8;
BA_ "GenSigSendType" SG_ 1383 ARC_OD_DynProp_Obj_45_FR 8;
BA_ "GenSigSendType" SG_ 1383 ARC_OD_Length_Obj_45_FR 8;
BA_ "GenSigSendType" SG_ 1383 ARC_OD_MaintenanceState_Obj_0016 8;
BA_ "GenSigSendType" SG_ 1383 ARC_OD_Width_Obj_45_FR 8;
BA_ "GenSigSendType" SG_ 1383 ARC_OD_RCS_Obj_45_FR 8;
BA_ "GenSigSendType" SG_ 1383 ARC_OD_Orientation_Obj_45_FR 8;
BA_ "GenSigSendType" SG_ 1383 ARC_OD_LifeCycle_Obj_45_FR 8;
BA_ "GenSigSendType" SG_ 1383 ARC_OD_ObstacleProb_Obj_44_FR 8;
BA_ "GenSigSendType" SG_ 1383 ARC_OD_ObstacleProb_Obj_45_FR 8;
BA_ "GenSigSendType" SG_ 1383 ARC_OD_VabsY_Obj_44_FR 8;
BA_ "GenSigSendType" SG_ 1383 ARC_OD_ID_44_FR 8;
BA_ "GenSigSendType" SG_ 1383 ARC_OD_ID_45_FR 8;
BA_ "GenSigSendType" SG_ 1383 ARC_OD_MsgCounter_Obj_44_45_FR 8;
BA_ "GenSigSendType" SG_ 1383 ARC_OD_CRC8_Obj_44_45_FR 8;
BA_ "GenSigSendType" SG_ 1383 ARC_OD_AabsY_Obj_44_FR 8;
BA_ "GenSigSendType" SG_ 1383 ARC_OD_DistXStd_Obj_44_FR 8;
BA_ "GenSigSendType" SG_ 1383 ARC_OD_DistYStd_Obj_44_FR 8;
BA_ "GenSigSendType" SG_ 1383 ARC_OD_VabsXStd_Obj_44_FR 8;
BA_ "GenSigSendType" SG_ 1383 ARC_OD_VabsYStd_Obj_44_FR 8;
BA_ "GenSigSendType" SG_ 1383 ARC_OD_AabsXStd_Obj_44_FR 8;
BA_ "GenSigSendType" SG_ 1382 DistHeight_Obj_43_FR 8;
BA_ "GenSigSendType" SG_ 1382 DistHeight_Obj_42_FR 8;
BA_ "GenSigSendType" SG_ 1382 ARC_OD_DistX_Obj_42_FR 8;
BA_ "GenSigSendType" SG_ 1382 ARC_OD_Classification_Obj_42_FR 8;
BA_ "GenSigSendType" SG_ 1382 ARC_OD_AabsYStd_Obj_42_FR 8;
BA_ "GenSigSendType" SG_ 1382 ARC_OD_ClassConf_Obj_42_FR 8;
BA_ "GenSigSendType" SG_ 1382 ARC_OD_ProbOfExist_Obj_42_FR 8;
BA_ "GenSigSendType" SG_ 1382 ARC_OD_VabsX_Obj_42_FR 8;
BA_ "GenSigSendType" SG_ 1382 ARC_OD_DynProp_Obj_42_FR 8;
BA_ "GenSigSendType" SG_ 1382 ARC_OD_Length_Obj_42_FR 8;
BA_ "GenSigSendType" SG_ 1382 ARC_OD_MaintenanceState_Obj_0017 8;
BA_ "GenSigSendType" SG_ 1382 ARC_OD_Width_Obj_42_FR 8;
BA_ "GenSigSendType" SG_ 1382 ARC_OD_RCS_Obj_42_FR 8;
BA_ "GenSigSendType" SG_ 1382 ARC_OD_Orientation_Obj_42_FR 8;
BA_ "GenSigSendType" SG_ 1382 ARC_OD_LifeCycle_Obj_42_FR 8;
BA_ "GenSigSendType" SG_ 1382 ARC_OD_DistX_Obj_43_FR 8;
BA_ "GenSigSendType" SG_ 1382 ARC_OD_VabsX_Obj_43_FR 8;
BA_ "GenSigSendType" SG_ 1382 ARC_OD_AabsX_Obj_43_FR 8;
BA_ "GenSigSendType" SG_ 1382 ARC_OD_AabsX_Obj_42_FR 8;
BA_ "GenSigSendType" SG_ 1382 ARC_OD_DistY_Obj_43_FR 8;
BA_ "GenSigSendType" SG_ 1382 ARC_OD_VabsY_Obj_43_FR 8;
BA_ "GenSigSendType" SG_ 1382 ARC_OD_AabsY_Obj_43_FR 8;
BA_ "GenSigSendType" SG_ 1382 ARC_OD_DistXStd_Obj_43_FR 8;
BA_ "GenSigSendType" SG_ 1382 ARC_OD_DistYStd_Obj_43_FR 8;
BA_ "GenSigSendType" SG_ 1382 ARC_OD_VabsXStd_Obj_43_FR 8;
BA_ "GenSigSendType" SG_ 1382 ARC_OD_VabsYStd_Obj_43_FR 8;
BA_ "GenSigSendType" SG_ 1382 ARC_OD_AabsXStd_Obj_43_FR 8;
BA_ "GenSigSendType" SG_ 1382 ARC_OD_Classification_Obj_43_FR 8;
BA_ "GenSigSendType" SG_ 1382 ARC_OD_AabsYStd_Obj_43_FR 8;
BA_ "GenSigSendType" SG_ 1382 ARC_OD_ClassConf_Obj_43_FR 8;
BA_ "GenSigSendType" SG_ 1382 ARC_OD_DistY_Obj_42_FR 8;
BA_ "GenSigSendType" SG_ 1382 ARC_OD_ProbOfExist_Obj_43_FR 8;
BA_ "GenSigSendType" SG_ 1382 ARC_OD_DynProp_Obj_43_FR 8;
BA_ "GenSigSendType" SG_ 1382 ARC_OD_Length_Obj_43_FR 8;
BA_ "GenSigSendType" SG_ 1382 ARC_OD_MaintenanceState_Obj_0018 8;
BA_ "GenSigSendType" SG_ 1382 ARC_OD_Width_Obj_43_FR 8;
BA_ "GenSigSendType" SG_ 1382 ARC_OD_RCS_Obj_43_FR 8;
BA_ "GenSigSendType" SG_ 1382 ARC_OD_Orientation_Obj_43_FR 8;
BA_ "GenSigSendType" SG_ 1382 ARC_OD_LifeCycle_Obj_43_FR 8;
BA_ "GenSigSendType" SG_ 1382 ARC_OD_ObstacleProb_Obj_42_FR 8;
BA_ "GenSigSendType" SG_ 1382 ARC_OD_ObstacleProb_Obj_43_FR 8;
BA_ "GenSigSendType" SG_ 1382 ARC_OD_VabsY_Obj_42_FR 8;
BA_ "GenSigSendType" SG_ 1382 ARC_OD_ID_42_FR 8;
BA_ "GenSigSendType" SG_ 1382 ARC_OD_ID_43_FR 8;
BA_ "GenSigSendType" SG_ 1382 ARC_OD_MsgCounter_Obj_42_43_FR 8;
BA_ "GenSigSendType" SG_ 1382 ARC_OD_CRC8_Obj_42_43_FR 8;
BA_ "GenSigSendType" SG_ 1382 ARC_OD_AabsY_Obj_42_FR 8;
BA_ "GenSigSendType" SG_ 1382 ARC_OD_DistXStd_Obj_42_FR 8;
BA_ "GenSigSendType" SG_ 1382 ARC_OD_DistYStd_Obj_42_FR 8;
BA_ "GenSigSendType" SG_ 1382 ARC_OD_VabsXStd_Obj_42_FR 8;
BA_ "GenSigSendType" SG_ 1382 ARC_OD_VabsYStd_Obj_42_FR 8;
BA_ "GenSigSendType" SG_ 1382 ARC_OD_AabsXStd_Obj_42_FR 8;
BA_ "GenSigSendType" SG_ 1381 DistHeight_Obj_41_FR 8;
BA_ "GenSigSendType" SG_ 1381 DistHeight_Obj_40_FR 8;
BA_ "GenSigSendType" SG_ 1381 ARC_OD_DistX_Obj_40_FR 8;
BA_ "GenSigSendType" SG_ 1381 ARC_OD_Classification_Obj_40_FR 8;
BA_ "GenSigSendType" SG_ 1381 ARC_OD_AabsYStd_Obj_40_FR 8;
BA_ "GenSigSendType" SG_ 1381 ARC_OD_ClassConf_Obj_40_FR 8;
BA_ "GenSigSendType" SG_ 1381 ARC_OD_ProbOfExist_Obj_40_FR 8;
BA_ "GenSigSendType" SG_ 1381 ARC_OD_VabsX_Obj_40_FR 8;
BA_ "GenSigSendType" SG_ 1381 ARC_OD_DynProp_Obj_40_FR 8;
BA_ "GenSigSendType" SG_ 1381 ARC_OD_Length_Obj_40_FR 8;
BA_ "GenSigSendType" SG_ 1381 ARC_OD_MaintenanceState_Obj_0019 8;
BA_ "GenSigSendType" SG_ 1381 ARC_OD_Width_Obj_40_FR 8;
BA_ "GenSigSendType" SG_ 1381 ARC_OD_RCS_Obj_40_FR 8;
BA_ "GenSigSendType" SG_ 1381 ARC_OD_Orientation_Obj_40_FR 8;
BA_ "GenSigSendType" SG_ 1381 ARC_OD_LifeCycle_Obj_40_FR 8;
BA_ "GenSigSendType" SG_ 1381 ARC_OD_DistX_Obj_41_FR 8;
BA_ "GenSigSendType" SG_ 1381 ARC_OD_VabsX_Obj_41_FR 8;
BA_ "GenSigSendType" SG_ 1381 ARC_OD_AabsX_Obj_41_FR 8;
BA_ "GenSigSendType" SG_ 1381 ARC_OD_AabsX_Obj_40_FR 8;
BA_ "GenSigSendType" SG_ 1381 ARC_OD_DistY_Obj_41_FR 8;
BA_ "GenSigSendType" SG_ 1381 ARC_OD_VabsY_Obj_41_FR 8;
BA_ "GenSigSendType" SG_ 1381 ARC_OD_AabsY_Obj_41_FR 8;
BA_ "GenSigSendType" SG_ 1381 ARC_OD_DistXStd_Obj_41_FR 8;
BA_ "GenSigSendType" SG_ 1381 ARC_OD_DistYStd_Obj_41_FR 8;
BA_ "GenSigSendType" SG_ 1381 ARC_OD_VabsXStd_Obj_41_FR 8;
BA_ "GenSigSendType" SG_ 1381 ARC_OD_VabsYStd_Obj_41_FR 8;
BA_ "GenSigSendType" SG_ 1381 ARC_OD_AabsXStd_Obj_41_FR 8;
BA_ "GenSigSendType" SG_ 1381 ARC_OD_Classification_Obj_41_FR 8;
BA_ "GenSigSendType" SG_ 1381 ARC_OD_AabsYStd_Obj_41_FR 8;
BA_ "GenSigSendType" SG_ 1381 ARC_OD_ClassConf_Obj_41_FR 8;
BA_ "GenSigSendType" SG_ 1381 ARC_OD_DistY_Obj_40_FR 8;
BA_ "GenSigSendType" SG_ 1381 ARC_OD_ProbOfExist_Obj_41_FR 8;
BA_ "GenSigSendType" SG_ 1381 ARC_OD_DynProp_Obj_41_FR 8;
BA_ "GenSigSendType" SG_ 1381 ARC_OD_Length_Obj_41_FR 8;
BA_ "GenSigSendType" SG_ 1381 ARC_OD_MaintenanceState_Obj_0020 8;
BA_ "GenSigSendType" SG_ 1381 ARC_OD_Width_Obj_41_FR 8;
BA_ "GenSigSendType" SG_ 1381 ARC_OD_RCS_Obj_41_FR 8;
BA_ "GenSigSendType" SG_ 1381 ARC_OD_Orientation_Obj_41_FR 8;
BA_ "GenSigSendType" SG_ 1381 ARC_OD_LifeCycle_Obj_41_FR 8;
BA_ "GenSigSendType" SG_ 1381 ARC_OD_ObstacleProb_Obj_40_FR 8;
BA_ "GenSigSendType" SG_ 1381 ARC_OD_ObstacleProb_Obj_41_FR 8;
BA_ "GenSigSendType" SG_ 1381 ARC_OD_VabsY_Obj_40_FR 8;
BA_ "GenSigSendType" SG_ 1381 ARC_OD_ID_40_FR 8;
BA_ "GenSigSendType" SG_ 1381 ARC_OD_ID_41_FR 8;
BA_ "GenSigSendType" SG_ 1381 ARC_OD_MsgCounter_Obj_40_41_FR 8;
BA_ "GenSigSendType" SG_ 1381 ARC_OD_CRC8_Obj_40_41_FR 8;
BA_ "GenSigSendType" SG_ 1381 ARC_OD_AabsY_Obj_40_FR 8;
BA_ "GenSigSendType" SG_ 1381 ARC_OD_DistXStd_Obj_40_FR 8;
BA_ "GenSigSendType" SG_ 1381 ARC_OD_DistYStd_Obj_40_FR 8;
BA_ "GenSigSendType" SG_ 1381 ARC_OD_VabsXStd_Obj_40_FR 8;
BA_ "GenSigSendType" SG_ 1381 ARC_OD_VabsYStd_Obj_40_FR 8;
BA_ "GenSigSendType" SG_ 1381 ARC_OD_AabsXStd_Obj_40_FR 8;
BA_ "GenSigSendType" SG_ 1380 DistHeight_Obj_39_FR 8;
BA_ "GenSigSendType" SG_ 1380 DistHeight_Obj_38_FR 8;
BA_ "GenSigSendType" SG_ 1380 ARC_OD_DistX_Obj_38_FR 8;
BA_ "GenSigSendType" SG_ 1380 ARC_OD_Classification_Obj_38_FR 8;
BA_ "GenSigSendType" SG_ 1380 ARC_OD_AabsYStd_Obj_38_FR 8;
BA_ "GenSigSendType" SG_ 1380 ARC_OD_ClassConf_Obj_38_FR 8;
BA_ "GenSigSendType" SG_ 1380 ARC_OD_ProbOfExist_Obj_38_FR 8;
BA_ "GenSigSendType" SG_ 1380 ARC_OD_VabsX_Obj_38_FR 8;
BA_ "GenSigSendType" SG_ 1380 ARC_OD_DynProp_Obj_38_FR 8;
BA_ "GenSigSendType" SG_ 1380 ARC_OD_Length_Obj_38_FR 8;
BA_ "GenSigSendType" SG_ 1380 ARC_OD_MaintenanceState_Obj_0021 8;
BA_ "GenSigSendType" SG_ 1380 ARC_OD_Width_Obj_38_FR 8;
BA_ "GenSigSendType" SG_ 1380 ARC_OD_RCS_Obj_38_FR 8;
BA_ "GenSigSendType" SG_ 1380 ARC_OD_Orientation_Obj_38_FR 8;
BA_ "GenSigSendType" SG_ 1380 ARC_OD_LifeCycle_Obj_38_FR 8;
BA_ "GenSigSendType" SG_ 1380 ARC_OD_DistX_Obj_39_FR 8;
BA_ "GenSigSendType" SG_ 1380 ARC_OD_VabsX_Obj_39_FR 8;
BA_ "GenSigSendType" SG_ 1380 ARC_OD_AabsX_Obj_39_FR 8;
BA_ "GenSigSendType" SG_ 1380 ARC_OD_AabsX_Obj_38_FR 8;
BA_ "GenSigSendType" SG_ 1380 ARC_OD_DistY_Obj_39_FR 8;
BA_ "GenSigSendType" SG_ 1380 ARC_OD_VabsY_Obj_39_FR 8;
BA_ "GenSigSendType" SG_ 1380 ARC_OD_AabsY_Obj_39_FR 8;
BA_ "GenSigSendType" SG_ 1380 ARC_OD_DistXStd_Obj_39_FR 8;
BA_ "GenSigSendType" SG_ 1380 ARC_OD_DistYStd_Obj_39_FR 8;
BA_ "GenSigSendType" SG_ 1380 ARC_OD_VabsXStd_Obj_39_FR 8;
BA_ "GenSigSendType" SG_ 1380 ARC_OD_VabsYStd_Obj_39_FR 8;
BA_ "GenSigSendType" SG_ 1380 ARC_OD_AabsXStd_Obj_39_FR 8;
BA_ "GenSigSendType" SG_ 1380 ARC_OD_Classification_Obj_39_FR 8;
BA_ "GenSigSendType" SG_ 1380 ARC_OD_AabsYStd_Obj_39_FR 8;
BA_ "GenSigSendType" SG_ 1380 ARC_OD_ClassConf_Obj_39_FR 8;
BA_ "GenSigSendType" SG_ 1380 ARC_OD_DistY_Obj_38_FR 8;
BA_ "GenSigSendType" SG_ 1380 ARC_OD_ProbOfExist_Obj_39_FR 8;
BA_ "GenSigSendType" SG_ 1380 ARC_OD_DynProp_Obj_39_FR 8;
BA_ "GenSigSendType" SG_ 1380 ARC_OD_Length_Obj_39_FR 8;
BA_ "GenSigSendType" SG_ 1380 ARC_OD_MaintenanceState_Obj_0022 8;
BA_ "GenSigSendType" SG_ 1380 ARC_OD_Width_Obj_39_FR 8;
BA_ "GenSigSendType" SG_ 1380 ARC_OD_RCS_Obj_39_FR 8;
BA_ "GenSigSendType" SG_ 1380 ARC_OD_Orientation_Obj_39_FR 8;
BA_ "GenSigSendType" SG_ 1380 ARC_OD_LifeCycle_Obj_39_FR 8;
BA_ "GenSigSendType" SG_ 1380 ARC_OD_ObstacleProb_Obj_38_FR 8;
BA_ "GenSigSendType" SG_ 1380 ARC_OD_ObstacleProb_Obj_39_FR 8;
BA_ "GenSigSendType" SG_ 1380 ARC_OD_VabsY_Obj_38_FR 8;
BA_ "GenSigSendType" SG_ 1380 ARC_OD_ID_38_FR 8;
BA_ "GenSigSendType" SG_ 1380 ARC_OD_ID_39_FR 8;
BA_ "GenSigSendType" SG_ 1380 ARC_OD_MsgCounter_Obj_38_39_FR 8;
BA_ "GenSigSendType" SG_ 1380 ARC_OD_CRC8_Obj_38_39_FR 8;
BA_ "GenSigSendType" SG_ 1380 ARC_OD_AabsY_Obj_38_FR 8;
BA_ "GenSigSendType" SG_ 1380 ARC_OD_DistXStd_Obj_38_FR 8;
BA_ "GenSigSendType" SG_ 1380 ARC_OD_DistYStd_Obj_38_FR 8;
BA_ "GenSigSendType" SG_ 1380 ARC_OD_VabsXStd_Obj_38_FR 8;
BA_ "GenSigSendType" SG_ 1380 ARC_OD_VabsYStd_Obj_38_FR 8;
BA_ "GenSigSendType" SG_ 1380 ARC_OD_AabsXStd_Obj_38_FR 8;
BA_ "GenSigSendType" SG_ 1379 DistHeight_Obj_37_FR 8;
BA_ "GenSigSendType" SG_ 1379 DistHeight_Obj_36_FR 8;
BA_ "GenSigSendType" SG_ 1379 ARC_OD_DistX_Obj_36_FR 8;
BA_ "GenSigSendType" SG_ 1379 ARC_OD_Classification_Obj_36_FR 8;
BA_ "GenSigSendType" SG_ 1379 ARC_OD_AabsYStd_Obj_36_FR 8;
BA_ "GenSigSendType" SG_ 1379 ARC_OD_ClassConf_Obj_36_FR 8;
BA_ "GenSigSendType" SG_ 1379 ARC_OD_ProbOfExist_Obj_36_FR 8;
BA_ "GenSigSendType" SG_ 1379 ARC_OD_VabsX_Obj_36_FR 8;
BA_ "GenSigSendType" SG_ 1379 ARC_OD_DynProp_Obj_36_FR 8;
BA_ "GenSigSendType" SG_ 1379 ARC_OD_Length_Obj_36_FR 8;
BA_ "GenSigSendType" SG_ 1379 ARC_OD_MaintenanceState_Obj_0023 8;
BA_ "GenSigSendType" SG_ 1379 ARC_OD_Width_Obj_36_FR 8;
BA_ "GenSigSendType" SG_ 1379 ARC_OD_RCS_Obj_36_FR 8;
BA_ "GenSigSendType" SG_ 1379 ARC_OD_Orientation_Obj_36_FR 8;
BA_ "GenSigSendType" SG_ 1379 ARC_OD_LifeCycle_Obj_36_FR 8;
BA_ "GenSigSendType" SG_ 1379 ARC_OD_DistX_Obj_37_FR 8;
BA_ "GenSigSendType" SG_ 1379 ARC_OD_VabsX_Obj_37_FR 8;
BA_ "GenSigSendType" SG_ 1379 ARC_OD_AabsX_Obj_37_FR 8;
BA_ "GenSigSendType" SG_ 1379 ARC_OD_AabsX_Obj_36_FR 8;
BA_ "GenSigSendType" SG_ 1379 ARC_OD_DistY_Obj_37_FR 8;
BA_ "GenSigSendType" SG_ 1379 ARC_OD_VabsY_Obj_37_FR 8;
BA_ "GenSigSendType" SG_ 1379 ARC_OD_AabsY_Obj_37_FR 8;
BA_ "GenSigSendType" SG_ 1379 ARC_OD_DistXStd_Obj_37_FR 8;
BA_ "GenSigSendType" SG_ 1379 ARC_OD_DistYStd_Obj_37_FR 8;
BA_ "GenSigSendType" SG_ 1379 ARC_OD_VabsXStd_Obj_37_FR 8;
BA_ "GenSigSendType" SG_ 1379 ARC_OD_VabsYStd_Obj_37_FR 8;
BA_ "GenSigSendType" SG_ 1379 ARC_OD_AabsXStd_Obj_37_FR 8;
BA_ "GenSigSendType" SG_ 1379 ARC_OD_Classification_Obj_37_FR 8;
BA_ "GenSigSendType" SG_ 1379 ARC_OD_AabsYStd_Obj_37_FR 8;
BA_ "GenSigSendType" SG_ 1379 ARC_OD_ClassConf_Obj_37_FR 8;
BA_ "GenSigSendType" SG_ 1379 ARC_OD_DistY_Obj_36_FR 8;
BA_ "GenSigSendType" SG_ 1379 ARC_OD_ProbOfExist_Obj_37_FR 8;
BA_ "GenSigSendType" SG_ 1379 ARC_OD_DynProp_Obj_37_FR 8;
BA_ "GenSigSendType" SG_ 1379 ARC_OD_Length_Obj_37_FR 8;
BA_ "GenSigSendType" SG_ 1379 ARC_OD_MaintenanceState_Obj_0024 8;
BA_ "GenSigSendType" SG_ 1379 ARC_OD_Width_Obj_37_FR 8;
BA_ "GenSigSendType" SG_ 1379 ARC_OD_RCS_Obj_37_FR 8;
BA_ "GenSigSendType" SG_ 1379 ARC_OD_Orientation_Obj_37_FR 8;
BA_ "GenSigSendType" SG_ 1379 ARC_OD_LifeCycle_Obj_37_FR 8;
BA_ "GenSigSendType" SG_ 1379 ARC_OD_ObstacleProb_Obj_36_FR 8;
BA_ "GenSigSendType" SG_ 1379 ARC_OD_ObstacleProb_Obj_37_FR 8;
BA_ "GenSigSendType" SG_ 1379 ARC_OD_VabsY_Obj_36_FR 8;
BA_ "GenSigSendType" SG_ 1379 ARC_OD_ID_36_FR 8;
BA_ "GenSigSendType" SG_ 1379 ARC_OD_ID_37_FR 8;
BA_ "GenSigSendType" SG_ 1379 ARC_OD_MsgCounter_Obj_36_37_FR 8;
BA_ "GenSigSendType" SG_ 1379 ARC_OD_CRC8_Obj_36_37_FR 8;
BA_ "GenSigSendType" SG_ 1379 ARC_OD_AabsY_Obj_36_FR 8;
BA_ "GenSigSendType" SG_ 1379 ARC_OD_DistXStd_Obj_36_FR 8;
BA_ "GenSigSendType" SG_ 1379 ARC_OD_DistYStd_Obj_36_FR 8;
BA_ "GenSigSendType" SG_ 1379 ARC_OD_VabsXStd_Obj_36_FR 8;
BA_ "GenSigSendType" SG_ 1379 ARC_OD_VabsYStd_Obj_36_FR 8;
BA_ "GenSigSendType" SG_ 1379 ARC_OD_AabsXStd_Obj_36_FR 8;
BA_ "GenSigSendType" SG_ 1378 DistHeight_Obj_35_FR 8;
BA_ "GenSigSendType" SG_ 1378 DistHeight_Obj_34_FR 8;
BA_ "GenSigSendType" SG_ 1378 ARC_OD_DistX_Obj_34_FR 8;
BA_ "GenSigSendType" SG_ 1378 ARC_OD_Classification_Obj_34_FR 8;
BA_ "GenSigSendType" SG_ 1378 ARC_OD_AabsYStd_Obj_34_FR 8;
BA_ "GenSigSendType" SG_ 1378 ARC_OD_ClassConf_Obj_34_FR 8;
BA_ "GenSigSendType" SG_ 1378 ARC_OD_ProbOfExist_Obj_34_FR 8;
BA_ "GenSigSendType" SG_ 1378 ARC_OD_VabsX_Obj_34_FR 8;
BA_ "GenSigSendType" SG_ 1378 ARC_OD_DynProp_Obj_34_FR 8;
BA_ "GenSigSendType" SG_ 1378 ARC_OD_Length_Obj_34_FR 8;
BA_ "GenSigSendType" SG_ 1378 ARC_OD_MaintenanceState_Obj_0025 8;
BA_ "GenSigSendType" SG_ 1378 ARC_OD_Width_Obj_34_FR 8;
BA_ "GenSigSendType" SG_ 1378 ARC_OD_RCS_Obj_34_FR 8;
BA_ "GenSigSendType" SG_ 1378 ARC_OD_Orientation_Obj_34_FR 8;
BA_ "GenSigSendType" SG_ 1378 ARC_OD_LifeCycle_Obj_34_FR 8;
BA_ "GenSigSendType" SG_ 1378 ARC_OD_DistX_Obj_35_FR 8;
BA_ "GenSigSendType" SG_ 1378 ARC_OD_VabsX_Obj_35_FR 8;
BA_ "GenSigSendType" SG_ 1378 ARC_OD_AabsX_Obj_35_FR 8;
BA_ "GenSigSendType" SG_ 1378 ARC_OD_AabsX_Obj_34_FR 8;
BA_ "GenSigSendType" SG_ 1378 ARC_OD_DistY_Obj_35_FR 8;
BA_ "GenSigSendType" SG_ 1378 ARC_OD_VabsY_Obj_35_FR 8;
BA_ "GenSigSendType" SG_ 1378 ARC_OD_AabsY_Obj_35_FR 8;
BA_ "GenSigSendType" SG_ 1378 ARC_OD_DistXStd_Obj_35_FR 8;
BA_ "GenSigSendType" SG_ 1378 ARC_OD_DistYStd_Obj_35_FR 8;
BA_ "GenSigSendType" SG_ 1378 ARC_OD_VabsXStd_Obj_35_FR 8;
BA_ "GenSigSendType" SG_ 1378 ARC_OD_VabsYStd_Obj_35_FR 8;
BA_ "GenSigSendType" SG_ 1378 ARC_OD_AabsXStd_Obj_35_FR 8;
BA_ "GenSigSendType" SG_ 1378 ARC_OD_Classification_Obj_35_FR 8;
BA_ "GenSigSendType" SG_ 1378 ARC_OD_AabsYStd_Obj_35_FR 8;
BA_ "GenSigSendType" SG_ 1378 ARC_OD_ClassConf_Obj_35_FR 8;
BA_ "GenSigSendType" SG_ 1378 ARC_OD_DistY_Obj_34_FR 8;
BA_ "GenSigSendType" SG_ 1378 ARC_OD_ProbOfExist_Obj_35_FR 8;
BA_ "GenSigSendType" SG_ 1378 ARC_OD_DynProp_Obj_35_FR 8;
BA_ "GenSigSendType" SG_ 1378 ARC_OD_Length_Obj_35_FR 8;
BA_ "GenSigSendType" SG_ 1378 ARC_OD_MaintenanceState_Obj_0026 8;
BA_ "GenSigSendType" SG_ 1378 ARC_OD_Width_Obj_35_FR 8;
BA_ "GenSigSendType" SG_ 1378 ARC_OD_RCS_Obj_35_FR 8;
BA_ "GenSigSendType" SG_ 1378 ARC_OD_Orientation_Obj_35_FR 8;
BA_ "GenSigSendType" SG_ 1378 ARC_OD_LifeCycle_Obj_35_FR 8;
BA_ "GenSigSendType" SG_ 1378 ARC_OD_ObstacleProb_Obj_34_FR 8;
BA_ "GenSigSendType" SG_ 1378 ARC_OD_ObstacleProb_Obj_35_FR 8;
BA_ "GenSigSendType" SG_ 1378 ARC_OD_VabsY_Obj_34_FR 8;
BA_ "GenSigSendType" SG_ 1378 ARC_OD_ID_34_FR 8;
BA_ "GenSigSendType" SG_ 1378 ARC_OD_ID_35_FR 8;
BA_ "GenSigSendType" SG_ 1378 ARC_OD_MsgCounter_Obj_34_35_FR 8;
BA_ "GenSigSendType" SG_ 1378 ARC_OD_CRC8_Obj_34_35_FR 8;
BA_ "GenSigSendType" SG_ 1378 ARC_OD_AabsY_Obj_34_FR 8;
BA_ "GenSigSendType" SG_ 1378 ARC_OD_DistXStd_Obj_34_FR 8;
BA_ "GenSigSendType" SG_ 1378 ARC_OD_DistYStd_Obj_34_FR 8;
BA_ "GenSigSendType" SG_ 1378 ARC_OD_VabsXStd_Obj_34_FR 8;
BA_ "GenSigSendType" SG_ 1378 ARC_OD_VabsYStd_Obj_34_FR 8;
BA_ "GenSigSendType" SG_ 1378 ARC_OD_AabsXStd_Obj_34_FR 8;
BA_ "GenSigSendType" SG_ 1377 DistHeight_Obj_33_FR 8;
BA_ "GenSigSendType" SG_ 1377 DistHeight_Obj_32_FR 8;
BA_ "GenSigSendType" SG_ 1377 ARC_OD_DistX_Obj_32_FR 8;
BA_ "GenSigSendType" SG_ 1377 ARC_OD_Classification_Obj_32_FR 8;
BA_ "GenSigSendType" SG_ 1377 ARC_OD_AabsYStd_Obj_32_FR 8;
BA_ "GenSigSendType" SG_ 1377 ARC_OD_ClassConf_Obj_32_FR 8;
BA_ "GenSigSendType" SG_ 1377 ARC_OD_ProbOfExist_Obj_32_FR 8;
BA_ "GenSigSendType" SG_ 1377 ARC_OD_VabsX_Obj_32_FR 8;
BA_ "GenSigSendType" SG_ 1377 ARC_OD_DynProp_Obj_32_FR 8;
BA_ "GenSigSendType" SG_ 1377 ARC_OD_Length_Obj_32_FR 8;
BA_ "GenSigSendType" SG_ 1377 ARC_OD_MaintenanceState_Obj_0027 8;
BA_ "GenSigSendType" SG_ 1377 ARC_OD_Width_Obj_32_FR 8;
BA_ "GenSigSendType" SG_ 1377 ARC_OD_RCS_Obj_32_FR 8;
BA_ "GenSigSendType" SG_ 1377 ARC_OD_Orientation_Obj_32_FR 8;
BA_ "GenSigSendType" SG_ 1377 ARC_OD_LifeCycle_Obj_32_FR 8;
BA_ "GenSigSendType" SG_ 1377 ARC_OD_DistX_Obj_33_FR 8;
BA_ "GenSigSendType" SG_ 1377 ARC_OD_VabsX_Obj_33_FR 8;
BA_ "GenSigSendType" SG_ 1377 ARC_OD_AabsX_Obj_33_FR 8;
BA_ "GenSigSendType" SG_ 1377 ARC_OD_AabsX_Obj_32_FR 8;
BA_ "GenSigSendType" SG_ 1377 ARC_OD_DistY_Obj_33_FR 8;
BA_ "GenSigSendType" SG_ 1377 ARC_OD_VabsY_Obj_33_FR 8;
BA_ "GenSigSendType" SG_ 1377 ARC_OD_AabsY_Obj_33_FR 8;
BA_ "GenSigSendType" SG_ 1377 ARC_OD_DistXStd_Obj_33_FR 8;
BA_ "GenSigSendType" SG_ 1377 ARC_OD_DistYStd_Obj_33_FR 8;
BA_ "GenSigSendType" SG_ 1377 ARC_OD_VabsXStd_Obj_33_FR 8;
BA_ "GenSigSendType" SG_ 1377 ARC_OD_VabsYStd_Obj_33_FR 8;
BA_ "GenSigSendType" SG_ 1377 ARC_OD_AabsXStd_Obj_33_FR 8;
BA_ "GenSigSendType" SG_ 1377 ARC_OD_Classification_Obj_33_FR 8;
BA_ "GenSigSendType" SG_ 1377 ARC_OD_AabsYStd_Obj_33_FR 8;
BA_ "GenSigSendType" SG_ 1377 ARC_OD_ClassConf_Obj_33_FR 8;
BA_ "GenSigSendType" SG_ 1377 ARC_OD_DistY_Obj_32_FR 8;
BA_ "GenSigSendType" SG_ 1377 ARC_OD_ProbOfExist_Obj_33_FR 8;
BA_ "GenSigSendType" SG_ 1377 ARC_OD_DynProp_Obj_33_FR 8;
BA_ "GenSigSendType" SG_ 1377 ARC_OD_Length_Obj_33_FR 8;
BA_ "GenSigSendType" SG_ 1377 ARC_OD_MaintenanceState_Obj_0028 8;
BA_ "GenSigSendType" SG_ 1377 ARC_OD_Width_Obj_33_FR 8;
BA_ "GenSigSendType" SG_ 1377 ARC_OD_RCS_Obj_33_FR 8;
BA_ "GenSigSendType" SG_ 1377 ARC_OD_Orientation_Obj_33_FR 8;
BA_ "GenSigSendType" SG_ 1377 ARC_OD_LifeCycle_Obj_33_FR 8;
BA_ "GenSigSendType" SG_ 1377 ARC_OD_ObstacleProb_Obj_32_FR 8;
BA_ "GenSigSendType" SG_ 1377 ARC_OD_ObstacleProb_Obj_33_FR 8;
BA_ "GenSigSendType" SG_ 1377 ARC_OD_VabsY_Obj_32_FR 8;
BA_ "GenSigSendType" SG_ 1377 ARC_OD_ID_32_FR 8;
BA_ "GenSigSendType" SG_ 1377 ARC_OD_ID_33_FR 8;
BA_ "GenSigSendType" SG_ 1377 ARC_OD_MsgCounter_Obj_32_33_FR 8;
BA_ "GenSigSendType" SG_ 1377 ARC_OD_CRC8_Obj_32_33_FR 8;
BA_ "GenSigSendType" SG_ 1377 ARC_OD_AabsY_Obj_32_FR 8;
BA_ "GenSigSendType" SG_ 1377 ARC_OD_DistXStd_Obj_32_FR 8;
BA_ "GenSigSendType" SG_ 1377 ARC_OD_DistYStd_Obj_32_FR 8;
BA_ "GenSigSendType" SG_ 1377 ARC_OD_VabsXStd_Obj_32_FR 8;
BA_ "GenSigSendType" SG_ 1377 ARC_OD_VabsYStd_Obj_32_FR 8;
BA_ "GenSigSendType" SG_ 1377 ARC_OD_AabsXStd_Obj_32_FR 8;
BA_ "GenSigSendType" SG_ 1376 DistHeight_Obj_31_FR 8;
BA_ "GenSigSendType" SG_ 1376 DistHeight_Obj_30_FR 8;
BA_ "GenSigSendType" SG_ 1376 ARC_OD_DistX_Obj_30_FR 8;
BA_ "GenSigSendType" SG_ 1376 ARC_OD_Classification_Obj_30_FR 8;
BA_ "GenSigSendType" SG_ 1376 ARC_OD_AabsYStd_Obj_30_FR 8;
BA_ "GenSigSendType" SG_ 1376 ARC_OD_ClassConf_Obj_30_FR 8;
BA_ "GenSigSendType" SG_ 1376 ARC_OD_ProbOfExist_Obj_30_FR 8;
BA_ "GenSigSendType" SG_ 1376 ARC_OD_VabsX_Obj_30_FR 8;
BA_ "GenSigSendType" SG_ 1376 ARC_OD_DynProp_Obj_30_FR 8;
BA_ "GenSigSendType" SG_ 1376 ARC_OD_Length_Obj_30_FR 8;
BA_ "GenSigSendType" SG_ 1376 ARC_OD_MaintenanceState_Obj_0029 8;
BA_ "GenSigSendType" SG_ 1376 ARC_OD_Width_Obj_30_FR 8;
BA_ "GenSigSendType" SG_ 1376 ARC_OD_RCS_Obj_30_FR 8;
BA_ "GenSigSendType" SG_ 1376 ARC_OD_Orientation_Obj_30_FR 8;
BA_ "GenSigSendType" SG_ 1376 ARC_OD_LifeCycle_Obj_30_FR 8;
BA_ "GenSigSendType" SG_ 1376 ARC_OD_DistX_Obj_31_FR 8;
BA_ "GenSigSendType" SG_ 1376 ARC_OD_VabsX_Obj_31_FR 8;
BA_ "GenSigSendType" SG_ 1376 ARC_OD_AabsX_Obj_31_FR 8;
BA_ "GenSigSendType" SG_ 1376 ARC_OD_AabsX_Obj_30_FR 8;
BA_ "GenSigSendType" SG_ 1376 ARC_OD_DistY_Obj_31_FR 8;
BA_ "GenSigSendType" SG_ 1376 ARC_OD_VabsY_Obj_31_FR 8;
BA_ "GenSigSendType" SG_ 1376 ARC_OD_AabsY_Obj_31_FR 8;
BA_ "GenSigSendType" SG_ 1376 ARC_OD_DistXStd_Obj_31_FR 8;
BA_ "GenSigSendType" SG_ 1376 ARC_OD_DistYStd_Obj_31_FR 8;
BA_ "GenSigSendType" SG_ 1376 ARC_OD_VabsXStd_Obj_31_FR 8;
BA_ "GenSigSendType" SG_ 1376 ARC_OD_VabsYStd_Obj_31_FR 8;
BA_ "GenSigSendType" SG_ 1376 ARC_OD_AabsXStd_Obj_31_FR 8;
BA_ "GenSigSendType" SG_ 1376 ARC_OD_Classification_Obj_31_FR 8;
BA_ "GenSigSendType" SG_ 1376 ARC_OD_AabsYStd_Obj_31_FR 8;
BA_ "GenSigSendType" SG_ 1376 ARC_OD_ClassConf_Obj_31_FR 8;
BA_ "GenSigSendType" SG_ 1376 ARC_OD_DistY_Obj_30_FR 8;
BA_ "GenSigSendType" SG_ 1376 ARC_OD_ProbOfExist_Obj_31_FR 8;
BA_ "GenSigSendType" SG_ 1376 ARC_OD_DynProp_Obj_31_FR 8;
BA_ "GenSigSendType" SG_ 1376 ARC_OD_Length_Obj_31_FR 8;
BA_ "GenSigSendType" SG_ 1376 ARC_OD_MaintenanceState_Obj_0030 8;
BA_ "GenSigSendType" SG_ 1376 ARC_OD_Width_Obj_31_FR 8;
BA_ "GenSigSendType" SG_ 1376 ARC_OD_RCS_Obj_31_FR 8;
BA_ "GenSigSendType" SG_ 1376 ARC_OD_Orientation_Obj_31_FR 8;
BA_ "GenSigSendType" SG_ 1376 ARC_OD_LifeCycle_Obj_31_FR 8;
BA_ "GenSigSendType" SG_ 1376 ARC_OD_ObstacleProb_Obj_30_FR 8;
BA_ "GenSigSendType" SG_ 1376 ARC_OD_ObstacleProb_Obj_31_FR 8;
BA_ "GenSigSendType" SG_ 1376 ARC_OD_VabsY_Obj_30_FR 8;
BA_ "GenSigSendType" SG_ 1376 ARC_OD_ID_30_FR 8;
BA_ "GenSigSendType" SG_ 1376 ARC_OD_ID_31_FR 8;
BA_ "GenSigSendType" SG_ 1376 ARC_OD_MsgCounter_Obj_30_31_FR 8;
BA_ "GenSigSendType" SG_ 1376 ARC_OD_CRC8_Obj_30_31_FR 8;
BA_ "GenSigSendType" SG_ 1376 ARC_OD_AabsY_Obj_30_FR 8;
BA_ "GenSigSendType" SG_ 1376 ARC_OD_DistXStd_Obj_30_FR 8;
BA_ "GenSigSendType" SG_ 1376 ARC_OD_DistYStd_Obj_30_FR 8;
BA_ "GenSigSendType" SG_ 1376 ARC_OD_VabsXStd_Obj_30_FR 8;
BA_ "GenSigSendType" SG_ 1376 ARC_OD_VabsYStd_Obj_30_FR 8;
BA_ "GenSigSendType" SG_ 1376 ARC_OD_AabsXStd_Obj_30_FR 8;
BA_ "GenSigSendType" SG_ 1375 DistHeight_Obj_29_FR 8;
BA_ "GenSigSendType" SG_ 1375 DistHeight_Obj_28_FR 8;
BA_ "GenSigSendType" SG_ 1375 ARC_OD_DistX_Obj_28_FR 8;
BA_ "GenSigSendType" SG_ 1375 ARC_OD_Classification_Obj_28_FR 8;
BA_ "GenSigSendType" SG_ 1375 ARC_OD_AabsYStd_Obj_28_FR 8;
BA_ "GenSigSendType" SG_ 1375 ARC_OD_ClassConf_Obj_28_FR 8;
BA_ "GenSigSendType" SG_ 1375 ARC_OD_ProbOfExist_Obj_28_FR 8;
BA_ "GenSigSendType" SG_ 1375 ARC_OD_VabsX_Obj_28_FR 8;
BA_ "GenSigSendType" SG_ 1375 ARC_OD_DynProp_Obj_28_FR 8;
BA_ "GenSigSendType" SG_ 1375 ARC_OD_Length_Obj_28_FR 8;
BA_ "GenSigSendType" SG_ 1375 ARC_OD_MaintenanceState_Obj_0031 8;
BA_ "GenSigSendType" SG_ 1375 ARC_OD_Width_Obj_28_FR 8;
BA_ "GenSigSendType" SG_ 1375 ARC_OD_RCS_Obj_28_FR 8;
BA_ "GenSigSendType" SG_ 1375 ARC_OD_Orientation_Obj_28_FR 8;
BA_ "GenSigSendType" SG_ 1375 ARC_OD_LifeCycle_Obj_28_FR 8;
BA_ "GenSigSendType" SG_ 1375 ARC_OD_DistX_Obj_29_FR 8;
BA_ "GenSigSendType" SG_ 1375 ARC_OD_VabsX_Obj_29_FR 8;
BA_ "GenSigSendType" SG_ 1375 ARC_OD_AabsX_Obj_29_FR 8;
BA_ "GenSigSendType" SG_ 1375 ARC_OD_AabsX_Obj_28_FR 8;
BA_ "GenSigSendType" SG_ 1375 ARC_OD_DistY_Obj_29_FR 8;
BA_ "GenSigSendType" SG_ 1375 ARC_OD_VabsY_Obj_29_FR 8;
BA_ "GenSigSendType" SG_ 1375 ARC_OD_AabsY_Obj_29_FR 8;
BA_ "GenSigSendType" SG_ 1375 ARC_OD_DistXStd_Obj_29_FR 8;
BA_ "GenSigSendType" SG_ 1375 ARC_OD_DistYStd_Obj_29_FR 8;
BA_ "GenSigSendType" SG_ 1375 ARC_OD_VabsXStd_Obj_29_FR 8;
BA_ "GenSigSendType" SG_ 1375 ARC_OD_VabsYStd_Obj_29_FR 8;
BA_ "GenSigSendType" SG_ 1375 ARC_OD_AabsXStd_Obj_29_FR 8;
BA_ "GenSigSendType" SG_ 1375 ARC_OD_Classification_Obj_29_FR 8;
BA_ "GenSigSendType" SG_ 1375 ARC_OD_AabsYStd_Obj_29_FR 8;
BA_ "GenSigSendType" SG_ 1375 ARC_OD_ClassConf_Obj_29_FR 8;
BA_ "GenSigSendType" SG_ 1375 ARC_OD_DistY_Obj_28_FR 8;
BA_ "GenSigSendType" SG_ 1375 ARC_OD_ProbOfExist_Obj_29_FR 8;
BA_ "GenSigSendType" SG_ 1375 ARC_OD_DynProp_Obj_29_FR 8;
BA_ "GenSigSendType" SG_ 1375 ARC_OD_Length_Obj_29_FR 8;
BA_ "GenSigSendType" SG_ 1375 ARC_OD_MaintenanceState_Obj_0032 8;
BA_ "GenSigSendType" SG_ 1375 ARC_OD_Width_Obj_29_FR 8;
BA_ "GenSigSendType" SG_ 1375 ARC_OD_RCS_Obj_29_FR 8;
BA_ "GenSigSendType" SG_ 1375 ARC_OD_Orientation_Obj_29_FR 8;
BA_ "GenSigSendType" SG_ 1375 ARC_OD_LifeCycle_Obj_29_FR 8;
BA_ "GenSigSendType" SG_ 1375 ARC_OD_ObstacleProb_Obj_28_FR 8;
BA_ "GenSigSendType" SG_ 1375 ARC_OD_ObstacleProb_Obj_29_FR 8;
BA_ "GenSigSendType" SG_ 1375 ARC_OD_VabsY_Obj_28_FR 8;
BA_ "GenSigSendType" SG_ 1375 ARC_OD_ID_28_FR 8;
BA_ "GenSigSendType" SG_ 1375 ARC_OD_ID_29_FR 8;
BA_ "GenSigSendType" SG_ 1375 ARC_OD_MsgCounter_Obj_28_29_FR 8;
BA_ "GenSigSendType" SG_ 1375 ARC_OD_CRC8_Obj_28_29_FR 8;
BA_ "GenSigSendType" SG_ 1375 ARC_OD_AabsY_Obj_28_FR 8;
BA_ "GenSigSendType" SG_ 1375 ARC_OD_DistXStd_Obj_28_FR 8;
BA_ "GenSigSendType" SG_ 1375 ARC_OD_DistYStd_Obj_28_FR 8;
BA_ "GenSigSendType" SG_ 1375 ARC_OD_VabsXStd_Obj_28_FR 8;
BA_ "GenSigSendType" SG_ 1375 ARC_OD_VabsYStd_Obj_28_FR 8;
BA_ "GenSigSendType" SG_ 1375 ARC_OD_AabsXStd_Obj_28_FR 8;
BA_ "GenSigSendType" SG_ 1374 DistHeight_Obj_27_FR 8;
BA_ "GenSigSendType" SG_ 1374 DistHeight_Obj_26_FR 8;
BA_ "GenSigSendType" SG_ 1374 ARC_OD_DistX_Obj_26_FR 8;
BA_ "GenSigSendType" SG_ 1374 ARC_OD_Classification_Obj_26_FR 8;
BA_ "GenSigSendType" SG_ 1374 ARC_OD_AabsYStd_Obj_26_FR 8;
BA_ "GenSigSendType" SG_ 1374 ARC_OD_ClassConf_Obj_26_FR 8;
BA_ "GenSigSendType" SG_ 1374 ARC_OD_ProbOfExist_Obj_26_FR 8;
BA_ "GenSigSendType" SG_ 1374 ARC_OD_VabsX_Obj_26_FR 8;
BA_ "GenSigSendType" SG_ 1374 ARC_OD_DynProp_Obj_26_FR 8;
BA_ "GenSigSendType" SG_ 1374 ARC_OD_Length_Obj_26_FR 8;
BA_ "GenSigSendType" SG_ 1374 ARC_OD_MaintenanceState_Obj_0033 8;
BA_ "GenSigSendType" SG_ 1374 ARC_OD_Width_Obj_26_FR 8;
BA_ "GenSigSendType" SG_ 1374 ARC_OD_RCS_Obj_26_FR 8;
BA_ "GenSigSendType" SG_ 1374 ARC_OD_Orientation_Obj_26_FR 8;
BA_ "GenSigSendType" SG_ 1374 ARC_OD_LifeCycle_Obj_26_FR 8;
BA_ "GenSigSendType" SG_ 1374 ARC_OD_DistX_Obj_27_FR 8;
BA_ "GenSigSendType" SG_ 1374 ARC_OD_VabsX_Obj_27_FR 8;
BA_ "GenSigSendType" SG_ 1374 ARC_OD_AabsX_Obj_27_FR 8;
BA_ "GenSigSendType" SG_ 1374 ARC_OD_AabsX_Obj_26_FR 8;
BA_ "GenSigSendType" SG_ 1374 ARC_OD_DistY_Obj_27_FR 8;
BA_ "GenSigSendType" SG_ 1374 ARC_OD_VabsY_Obj_27_FR 8;
BA_ "GenSigSendType" SG_ 1374 ARC_OD_AabsY_Obj_27_FR 8;
BA_ "GenSigSendType" SG_ 1374 ARC_OD_DistXStd_Obj_27_FR 8;
BA_ "GenSigSendType" SG_ 1374 ARC_OD_DistYStd_Obj_27_FR 8;
BA_ "GenSigSendType" SG_ 1374 ARC_OD_VabsXStd_Obj_27_FR 8;
BA_ "GenSigSendType" SG_ 1374 ARC_OD_VabsYStd_Obj_27_FR 8;
BA_ "GenSigSendType" SG_ 1374 ARC_OD_AabsXStd_Obj_27_FR 8;
BA_ "GenSigSendType" SG_ 1374 ARC_OD_Classification_Obj_27_FR 8;
BA_ "GenSigSendType" SG_ 1374 ARC_OD_AabsYStd_Obj_27_FR 8;
BA_ "GenSigSendType" SG_ 1374 ARC_OD_ClassConf_Obj_27_FR 8;
BA_ "GenSigSendType" SG_ 1374 ARC_OD_DistY_Obj_26_FR 8;
BA_ "GenSigSendType" SG_ 1374 ARC_OD_ProbOfExist_Obj_27_FR 8;
BA_ "GenSigSendType" SG_ 1374 ARC_OD_DynProp_Obj_27_FR 8;
BA_ "GenSigSendType" SG_ 1374 ARC_OD_Length_Obj_27_FR 8;
BA_ "GenSigSendType" SG_ 1374 ARC_OD_MaintenanceState_Obj_0034 8;
BA_ "GenSigSendType" SG_ 1374 ARC_OD_Width_Obj_27_FR 8;
BA_ "GenSigSendType" SG_ 1374 ARC_OD_RCS_Obj_27_FR 8;
BA_ "GenSigSendType" SG_ 1374 ARC_OD_Orientation_Obj_27_FR 8;
BA_ "GenSigSendType" SG_ 1374 ARC_OD_LifeCycle_Obj_27_FR 8;
BA_ "GenSigSendType" SG_ 1374 ARC_OD_ObstacleProb_Obj_26_FR 8;
BA_ "GenSigSendType" SG_ 1374 ARC_OD_ObstacleProb_Obj_27_FR 8;
BA_ "GenSigSendType" SG_ 1374 ARC_OD_VabsY_Obj_26_FR 8;
BA_ "GenSigSendType" SG_ 1374 ARC_OD_ID_26_FR 8;
BA_ "GenSigSendType" SG_ 1374 ARC_OD_ID_27_FR 8;
BA_ "GenSigSendType" SG_ 1374 ARC_OD_MsgCounter_Obj_26_27_FR 8;
BA_ "GenSigSendType" SG_ 1374 ARC_OD_CRC8_Obj_26_27_FR 8;
BA_ "GenSigSendType" SG_ 1374 ARC_OD_AabsY_Obj_26_FR 8;
BA_ "GenSigSendType" SG_ 1374 ARC_OD_DistXStd_Obj_26_FR 8;
BA_ "GenSigSendType" SG_ 1374 ARC_OD_DistYStd_Obj_26_FR 8;
BA_ "GenSigSendType" SG_ 1374 ARC_OD_VabsXStd_Obj_26_FR 8;
BA_ "GenSigSendType" SG_ 1374 ARC_OD_VabsYStd_Obj_26_FR 8;
BA_ "GenSigSendType" SG_ 1374 ARC_OD_AabsXStd_Obj_26_FR 8;
BA_ "GenSigSendType" SG_ 1373 DistHeight_Obj_25_FR 8;
BA_ "GenSigSendType" SG_ 1373 DistHeight_Obj_24_FR 8;
BA_ "GenSigSendType" SG_ 1373 ARC_OD_DistX_Obj_24_FR 8;
BA_ "GenSigSendType" SG_ 1373 ARC_OD_Classification_Obj_24_FR 8;
BA_ "GenSigSendType" SG_ 1373 ARC_OD_AabsYStd_Obj_24_FR 8;
BA_ "GenSigSendType" SG_ 1373 ARC_OD_ClassConf_Obj_24_FR 8;
BA_ "GenSigSendType" SG_ 1373 ARC_OD_ProbOfExist_Obj_24_FR 8;
BA_ "GenSigSendType" SG_ 1373 ARC_OD_VabsX_Obj_24_FR 8;
BA_ "GenSigSendType" SG_ 1373 ARC_OD_DynProp_Obj_24_FR 8;
BA_ "GenSigSendType" SG_ 1373 ARC_OD_Length_Obj_24_FR 8;
BA_ "GenSigSendType" SG_ 1373 ARC_OD_MaintenanceState_Obj_0035 8;
BA_ "GenSigSendType" SG_ 1373 ARC_OD_Width_Obj_24_FR 8;
BA_ "GenSigSendType" SG_ 1373 ARC_OD_RCS_Obj_24_FR 8;
BA_ "GenSigSendType" SG_ 1373 ARC_OD_Orientation_Obj_24_FR 8;
BA_ "GenSigSendType" SG_ 1373 ARC_OD_LifeCycle_Obj_24_FR 8;
BA_ "GenSigSendType" SG_ 1373 ARC_OD_DistX_Obj_25_FR 8;
BA_ "GenSigSendType" SG_ 1373 ARC_OD_VabsX_Obj_25_FR 8;
BA_ "GenSigSendType" SG_ 1373 ARC_OD_AabsX_Obj_25_FR 8;
BA_ "GenSigSendType" SG_ 1373 ARC_OD_AabsX_Obj_24_FR 8;
BA_ "GenSigSendType" SG_ 1373 ARC_OD_DistY_Obj_25_FR 8;
BA_ "GenSigSendType" SG_ 1373 ARC_OD_VabsY_Obj_25_FR 8;
BA_ "GenSigSendType" SG_ 1373 ARC_OD_AabsY_Obj_25_FR 8;
BA_ "GenSigSendType" SG_ 1373 ARC_OD_DistXStd_Obj_25_FR 8;
BA_ "GenSigSendType" SG_ 1373 ARC_OD_DistYStd_Obj_25_FR 8;
BA_ "GenSigSendType" SG_ 1373 ARC_OD_VabsXStd_Obj_25_FR 8;
BA_ "GenSigSendType" SG_ 1373 ARC_OD_VabsYStd_Obj_25_FR 8;
BA_ "GenSigSendType" SG_ 1373 ARC_OD_AabsXStd_Obj_25_FR 8;
BA_ "GenSigSendType" SG_ 1373 ARC_OD_Classification_Obj_25_FR 8;
BA_ "GenSigSendType" SG_ 1373 ARC_OD_AabsYStd_Obj_25_FR 8;
BA_ "GenSigSendType" SG_ 1373 ARC_OD_ClassConf_Obj_25_FR 8;
BA_ "GenSigSendType" SG_ 1373 ARC_OD_DistY_Obj_24_FR 8;
BA_ "GenSigSendType" SG_ 1373 ARC_OD_ProbOfExist_Obj_25_FR 8;
BA_ "GenSigSendType" SG_ 1373 ARC_OD_DynProp_Obj_25_FR 8;
BA_ "GenSigSendType" SG_ 1373 ARC_OD_Length_Obj_25_FR 8;
BA_ "GenSigSendType" SG_ 1373 ARC_OD_MaintenanceState_Obj_0036 8;
BA_ "GenSigSendType" SG_ 1373 ARC_OD_Width_Obj_25_FR 8;
BA_ "GenSigSendType" SG_ 1373 ARC_OD_RCS_Obj_25_FR 8;
BA_ "GenSigSendType" SG_ 1373 ARC_OD_Orientation_Obj_25_FR 8;
BA_ "GenSigSendType" SG_ 1373 ARC_OD_LifeCycle_Obj_25_FR 8;
BA_ "GenSigSendType" SG_ 1373 ARC_OD_ObstacleProb_Obj_24_FR 8;
BA_ "GenSigSendType" SG_ 1373 ARC_OD_ObstacleProb_Obj_25_FR 8;
BA_ "GenSigSendType" SG_ 1373 ARC_OD_VabsY_Obj_24_FR 8;
BA_ "GenSigSendType" SG_ 1373 ARC_OD_ID_24_FR 8;
BA_ "GenSigSendType" SG_ 1373 ARC_OD_ID_25_FR 8;
BA_ "GenSigSendType" SG_ 1373 ARC_OD_MsgCounter_Obj_24_25_FR 8;
BA_ "GenSigSendType" SG_ 1373 ARC_OD_CRC8_Obj_24_25_FR 8;
BA_ "GenSigSendType" SG_ 1373 ARC_OD_AabsY_Obj_24_FR 8;
BA_ "GenSigSendType" SG_ 1373 ARC_OD_DistXStd_Obj_24_FR 8;
BA_ "GenSigSendType" SG_ 1373 ARC_OD_DistYStd_Obj_24_FR 8;
BA_ "GenSigSendType" SG_ 1373 ARC_OD_VabsXStd_Obj_24_FR 8;
BA_ "GenSigSendType" SG_ 1373 ARC_OD_VabsYStd_Obj_24_FR 8;
BA_ "GenSigSendType" SG_ 1373 ARC_OD_AabsXStd_Obj_24_FR 8;
VAL_ 1623 ARC_OD_Classification_Obj_12_FL 0 "Unknow" 1 "Person" 2 "Bimo" 3 "Car" 4 "Truck" 5 "Barrier" 6 "Reserved" 7 "Reserved";
VAL_ 1623 ARC_OD_DynProp_Obj_12_FL 0 "MOVING" 1 "STATIONARY" 2 "ONCOMING" 3 "CROSSING_LEFT2RIGHT" 4 "CROSSING_RIGHT2LEFT" 5 "UNKNOWN" 6 "STOPPED" 7 "RESERVED";
VAL_ 1623 ARC_OD_MaintenanceState_Obj_12_F 0 "INVALID" 1 "NEW" 2 "MEASURED" 3 "PREDICTED";
VAL_ 1623 ARC_OD_Classification_Obj_13_FL 0 "Unknow" 1 "Person" 2 "Bimo" 3 "Car" 4 "Truck" 5 "Barrier" 6 "Reserved" 7 "Reserved";
VAL_ 1623 ARC_OD_DynProp_Obj_13_FL 0 "STATIONAR" 1 "MOVIN" 2 "ONCOMING" 3 "STOPPE" 4 "CROSSING_LEFT2RIGH" 5 "CROSSING_RIGHT2LEF" 6 "RESERVE" 7 "RESERVED";
VAL_ 1623 ARC_OD_MaintenanceState_Obj_13_F 0 "INVALID" 1 "NEW" 2 "MEASURED" 3 "PREDICTED";
VAL_ 1622 ARC_OD_Classification_Obj_10_FL 0 "Unknow" 1 "Person" 2 "Bimo" 3 "Car" 4 "Truck" 5 "Barrier" 6 "Reserved" 7 "Reserved";
VAL_ 1622 ARC_OD_DynProp_Obj_10_FL 0 "MOVING" 1 "STATIONARY" 2 "ONCOMING" 3 "CROSSING_LEFT2RIGHT" 4 "CROSSING_RIGHT2LEFT" 5 "UNKNOWN" 6 "STOPPED" 7 "RESERVED";
VAL_ 1622 ARC_OD_Classification_Obj_11_FL 0 "Unknow" 1 "Person" 2 "Bimo" 3 "Car" 4 "Truck" 5 "Barrier" 6 "Reserved" 7 "Reserved";
VAL_ 1622 ARC_OD_DynProp_Obj_11_FL 0 "STATIONAR" 1 "MOVIN" 2 "ONCOMING" 3 "STOPPE" 4 "CROSSING_LEFT2RIGH" 5 "CROSSING_RIGHT2LEF" 6 "RESERVE" 7 "RESERVED";
VAL_ 1622 ARC_OD_MaintenanceState_Obj_11_F 0 "INVALID" 1 "NEW" 2 "MEASURED" 3 "PREDICTED";
VAL_ 1621 ARC_OD_Classification_Obj_08_FL 0 "Unknow" 1 "Person" 2 "Bimo" 3 "Car" 4 "Truck" 5 "Barrier" 6 "Reserved" 7 "Reserved";
VAL_ 1621 ARC_OD_DynProp_Obj_08_FL 0 "MOVING" 1 "STATIONARY" 2 "ONCOMING" 3 "CROSSING_LEFT2RIGHT" 4 "CROSSING_RIGHT2LEFT" 5 "UNKNOWN" 6 "STOPPED" 7 "RESERVED";
VAL_ 1621 ARC_OD_MaintenanceState_Obj_08_F 0 "INVALID" 1 "NEW" 2 "MEASURED" 3 "PREDICTED";
VAL_ 1621 ARC_OD_Classification_Obj_09_FL 0 "Unknow" 1 "Person" 2 "Bimo" 3 "Car" 4 "Truck" 5 "Barrier" 6 "Reserved" 7 "Reserved";
VAL_ 1621 ARC_OD_DynProp_Obj_09_FL 0 "STATIONAR" 1 "MOVIN" 2 "ONCOMING" 3 "STOPPE" 4 "CROSSING_LEFT2RIGH" 5 "CROSSING_RIGHT2LEF" 6 "RESERVE" 7 "RESERVED";
VAL_ 1621 ARC_OD_MaintenanceState_Obj_09_F 0 "INVALID" 1 "NEW" 2 "MEASURED" 3 "PREDICTED";
VAL_ 1620 ARC_OD_Classification_Obj_06_FL 0 "Unknow" 1 "Person" 2 "Bimo" 3 "Car" 4 "Truck" 5 "Barrier" 6 "Reserved" 7 "Reserved";
VAL_ 1620 ARC_OD_DynProp_Obj_06_FL 0 "MOVING" 1 "STATIONARY" 2 "ONCOMING" 3 "CROSSING_LEFT2RIGHT" 4 "CROSSING_RIGHT2LEFT" 5 "UNKNOWN" 6 "STOPPED" 7 "RESERVED";
VAL_ 1620 ARC_OD_MaintenanceState_Obj_06_F 0 "INVALID" 1 "NEW" 2 "MEASURED" 3 "PREDICTED";
VAL_ 1620 ARC_OD_Classification_Obj_07_FL 0 "Unknow" 1 "Person" 2 "Bimo" 3 "Car" 4 "Truck" 5 "Barrier" 6 "Reserved" 7 "Reserved";
VAL_ 1620 ARC_OD_DynProp_Obj_07_FL 0 "STATIONAR" 1 "MOVIN" 2 "ONCOMING" 3 "STOPPE" 4 "CROSSING_LEFT2RIGH" 5 "CROSSING_RIGHT2LEF" 6 "RESERVE" 7 "RESERVED";
VAL_ 1620 ARC_OD_MaintenanceState_Obj_07_F 0 "INVALID" 1 "NEW" 2 "MEASURED" 3 "PREDICTED";
VAL_ 1619 ARC_OD_Classification_Obj_04_FL 0 "Unknow" 1 "Person" 2 "Bimo" 3 "Car" 4 "Truck" 5 "Barrier" 6 "Reserved" 7 "Reserved";
VAL_ 1619 ARC_OD_DynProp_Obj_04_FL 0 "MOVING" 1 "STATIONARY" 2 "ONCOMING" 3 "CROSSING_LEFT2RIGHT" 4 "CROSSING_RIGHT2LEFT" 5 "UNKNOWN" 6 "STOPPED" 7 "RESERVED";
VAL_ 1619 ARC_OD_MaintenanceState_Obj_04_F 0 "INVALID" 1 "NEW" 2 "MEASURED" 3 "PREDICTED";
VAL_ 1619 ARC_OD_Classification_Obj_05_FL 0 "Unknow" 1 "Person" 2 "Bimo" 3 "Car" 4 "Truck" 5 "Barrier" 6 "Reserved" 7 "Reserved";
VAL_ 1619 ARC_OD_DynProp_Obj_05_FL 0 "STATIONAR" 1 "MOVIN" 2 "ONCOMING" 3 "STOPPE" 4 "CROSSING_LEFT2RIGH" 5 "CROSSING_RIGHT2LEF" 6 "RESERVE" 7 "RESERVED";
VAL_ 1619 ARC_OD_MaintenanceState_Obj_05_F 0 "INVALID" 1 "NEW" 2 "MEASURED" 3 "PREDICTED";
VAL_ 1618 ARC_OD_Classification_Obj_02_FL 0 "Unknow" 1 "Person" 2 "Bimo" 3 "Car" 4 "Truck" 5 "Barrier" 6 "Reserved" 7 "Reserved";
VAL_ 1618 ARC_OD_DynProp_Obj_02_FL 0 "MOVING" 1 "STATIONARY" 2 "ONCOMING" 3 "CROSSING_LEFT2RIGHT" 4 "CROSSING_RIGHT2LEFT" 5 "UNKNOWN" 6 "STOPPED" 7 "RESERVED";
VAL_ 1618 ARC_OD_MaintenanceState_Obj_02_F 0 "INVALID" 1 "NEW" 2 "MEASURED" 3 "PREDICTED";
VAL_ 1618 ARC_OD_Classification_Obj_03_FL 0 "Unknow" 1 "Person" 2 "Bimo" 3 "Car" 4 "Truck" 5 "Barrier" 6 "Reserved" 7 "Reserved";
VAL_ 1618 ARC_OD_DynProp_Obj_03_FL 0 "STATIONAR" 1 "MOVIN" 2 "ONCOMING" 3 "STOPPE" 4 "CROSSING_LEFT2RIGH" 5 "CROSSING_RIGHT2LEF" 6 "RESERVE" 7 "RESERVED";
VAL_ 1618 ARC_OD_MaintenanceState_Obj_03_F 0 "INVALID" 1 "NEW" 2 "MEASURED" 3 "PREDICTED";
VAL_ 1617 ARC_OD_Classification_Obj_00_FL 0 "Unknow" 1 "Person" 2 "Bimo" 3 "Car" 4 "Truck" 5 "Barrier" 6 "Reserved" 7 "Reserved";
VAL_ 1617 ARC_OD_DynProp_Obj_00_FL 0 "MOVING" 1 "STATIONARY" 2 "ONCOMING" 3 "CROSSING_LEFT2RIGHT" 4 "CROSSING_RIGHT2LEFT" 5 "UNKNOWN" 6 "STOPPED" 7 "RESERVED";
VAL_ 1617 ARC_OD_MaintenanceState_Obj_00_F 0 "INVALID" 1 "NEW" 2 "MEASURED" 3 "PREDICTED";
VAL_ 1617 ARC_OD_Classification_Obj_01_FL 0 "Unknow" 1 "Person" 2 "Bimo" 3 "Car" 4 "Truck" 5 "Barrier" 6 "Reserved" 7 "Reserved";
VAL_ 1617 ARC_OD_DynProp_Obj_01_FL 0 "STATIONAR" 1 "MOVIN" 2 "ONCOMING" 3 "STOPPE" 4 "CROSSING_LEFT2RIGH" 5 "CROSSING_RIGHT2LEF" 6 "RESERVE" 7 "RESERVED";
VAL_ 1617 ARC_OD_MaintenanceState_Obj_01_F 0 "INVALID" 1 "NEW" 2 "MEASURED" 3 "PREDICTED";
VAL_ 1390 ARC_OD_Classification_Obj_58_FR 0 "POINT" 1 "CAR" 2 "TRUCK" 3 "PEDESTRIAN" 4 "MOTORCYCLE" 5 "BICYCLE" 6 "WIDE" 7 "UNCLASSIFIED";
VAL_ 1390 ARC_OD_DynProp_Obj_58_FR 0 "MOVING" 1 "STATIONARY" 2 "ONCOMING" 3 "CROSSING_LEFT2RIGHT" 4 "CROSSING_RIGHT2LEFT" 5 "UNKNOWN" 6 "STOPPED" 7 "RESERVED";
VAL_ 1390 ARC_OD_MaintenanceState_Obj_0001 0 "INVALID" 1 "NEW" 2 "MEASURED" 3 "PREDICTED";
VAL_ 1390 ARC_OD_Classification_Obj_59_FR 0 "POINT" 1 "CAR" 2 "TRUCK" 3 "PEDESTRIAN" 4 "MOTORCYCLE" 5 "BICYCLE" 6 "WIDE" 7 "UNCLASSIFIED";
VAL_ 1390 ARC_OD_DynProp_Obj_59_FR 0 "STATIONAR" 1 "MOVIN" 2 "ONCOMING" 3 "STOPPE" 4 "CROSSING_LEFT2RIGH" 5 "CROSSING_RIGHT2LEF" 6 "RESERVE" 7 "RESERVED";
VAL_ 1390 ARC_OD_MaintenanceState_Obj_0002 0 "INVALID" 1 "NEW" 2 "MEASURED" 3 "PREDICTED";
VAL_ 1389 ARC_OD_Classification_Obj_56_FR 0 "POINT" 1 "CAR" 2 "TRUCK" 3 "PEDESTRIAN" 4 "MOTORCYCLE" 5 "BICYCLE" 6 "WIDE" 7 "UNCLASSIFIED";
VAL_ 1389 ARC_OD_DynProp_Obj_56_FR 0 "MOVING" 1 "STATIONARY" 2 "ONCOMING" 3 "CROSSING_LEFT2RIGHT" 4 "CROSSING_RIGHT2LEFT" 5 "UNKNOWN" 6 "STOPPED" 7 "RESERVED";
VAL_ 1389 ARC_OD_MaintenanceState_Obj_0003 0 "INVALID" 1 "NEW" 2 "MEASURED" 3 "PREDICTED";
VAL_ 1389 ARC_OD_Classification_Obj_57_FR 0 "POINT" 1 "CAR" 2 "TRUCK" 3 "PEDESTRIAN" 4 "MOTORCYCLE" 5 "BICYCLE" 6 "WIDE" 7 "UNCLASSIFIED";
VAL_ 1389 ARC_OD_DynProp_Obj_57_FR 0 "STATIONAR" 1 "MOVIN" 2 "ONCOMING" 3 "STOPPE" 4 "CROSSING_LEFT2RIGH" 5 "CROSSING_RIGHT2LEF" 6 "RESERVE" 7 "RESERVED";
VAL_ 1389 ARC_OD_MaintenanceState_Obj_0004 0 "INVALID" 1 "NEW" 2 "MEASURED" 3 "PREDICTED";
VAL_ 1388 ARC_OD_Classification_Obj_54_FR 0 "POINT" 1 "CAR" 2 "TRUCK" 3 "PEDESTRIAN" 4 "MOTORCYCLE" 5 "BICYCLE" 6 "WIDE" 7 "UNCLASSIFIED";
VAL_ 1388 ARC_OD_DynProp_Obj_54_FR 0 "MOVING" 1 "STATIONARY" 2 "ONCOMING" 3 "CROSSING_LEFT2RIGHT" 4 "CROSSING_RIGHT2LEFT" 5 "UNKNOWN" 6 "STOPPED" 7 "RESERVED";
VAL_ 1388 ARC_OD_MaintenanceState_Obj_0005 0 "INVALID" 1 "NEW" 2 "MEASURED" 3 "PREDICTED";
VAL_ 1388 ARC_OD_Classification_Obj_55_FR 0 "POINT" 1 "CAR" 2 "TRUCK" 3 "PEDESTRIAN" 4 "MOTORCYCLE" 5 "BICYCLE" 6 "WIDE" 7 "UNCLASSIFIED";
VAL_ 1388 ARC_OD_DynProp_Obj_55_FR 0 "STATIONAR" 1 "MOVIN" 2 "ONCOMING" 3 "STOPPE" 4 "CROSSING_LEFT2RIGH" 5 "CROSSING_RIGHT2LEF" 6 "RESERVE" 7 "RESERVED";
VAL_ 1388 ARC_OD_MaintenanceState_Obj_0006 0 "INVALID" 1 "NEW" 2 "MEASURED" 3 "PREDICTED";
VAL_ 1387 ARC_OD_Classification_Obj_52_FR 0 "POINT" 1 "CAR" 2 "TRUCK" 3 "PEDESTRIAN" 4 "MOTORCYCLE" 5 "BICYCLE" 6 "WIDE" 7 "UNCLASSIFIED";
VAL_ 1387 ARC_OD_DynProp_Obj_52_FR 0 "MOVING" 1 "STATIONARY" 2 "ONCOMING" 3 "CROSSING_LEFT2RIGHT" 4 "CROSSING_RIGHT2LEFT" 5 "UNKNOWN" 6 "STOPPED" 7 "RESERVED";
VAL_ 1387 ARC_OD_MaintenanceState_Obj_0007 0 "INVALID" 1 "NEW" 2 "MEASURED" 3 "PREDICTED";
VAL_ 1387 ARC_OD_Classification_Obj_53_FR 0 "POINT" 1 "CAR" 2 "TRUCK" 3 "PEDESTRIAN" 4 "MOTORCYCLE" 5 "BICYCLE" 6 "WIDE" 7 "UNCLASSIFIED";
VAL_ 1387 ARC_OD_DynProp_Obj_53_FR 0 "STATIONAR" 1 "MOVIN" 2 "ONCOMING" 3 "STOPPE" 4 "CROSSING_LEFT2RIGH" 5 "CROSSING_RIGHT2LEF" 6 "RESERVE" 7 "RESERVED";
VAL_ 1387 ARC_OD_MaintenanceState_Obj_0008 0 "INVALID" 1 "NEW" 2 "MEASURED" 3 "PREDICTED";
VAL_ 1386 ARC_OD_Classification_Obj_50_FR 0 "POINT" 1 "CAR" 2 "TRUCK" 3 "PEDESTRIAN" 4 "MOTORCYCLE" 5 "BICYCLE" 6 "WIDE" 7 "UNCLASSIFIED";
VAL_ 1386 ARC_OD_DynProp_Obj_50_FR 0 "MOVING" 1 "STATIONARY" 2 "ONCOMING" 3 "CROSSING_LEFT2RIGHT" 4 "CROSSING_RIGHT2LEFT" 5 "UNKNOWN" 6 "STOPPED" 7 "RESERVED";
VAL_ 1386 ARC_OD_MaintenanceState_Obj_0009 0 "INVALID" 1 "NEW" 2 "MEASURED" 3 "PREDICTED";
VAL_ 1386 ARC_OD_Classification_Obj_51_FR 0 "POINT" 1 "CAR" 2 "TRUCK" 3 "PEDESTRIAN" 4 "MOTORCYCLE" 5 "BICYCLE" 6 "WIDE" 7 "UNCLASSIFIED";
VAL_ 1386 ARC_OD_DynProp_Obj_51_FR 0 "STATIONAR" 1 "MOVIN" 2 "ONCOMING" 3 "STOPPE" 4 "CROSSING_LEFT2RIGH" 5 "CROSSING_RIGHT2LEF" 6 "RESERVE" 7 "RESERVED";
VAL_ 1386 ARC_OD_MaintenanceState_Obj_0010 0 "INVALID" 1 "NEW" 2 "MEASURED" 3 "PREDICTED";
VAL_ 1385 ARC_OD_Classification_Obj_48_FR 0 "POINT" 1 "CAR" 2 "TRUCK" 3 "PEDESTRIAN" 4 "MOTORCYCLE" 5 "BICYCLE" 6 "WIDE" 7 "UNCLASSIFIED";
VAL_ 1385 ARC_OD_DynProp_Obj_48_FR 0 "MOVING" 1 "STATIONARY" 2 "ONCOMING" 3 "CROSSING_LEFT2RIGHT" 4 "CROSSING_RIGHT2LEFT" 5 "UNKNOWN" 6 "STOPPED" 7 "RESERVED";
VAL_ 1385 ARC_OD_MaintenanceState_Obj_0011 0 "INVALID" 1 "NEW" 2 "MEASURED" 3 "PREDICTED";
VAL_ 1385 ARC_OD_Classification_Obj_49_FR 0 "POINT" 1 "CAR" 2 "TRUCK" 3 "PEDESTRIAN" 4 "MOTORCYCLE" 5 "BICYCLE" 6 "WIDE" 7 "UNCLASSIFIED";
VAL_ 1385 ARC_OD_DynProp_Obj_49_FR 0 "STATIONAR" 1 "MOVIN" 2 "ONCOMING" 3 "STOPPE" 4 "CROSSING_LEFT2RIGH" 5 "CROSSING_RIGHT2LEF" 6 "RESERVE" 7 "RESERVED";
VAL_ 1385 ARC_OD_MaintenanceState_Obj_0012 0 "INVALID" 1 "NEW" 2 "MEASURED" 3 "PREDICTED";
VAL_ 1384 ARC_OD_Classification_Obj_46_FR 0 "POINT" 1 "CAR" 2 "TRUCK" 3 "PEDESTRIAN" 4 "MOTORCYCLE" 5 "BICYCLE" 6 "WIDE" 7 "UNCLASSIFIED";
VAL_ 1384 ARC_OD_DynProp_Obj_46_FR 0 "MOVING" 1 "STATIONARY" 2 "ONCOMING" 3 "CROSSING_LEFT2RIGHT" 4 "CROSSING_RIGHT2LEFT" 5 "UNKNOWN" 6 "STOPPED" 7 "RESERVED";
VAL_ 1384 ARC_OD_MaintenanceState_Obj_0013 0 "INVALID" 1 "NEW" 2 "MEASURED" 3 "PREDICTED";
VAL_ 1384 ARC_OD_Classification_Obj_47_FR 0 "POINT" 1 "CAR" 2 "TRUCK" 3 "PEDESTRIAN" 4 "MOTORCYCLE" 5 "BICYCLE" 6 "WIDE" 7 "UNCLASSIFIED";
VAL_ 1384 ARC_OD_DynProp_Obj_47_FR 0 "STATIONAR" 1 "MOVIN" 2 "ONCOMING" 3 "STOPPE" 4 "CROSSING_LEFT2RIGH" 5 "CROSSING_RIGHT2LEF" 6 "RESERVE" 7 "RESERVED";
VAL_ 1384 ARC_OD_MaintenanceState_Obj_0014 0 "INVALID" 1 "NEW" 2 "MEASURED" 3 "PREDICTED";
VAL_ 1383 ARC_OD_Classification_Obj_44_FR 0 "POINT" 1 "CAR" 2 "TRUCK" 3 "PEDESTRIAN" 4 "MOTORCYCLE" 5 "BICYCLE" 6 "WIDE" 7 "UNCLASSIFIED";
VAL_ 1383 ARC_OD_DynProp_Obj_44_FR 0 "MOVING" 1 "STATIONARY" 2 "ONCOMING" 3 "CROSSING_LEFT2RIGHT" 4 "CROSSING_RIGHT2LEFT" 5 "UNKNOWN" 6 "STOPPED" 7 "RESERVED";
VAL_ 1383 ARC_OD_MaintenanceState_Obj_0015 0 "INVALID" 1 "NEW" 2 "MEASURED" 3 "PREDICTED";
VAL_ 1383 ARC_OD_Classification_Obj_45_FR 0 "POINT" 1 "CAR" 2 "TRUCK" 3 "PEDESTRIAN" 4 "MOTORCYCLE" 5 "BICYCLE" 6 "WIDE" 7 "UNCLASSIFIED";
VAL_ 1383 ARC_OD_DynProp_Obj_45_FR 0 "STATIONAR" 1 "MOVIN" 2 "ONCOMING" 3 "STOPPE" 4 "CROSSING_LEFT2RIGH" 5 "CROSSING_RIGHT2LEF" 6 "RESERVE" 7 "RESERVED";
VAL_ 1383 ARC_OD_MaintenanceState_Obj_0016 0 "INVALID" 1 "NEW" 2 "MEASURED" 3 "PREDICTED";
VAL_ 1382 ARC_OD_Classification_Obj_42_FR 0 "POINT" 1 "CAR" 2 "TRUCK" 3 "PEDESTRIAN" 4 "MOTORCYCLE" 5 "BICYCLE" 6 "WIDE" 7 "UNCLASSIFIED";
VAL_ 1382 ARC_OD_DynProp_Obj_42_FR 0 "MOVING" 1 "STATIONARY" 2 "ONCOMING" 3 "CROSSING_LEFT2RIGHT" 4 "CROSSING_RIGHT2LEFT" 5 "UNKNOWN" 6 "STOPPED" 7 "RESERVED";
VAL_ 1382 ARC_OD_MaintenanceState_Obj_0017 0 "INVALID" 1 "NEW" 2 "MEASURED" 3 "PREDICTED";
VAL_ 1382 ARC_OD_Classification_Obj_43_FR 0 "POINT" 1 "CAR" 2 "TRUCK" 3 "PEDESTRIAN" 4 "MOTORCYCLE" 5 "BICYCLE" 6 "WIDE" 7 "UNCLASSIFIED";
VAL_ 1382 ARC_OD_DynProp_Obj_43_FR 0 "STATIONAR" 1 "MOVIN" 2 "ONCOMING" 3 "STOPPE" 4 "CROSSING_LEFT2RIGH" 5 "CROSSING_RIGHT2LEF" 6 "RESERVE" 7 "RESERVED";
VAL_ 1382 ARC_OD_MaintenanceState_Obj_0018 0 "INVALID" 1 "NEW" 2 "MEASURED" 3 "PREDICTED";
VAL_ 1381 ARC_OD_Classification_Obj_40_FR 0 "Unknow" 1 "Person" 2 "Bimo" 3 "Car" 4 "Truck" 5 "Barrier" 6 "Reserved" 7 "Reserved";
VAL_ 1381 ARC_OD_DynProp_Obj_40_FR 0 "MOVING" 1 "STATIONARY" 2 "ONCOMING" 3 "CROSSING_LEFT2RIGHT" 4 "CROSSING_RIGHT2LEFT" 5 "UNKNOWN" 6 "STOPPED" 7 "RESERVED";
VAL_ 1381 ARC_OD_MaintenanceState_Obj_0019 0 "INVALID" 1 "NEW" 2 "MEASURED" 3 "PREDICTED";
VAL_ 1381 ARC_OD_Classification_Obj_41_FR 0 "Unknow" 1 "Person" 2 "Bimo" 3 "Car" 4 "Truck" 5 "Barrier" 6 "Reserved" 7 "Reserved";
VAL_ 1381 ARC_OD_DynProp_Obj_41_FR 0 "STATIONAR" 1 "MOVIN" 2 "ONCOMING" 3 "STOPPE" 4 "CROSSING_LEFT2RIGH" 5 "CROSSING_RIGHT2LEF" 6 "RESERVE" 7 "RESERVED";
VAL_ 1381 ARC_OD_MaintenanceState_Obj_0020 0 "INVALID" 1 "NEW" 2 "MEASURED" 3 "PREDICTED";
VAL_ 1380 ARC_OD_Classification_Obj_38_FR 0 "Unknow" 1 "Person" 2 "Bimo" 3 "Car" 4 "Truck" 5 "Barrier" 6 "Reserved" 7 "Reserved";
VAL_ 1380 ARC_OD_DynProp_Obj_38_FR 0 "MOVING" 1 "STATIONARY" 2 "ONCOMING" 3 "CROSSING_LEFT2RIGHT" 4 "CROSSING_RIGHT2LEFT" 5 "UNKNOWN" 6 "STOPPED" 7 "RESERVED";
VAL_ 1380 ARC_OD_MaintenanceState_Obj_0021 0 "INVALID" 1 "NEW" 2 "MEASURED" 3 "PREDICTED";
VAL_ 1380 ARC_OD_Classification_Obj_39_FR 0 "Unknow" 1 "Person" 2 "Bimo" 3 "Car" 4 "Truck" 5 "Barrier" 6 "Reserved" 7 "Reserved";
VAL_ 1380 ARC_OD_DynProp_Obj_39_FR 0 "STATIONAR" 1 "MOVIN" 2 "ONCOMING" 3 "STOPPE" 4 "CROSSING_LEFT2RIGH" 5 "CROSSING_RIGHT2LEF" 6 "RESERVE" 7 "RESERVED";
VAL_ 1380 ARC_OD_MaintenanceState_Obj_0022 0 "INVALID" 1 "NEW" 2 "MEASURED" 3 "PREDICTED";
VAL_ 1379 ARC_OD_Classification_Obj_36_FR 0 "Unknow" 1 "Person" 2 "Bimo" 3 "Car" 4 "Truck" 5 "Barrier" 6 "Reserved" 7 "Reserved";
VAL_ 1379 ARC_OD_DynProp_Obj_36_FR 0 "MOVING" 1 "STATIONARY" 2 "ONCOMING" 3 "CROSSING_LEFT2RIGHT" 4 "CROSSING_RIGHT2LEFT" 5 "UNKNOWN" 6 "STOPPED" 7 "RESERVED";
VAL_ 1379 ARC_OD_MaintenanceState_Obj_0023 0 "INVALID" 1 "NEW" 2 "MEASURED" 3 "PREDICTED";
VAL_ 1379 ARC_OD_Classification_Obj_37_FR 0 "Unknow" 1 "Person" 2 "Bimo" 3 "Car" 4 "Truck" 5 "Barrier" 6 "Reserved" 7 "Reserved";
VAL_ 1379 ARC_OD_DynProp_Obj_37_FR 0 "STATIONAR" 1 "MOVIN" 2 "ONCOMING" 3 "STOPPE" 4 "CROSSING_LEFT2RIGH" 5 "CROSSING_RIGHT2LEF" 6 "RESERVE" 7 "RESERVED";
VAL_ 1379 ARC_OD_MaintenanceState_Obj_0024 0 "INVALID" 1 "NEW" 2 "MEASURED" 3 "PREDICTED";
VAL_ 1378 ARC_OD_Classification_Obj_34_FR 0 "Unknow" 1 "Person" 2 "Bimo" 3 "Car" 4 "Truck" 5 "Barrier" 6 "Reserved" 7 "Reserved";
VAL_ 1378 ARC_OD_DynProp_Obj_34_FR 0 "MOVING" 1 "STATIONARY" 2 "ONCOMING" 3 "CROSSING_LEFT2RIGHT" 4 "CROSSING_RIGHT2LEFT" 5 "UNKNOWN" 6 "STOPPED" 7 "RESERVED";
VAL_ 1378 ARC_OD_MaintenanceState_Obj_0025 0 "INVALID" 1 "NEW" 2 "MEASURED" 3 "PREDICTED";
VAL_ 1378 ARC_OD_Classification_Obj_35_FR 0 "Unknow" 1 "Person" 2 "Bimo" 3 "Car" 4 "Truck" 5 "Barrier" 6 "Reserved" 7 "Reserved";
VAL_ 1378 ARC_OD_DynProp_Obj_35_FR 0 "STATIONAR" 1 "MOVIN" 2 "ONCOMING" 3 "STOPPE" 4 "CROSSING_LEFT2RIGH" 5 "CROSSING_RIGHT2LEF" 6 "RESERVE" 7 "RESERVED";
VAL_ 1378 ARC_OD_MaintenanceState_Obj_0026 0 "INVALID" 1 "NEW" 2 "MEASURED" 3 "PREDICTED";
VAL_ 1377 ARC_OD_Classification_Obj_32_FR 0 "Unknow" 1 "Person" 2 "Bimo" 3 "Car" 4 "Truck" 5 "Barrier" 6 "Reserved" 7 "Reserved";
VAL_ 1377 ARC_OD_DynProp_Obj_32_FR 0 "MOVING" 1 "STATIONARY" 2 "ONCOMING" 3 "CROSSING_LEFT2RIGHT" 4 "CROSSING_RIGHT2LEFT" 5 "UNKNOWN" 6 "STOPPED" 7 "RESERVED";
VAL_ 1377 ARC_OD_MaintenanceState_Obj_0027 0 "INVALID" 1 "NEW" 2 "MEASURED" 3 "PREDICTED";
VAL_ 1377 ARC_OD_Classification_Obj_33_FR 0 "Unknow" 1 "Person" 2 "Bimo" 3 "Car" 4 "Truck" 5 "Barrier" 6 "Reserved" 7 "Reserved";
VAL_ 1377 ARC_OD_DynProp_Obj_33_FR 0 "STATIONAR" 1 "MOVIN" 2 "ONCOMING" 3 "STOPPE" 4 "CROSSING_LEFT2RIGH" 5 "CROSSING_RIGHT2LEF" 6 "RESERVE" 7 "RESERVED";
VAL_ 1377 ARC_OD_MaintenanceState_Obj_0028 0 "INVALID" 1 "NEW" 2 "MEASURED" 3 "PREDICTED";
VAL_ 1376 ARC_OD_Classification_Obj_30_FR 0 "Unknow" 1 "Person" 2 "Bimo" 3 "Car" 4 "Truck" 5 "Barrier" 6 "Reserved" 7 "Reserved";
VAL_ 1376 ARC_OD_DynProp_Obj_30_FR 0 "MOVING" 1 "STATIONARY" 2 "ONCOMING" 3 "CROSSING_LEFT2RIGHT" 4 "CROSSING_RIGHT2LEFT" 5 "UNKNOWN" 6 "STOPPED" 7 "RESERVED";
VAL_ 1376 ARC_OD_MaintenanceState_Obj_0029 0 "INVALID" 1 "NEW" 2 "MEASURED" 3 "PREDICTED";
VAL_ 1376 ARC_OD_Classification_Obj_31_FR 0 "Unknow" 1 "Person" 2 "Bimo" 3 "Car" 4 "Truck" 5 "Barrier" 6 "Reserved" 7 "Reserved";
VAL_ 1376 ARC_OD_DynProp_Obj_31_FR 0 "STATIONAR" 1 "MOVIN" 2 "ONCOMING" 3 "STOPPE" 4 "CROSSING_LEFT2RIGH" 5 "CROSSING_RIGHT2LEF" 6 "RESERVE" 7 "RESERVED";
VAL_ 1376 ARC_OD_MaintenanceState_Obj_0030 0 "INVALID" 1 "NEW" 2 "MEASURED" 3 "PREDICTED";
VAL_ 1375 ARC_OD_Classification_Obj_28_FR 0 "Unknow" 1 "Person" 2 "Bimo" 3 "Car" 4 "Truck" 5 "Barrier" 6 "Reserved" 7 "Reserved";
VAL_ 1375 ARC_OD_DynProp_Obj_28_FR 0 "MOVING" 1 "STATIONARY" 2 "ONCOMING" 3 "CROSSING_LEFT2RIGHT" 4 "CROSSING_RIGHT2LEFT" 5 "UNKNOWN" 6 "STOPPED" 7 "RESERVED";
VAL_ 1375 ARC_OD_MaintenanceState_Obj_0031 0 "INVALID" 1 "NEW" 2 "MEASURED" 3 "PREDICTED";
VAL_ 1375 ARC_OD_Classification_Obj_29_FR 0 "Unknow" 1 "Person" 2 "Bimo" 3 "Car" 4 "Truck" 5 "Barrier" 6 "Reserved" 7 "Reserved";
VAL_ 1375 ARC_OD_DynProp_Obj_29_FR 0 "STATIONAR" 1 "MOVIN" 2 "ONCOMING" 3 "STOPPE" 4 "CROSSING_LEFT2RIGH" 5 "CROSSING_RIGHT2LEF" 6 "RESERVE" 7 "RESERVED";
VAL_ 1375 ARC_OD_MaintenanceState_Obj_0032 0 "INVALID" 1 "NEW" 2 "MEASURED" 3 "PREDICTED";
VAL_ 1374 ARC_OD_Classification_Obj_26_FR 0 "Unknow" 1 "Person" 2 "Bimo" 3 "Car" 4 "Truck" 5 "Barrier" 6 "Reserved" 7 "Reserved";
VAL_ 1374 ARC_OD_DynProp_Obj_26_FR 0 "MOVING" 1 "STATIONARY" 2 "ONCOMING" 3 "CROSSING_LEFT2RIGHT" 4 "CROSSING_RIGHT2LEFT" 5 "UNKNOWN" 6 "STOPPED" 7 "RESERVED";
VAL_ 1374 ARC_OD_MaintenanceState_Obj_0033 0 "INVALID" 1 "NEW" 2 "MEASURED" 3 "PREDICTED";
VAL_ 1374 ARC_OD_Classification_Obj_27_FR 0 "Unknow" 1 "Person" 2 "Bimo" 3 "Car" 4 "Truck" 5 "Barrier" 6 "Reserved" 7 "Reserved";
VAL_ 1374 ARC_OD_DynProp_Obj_27_FR 0 "STATIONAR" 1 "MOVIN" 2 "ONCOMING" 3 "STOPPE" 4 "CROSSING_LEFT2RIGH" 5 "CROSSING_RIGHT2LEF" 6 "RESERVE" 7 "RESERVED";
VAL_ 1374 ARC_OD_MaintenanceState_Obj_0034 0 "INVALID" 1 "NEW" 2 "MEASURED" 3 "PREDICTED";
VAL_ 1373 ARC_OD_Classification_Obj_24_FR 0 "Unknow" 1 "Person" 2 "Bimo" 3 "Car" 4 "Truck" 5 "Barrier" 6 "Reserved" 7 "Reserved";
VAL_ 1373 ARC_OD_DynProp_Obj_24_FR 0 "MOVING" 1 "STATIONARY" 2 "ONCOMING" 3 "CROSSING_LEFT2RIGHT" 4 "CROSSING_RIGHT2LEFT" 5 "UNKNOWN" 6 "STOPPED" 7 "RESERVED";
VAL_ 1373 ARC_OD_MaintenanceState_Obj_0035 0 "INVALID" 1 "NEW" 2 "MEASURED" 3 "PREDICTED";
VAL_ 1373 ARC_OD_Classification_Obj_25_FR 0 "Unknow" 1 "Person" 2 "Bimo" 3 "Car" 4 "Truck" 5 "Barrier" 6 "Reserved" 7 "Reserved";
VAL_ 1373 ARC_OD_DynProp_Obj_25_FR 0 "STATIONAR" 1 "MOVIN" 2 "ONCOMING" 3 "STOPPE" 4 "CROSSING_LEFT2RIGH" 5 "CROSSING_RIGHT2LEF" 6 "RESERVE" 7 "RESERVED";
VAL_ 1373 ARC_OD_MaintenanceState_Obj_0036 0 "INVALID" 1 "NEW" 2 "MEASURED" 3 "PREDICTED";
