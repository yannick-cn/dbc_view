VERSION "created by canmatrix"

NS_ :

BS_:

BU_: ARC ADC

BO_ 1121 ARC_OD_32_33_RR: 64 ARC
 SG_ DistHeight_Obj_33_RR : 487|8@0+ (0.2,-10) [-10|41] "m" ADC
 SG_ DistHeight_Obj_32_RR : 479|8@0+ (0.2,-10) [-10|41] "m" ADC
 SG_ ARC_OD_DistX_Obj_32_RR : 7|12@0+ (0.1,-152) [-152|257.5] "m" ADC
 SG_ ARC_OD_Classification_Obj_32_RR : 98|3@0+ (1,0) [0|7] "" ADC
 SG_ ARC_OD_AabsYStd_Obj_32_RR : 111|8@0+ (0.25,0) [0|63.75] "m/s^2" ADC
 SG_ ARC_OD_ClassConf_Obj_32_RR : 119|7@0+ (1,0) [0|127] "%" ADC
 SG_ ARC_OD_ProbOfExist_Obj_32_RR : 112|7@0+ (1,0) [0|127] "%" ADC
 SG_ ARC_OD_VabsX_Obj_32_RR : 11|11@0+ (0.125,-128) [-128|127.875] "m/s" ADC
 SG_ ARC_OD_DynProp_Obj_32_RR : 130|3@0+ (1,0) [0|7] "" ADC
 SG_ ARC_OD_Length_Obj_32_RR : 136|7@0+ (0.2,0) [0|25.4] "m" ADC
 SG_ ARC_OD_MaintenanceState_Obj_32_R : 145|2@0+ (1,0) [0|3] "" ADC
 SG_ ARC_OD_Width_Obj_32_RR : 159|7@0+ (0.2,0) [0|25.4] "m" ADC
 SG_ ARC_OD_RCS_Obj_32_RR : 152|9@0+ (0.2,-51.1) [-51.1|51.1] "dBsm" ADC
 SG_ ARC_OD_Orientation_Obj_32_RR : 175|10@0+ (0.01,-5.11) [-5.11|5.12] "rad" ADC
 SG_ ARC_OD_LifeCycle_Obj_32_RR : 207|16@0+ (1,0) [0|65535] "" ADC
 SG_ ARC_OD_DistX_Obj_33_RR : 223|12@0+ (0.1,-152) [-152|257.5] "m" ADC
 SG_ ARC_OD_VabsX_Obj_33_RR : 227|11@0+ (0.125,-128) [-128|127.875] "m/s" ADC
 SG_ ARC_OD_AabsX_Obj_33_RR : 232|9@0+ (0.125,-31.875) [-31.875|32] "m/s^2" ADC
 SG_ ARC_OD_AabsX_Obj_32_RR : 16|9@0+ (0.125,-31.875) [-31.875|32] "m/s^2" ADC
 SG_ ARC_OD_DistY_Obj_33_RR : 255|12@0+ (0.0875,-179.113) [-179.113|179.2] "m" ADC
 SG_ ARC_OD_VabsY_Obj_33_RR : 259|11@0+ (0.125,-128) [-128|127.875] "m/s" ADC
 SG_ ARC_OD_AabsY_Obj_33_RR : 264|9@0+ (0.125,-31.875) [-31.875|32] "m/s^2" ADC
 SG_ ARC_OD_DistXStd_Obj_33_RR : 287|8@0+ (0.05,0) [0|12.75] "m" ADC
 SG_ ARC_OD_DistYStd_Obj_33_RR : 295|8@0+ (0.1,0) [0|25.5] "m" ADC
 SG_ ARC_OD_VabsXStd_Obj_33_RR : 303|7@0+ (0.1,0) [0|12.7] "m/s" ADC
 SG_ ARC_OD_VabsYStd_Obj_33_RR : 296|7@0+ (0.2,0) [0|25.4] "m/s" ADC
 SG_ ARC_OD_AabsXStd_Obj_33_RR : 305|7@0+ (0.25,0) [0|31.75] "m/s^2" ADC
 SG_ ARC_OD_Classification_Obj_33_RR : 314|3@0+ (1,0) [0|7] "" ADC
 SG_ ARC_OD_AabsYStd_Obj_33_RR : 327|8@0+ (0.25,0) [0|63.75] "m/s^2" ADC
 SG_ ARC_OD_ClassConf_Obj_33_RR : 335|7@0+ (1,0) [0|127] "%" ADC
 SG_ ARC_OD_DistY_Obj_32_RR : 39|12@0+ (0.0875,-179.113) [-179.113|179.2] "m" ADC
 SG_ ARC_OD_ProbOfExist_Obj_33_RR : 328|7@0+ (1,0) [0|127] "%" ADC
 SG_ ARC_OD_DynProp_Obj_33_RR : 346|3@0+ (1,0) [0|7] "" ADC
 SG_ ARC_OD_Length_Obj_33_RR : 352|7@0+ (0.2,0) [0|25.4] "m" ADC
 SG_ ARC_OD_MaintenanceState_Obj_33_R : 361|2@0+ (1,0) [0|3] "" ADC
 SG_ ARC_OD_Width_Obj_33_RR : 375|7@0+ (0.2,0) [0|25.4] "m" ADC
 SG_ ARC_OD_RCS_Obj_33_RR : 368|9@0+ (0.2,-51.1) [-51.1|51.1] "dBsm" ADC
 SG_ ARC_OD_Orientation_Obj_33_RR : 391|10@0+ (0.01,-5.11) [-5.11|5.12] "rad" ADC
 SG_ ARC_OD_LifeCycle_Obj_33_RR : 423|16@0+ (1,0) [0|65535] "" ADC
 SG_ ARC_OD_ObstacleProb_Obj_32_RR : 447|7@0+ (1,0) [0|127] "%" ADC
 SG_ ARC_OD_ObstacleProb_Obj_33_RR : 455|7@0+ (1,0) [0|127] "%" ADC
 SG_ ARC_OD_VabsY_Obj_32_RR : 43|11@0+ (0.125,-128) [-128|127.875] "m/s" ADC
 SG_ ARC_OD_ID_32_RR : 463|8@0+ (1,0) [0|255] "" ADC
 SG_ ARC_OD_ID_33_RR : 471|8@0+ (1,0) [0|255] "" ADC
 SG_ ARC_OD_MsgCounter_Obj_32_33_RR : 491|4@0+ (1,0) [0|15] "" ADC
 SG_ ARC_OD_CRC8_Obj_32_33_RR : 511|8@0+ (1,0) [0|256] "" ADC
 SG_ ARC_OD_AabsY_Obj_32_RR : 48|9@0+ (0.125,-31.875) [-31.875|32] "m/s^2" ADC
 SG_ ARC_OD_DistXStd_Obj_32_RR : 71|8@0+ (0.05,0) [0|12.75] "m" ADC
 SG_ ARC_OD_DistYStd_Obj_32_RR : 79|8@0+ (0.1,0) [0|25.5] "m" ADC
 SG_ ARC_OD_VabsXStd_Obj_32_RR : 87|7@0+ (0.1,0) [0|12.7] "m/s" ADC
 SG_ ARC_OD_VabsYStd_Obj_32_RR : 80|7@0+ (0.2,0) [0|25.4] "m/s" ADC
 SG_ ARC_OD_AabsXStd_Obj_32_RR : 89|7@0+ (0.25,0) [0|31.75] "m/s^2" ADC

BO_ 1120 ARC_OD_30_31_RR: 64 ARC
 SG_ DistHeight_Obj_31_RR : 487|8@0+ (0.2,-10) [-10|41] "m" ADC
 SG_ DistHeight_Obj_30_RR : 479|8@0+ (0.2,-10) [-10|41] "m" ADC
 SG_ ARC_OD_DistX_Obj_30_RR : 7|12@0+ (0.1,-152) [-152|257.5] "m" ADC
 SG_ ARC_OD_Classification_Obj_30_RR : 98|3@0+ (1,0) [0|7] "" ADC
 SG_ ARC_OD_AabsYStd_Obj_30_RR : 111|8@0+ (0.25,0) [0|63.75] "m/s^2" ADC
 SG_ ARC_OD_ClassConf_Obj_30_RR : 119|7@0+ (1,0) [0|127] "%" ADC
 SG_ ARC_OD_ProbOfExist_Obj_30_RR : 112|7@0+ (1,0) [0|127] "%" ADC
 SG_ ARC_OD_VabsX_Obj_30_RR : 11|11@0+ (0.125,-128) [-128|127.875] "m/s" ADC
 SG_ ARC_OD_DynProp_Obj_30_RR : 130|3@0+ (1,0) [0|7] "" ADC
 SG_ ARC_OD_Length_Obj_30_RR : 136|7@0+ (0.2,0) [0|25.4] "m" ADC
 SG_ ARC_OD_MaintenanceState_Obj_30_R : 145|2@0+ (1,0) [0|3] "" ADC
 SG_ ARC_OD_Width_Obj_30_RR : 159|7@0+ (0.2,0) [0|25.4] "m" ADC
 SG_ ARC_OD_RCS_Obj_30_RR : 152|9@0+ (0.2,-51.1) [-51.1|51.1] "dBsm" ADC
 SG_ ARC_OD_Orientation_Obj_30_RR : 175|10@0+ (0.01,-5.11) [-5.11|5.12] "rad" ADC
 SG_ ARC_OD_LifeCycle_Obj_30_RR : 207|16@0+ (1,0) [0|65535] "" ADC
 SG_ ARC_OD_DistX_Obj_31_RR : 223|12@0+ (0.1,-152) [-152|257.5] "m" ADC
 SG_ ARC_OD_VabsX_Obj_31_RR : 227|11@0+ (0.125,-128) [-128|127.875] "m/s" ADC
 SG_ ARC_OD_AabsX_Obj_31_RR : 232|9@0+ (0.125,-31.875) [-31.875|32] "m/s^2" ADC
 SG_ ARC_OD_AabsX_Obj_30_RR : 16|9@0+ (0.125,-31.875) [-31.875|32] "m/s^2" ADC
 SG_ ARC_OD_DistY_Obj_31_RR : 255|12@0+ (0.0875,-179.113) [-179.113|179.2] "m" ADC
 SG_ ARC_OD_VabsY_Obj_31_RR : 259|11@0+ (0.125,-128) [-128|127.875] "m/s" ADC
 SG_ ARC_OD_AabsY_Obj_31_RR : 264|9@0+ (0.125,-31.875) [-31.875|32] "m/s^2" ADC
 SG_ ARC_OD_DistXStd_Obj_31_RR : 287|8@0+ (0.05,0) [0|12.75] "m" ADC
 SG_ ARC_OD_DistYStd_Obj_31_RR : 295|8@0+ (0.1,0) [0|25.5] "m" ADC
 SG_ ARC_OD_VabsXStd_Obj_31_RR : 303|7@0+ (0.1,0) [0|12.7] "m/s" ADC
 SG_ ARC_OD_VabsYStd_Obj_31_RR : 296|7@0+ (0.2,0) [0|25.4] "m/s" ADC
 SG_ ARC_OD_AabsXStd_Obj_31_RR : 305|7@0+ (0.25,0) [0|31.75] "m/s^2" ADC
 SG_ ARC_OD_Classification_Obj_31_RR : 314|3@0+ (1,0) [0|7] "" ADC
 SG_ ARC_OD_AabsYStd_Obj_31_RR : 327|8@0+ (0.25,0) [0|63.75] "m/s^2" ADC
 SG_ ARC_OD_ClassConf_Obj_31_RR : 335|7@0+ (1,0) [0|127] "%" ADC
 SG_ ARC_OD_DistY_Obj_30_RR : 39|12@0+ (0.0875,-179.113) [-179.113|179.2] "m" ADC
 SG_ ARC_OD_ProbOfExist_Obj_31_RR : 328|7@0+ (1,0) [0|127] "%" ADC
 SG_ ARC_OD_DynProp_Obj_31_RR : 346|3@0+ (1,0) [0|7] "" ADC
 SG_ ARC_OD_Length_Obj_31_RR : 352|7@0+ (0.2,0) [0|25.4] "m" ADC
 SG_ ARC_OD_MaintenanceState_Obj_31_R : 361|2@0+ (1,0) [0|3] "" ADC
 SG_ ARC_OD_Width_Obj_31_RR : 375|7@0+ (0.2,0) [0|25.4] "m" ADC
 SG_ ARC_OD_RCS_Obj_31_RR : 368|9@0+ (0.2,-51.1) [-51.1|51.1] "dBsm" ADC
 SG_ ARC_OD_Orientation_Obj_31_RR : 391|10@0+ (0.01,-5.11) [-5.11|5.12] "rad" ADC
 SG_ ARC_OD_LifeCycle_Obj_31_RR : 423|16@0+ (1,0) [0|65535] "" ADC
 SG_ ARC_OD_ObstacleProb_Obj_30_RR : 447|7@0+ (1,0) [0|127] "%" ADC
 SG_ ARC_OD_ObstacleProb_Obj_31_RR : 455|7@0+ (1,0) [0|127] "%" ADC
 SG_ ARC_OD_VabsY_Obj_30_RR : 43|11@0+ (0.125,-128) [-128|127.875] "m/s" ADC
 SG_ ARC_OD_ID_30_RR : 463|8@0+ (1,0) [0|255] "" ADC
 SG_ ARC_OD_ID_31_RR : 471|8@0+ (1,0) [0|255] "" ADC
 SG_ ARC_OD_MsgCounter_Obj_30_31_RR : 491|4@0+ (1,0) [0|15] "" ADC
 SG_ ARC_OD_CRC8_Obj_30_31_RR : 511|8@0+ (1,0) [0|256] "" ADC
 SG_ ARC_OD_AabsY_Obj_30_RR : 48|9@0+ (0.125,-31.875) [-31.875|32] "m/s^2" ADC
 SG_ ARC_OD_DistXStd_Obj_30_RR : 71|8@0+ (0.05,0) [0|12.75] "m" ADC
 SG_ ARC_OD_DistYStd_Obj_30_RR : 79|8@0+ (0.1,0) [0|25.5] "m" ADC
 SG_ ARC_OD_VabsXStd_Obj_30_RR : 87|7@0+ (0.1,0) [0|12.7] "m/s" ADC
 SG_ ARC_OD_VabsYStd_Obj_30_RR : 80|7@0+ (0.2,0) [0|25.4] "m/s" ADC
 SG_ ARC_OD_AabsXStd_Obj_30_RR : 89|7@0+ (0.25,0) [0|31.75] "m/s^2" ADC

BO_ 1119 ARC_OD_28_29_RR: 64 ARC
 SG_ DistHeight_Obj_29_RR : 487|8@0+ (0.2,-10) [-10|41] "m" ADC
 SG_ DistHeight_Obj_28_RR : 479|8@0+ (0.2,-10) [-10|41] "m" ADC
 SG_ ARC_OD_DistX_Obj_28_RR : 7|12@0+ (0.1,-152) [-152|257.5] "m" ADC
 SG_ ARC_OD_Classification_Obj_28_RR : 98|3@0+ (1,0) [0|7] "" ADC
 SG_ ARC_OD_AabsYStd_Obj_28_RR : 111|8@0+ (0.25,0) [0|63.75] "m/s^2" ADC
 SG_ ARC_OD_ClassConf_Obj_28_RR : 119|7@0+ (1,0) [0|127] "%" ADC
 SG_ ARC_OD_ProbOfExist_Obj_28_RR : 112|7@0+ (1,0) [0|127] "%" ADC
 SG_ ARC_OD_VabsX_Obj_28_RR : 11|11@0+ (0.125,-128) [-128|127.875] "m/s" ADC
 SG_ ARC_OD_DynProp_Obj_28_RR : 130|3@0+ (1,0) [0|7] "" ADC
 SG_ ARC_OD_Length_Obj_28_RR : 136|7@0+ (0.2,0) [0|25.4] "m" ADC
 SG_ ARC_OD_MaintenanceState_Obj_28_R : 145|2@0+ (1,0) [0|3] "" ADC
 SG_ ARC_OD_Width_Obj_28_RR : 159|7@0+ (0.2,0) [0|25.4] "m" ADC
 SG_ ARC_OD_RCS_Obj_28_RR : 152|9@0+ (0.2,-51.1) [-51.1|51.1] "dBsm" ADC
 SG_ ARC_OD_Orientation_Obj_28_RR : 175|10@0+ (0.01,-5.11) [-5.11|5.12] "rad" ADC
 SG_ ARC_OD_LifeCycle_Obj_28_RR : 207|16@0+ (1,0) [0|65535] "" ADC
 SG_ ARC_OD_DistX_Obj_29_RR : 223|12@0+ (0.1,-152) [-152|257.5] "m" ADC
 SG_ ARC_OD_VabsX_Obj_29_RR : 227|11@0+ (0.125,-128) [-128|127.875] "m/s" ADC
 SG_ ARC_OD_AabsX_Obj_29_RR : 232|9@0+ (0.125,-31.875) [-31.875|32] "m/s^2" ADC
 SG_ ARC_OD_AabsX_Obj_28_RR : 16|9@0+ (0.125,-31.875) [-31.875|32] "m/s^2" ADC
 SG_ ARC_OD_DistY_Obj_29_RR : 255|12@0+ (0.0875,-179.113) [-179.113|179.2] "m" ADC
 SG_ ARC_OD_VabsY_Obj_29_RR : 259|11@0+ (0.125,-128) [-128|127.875] "m/s" ADC
 SG_ ARC_OD_AabsY_Obj_29_RR : 264|9@0+ (0.125,-31.875) [-31.875|32] "m/s^2" ADC
 SG_ ARC_OD_DistXStd_Obj_29_RR : 287|8@0+ (0.05,0) [0|12.75] "m" ADC
 SG_ ARC_OD_DistYStd_Obj_29_RR : 295|8@0+ (0.1,0) [0|25.5] "m" ADC
 SG_ ARC_OD_VabsXStd_Obj_29_RR : 303|7@0+ (0.1,0) [0|12.7] "m/s" ADC
 SG_ ARC_OD_VabsYStd_Obj_29_RR : 296|7@0+ (0.2,0) [0|25.4] "m/s" ADC
 SG_ ARC_OD_AabsXStd_Obj_29_RR : 305|7@0+ (0.25,0) [0|31.75] "m/s^2" ADC
 SG_ ARC_OD_Classification_Obj_29_RR : 314|3@0+ (1,0) [0|7] "" ADC
 SG_ ARC_OD_AabsYStd_Obj_29_RR : 327|8@0+ (0.25,0) [0|63.75] "m/s^2" ADC
 SG_ ARC_OD_ClassConf_Obj_29_RR : 335|7@0+ (1,0) [0|127] "%" ADC
 SG_ ARC_OD_DistY_Obj_28_RR : 39|12@0+ (0.0875,-179.113) [-179.113|179.2] "m" ADC
 SG_ ARC_OD_ProbOfExist_Obj_29_RR : 328|7@0+ (1,0) [0|127] "%" ADC
 SG_ ARC_OD_DynProp_Obj_29_RR : 346|3@0+ (1,0) [0|7] "" ADC
 SG_ ARC_OD_Length_Obj_29_RR : 352|7@0+ (0.2,0) [0|25.4] "m" ADC
 SG_ ARC_OD_MaintenanceState_Obj_29_R : 361|2@0+ (1,0) [0|3] "" ADC
 SG_ ARC_OD_Width_Obj_29_RR : 375|7@0+ (0.2,0) [0|25.4] "m" ADC
 SG_ ARC_OD_RCS_Obj_29_RR : 368|9@0+ (0.2,-51.1) [-51.1|51.1] "dBsm" ADC
 SG_ ARC_OD_Orientation_Obj_29_RR : 391|10@0+ (0.01,-5.11) [-5.11|5.12] "rad" ADC
 SG_ ARC_OD_LifeCycle_Obj_29_RR : 423|16@0+ (1,0) [0|65535] "" ADC
 SG_ ARC_OD_ObstacleProb_Obj_28_RR : 447|7@0+ (1,0) [0|127] "%" ADC
 SG_ ARC_OD_ObstacleProb_Obj_29_RR : 455|7@0+ (1,0) [0|127] "%" ADC
 SG_ ARC_OD_VabsY_Obj_28_RR : 43|11@0+ (0.125,-128) [-128|127.875] "m/s" ADC
 SG_ ARC_OD_ID_28_RR : 463|8@0+ (1,0) [0|255] "" ADC
 SG_ ARC_OD_ID_29_RR : 471|8@0+ (1,0) [0|255] "" ADC
 SG_ ARC_OD_MsgCounter_Obj_28_29_RR : 491|4@0+ (1,0) [0|15] "" ADC
 SG_ ARC_OD_CRC8_Obj_28_29_RR : 511|8@0+ (1,0) [0|256] "" ADC
 SG_ ARC_OD_AabsY_Obj_28_RR : 48|9@0+ (0.125,-31.875) [-31.875|32] "m/s^2" ADC
 SG_ ARC_OD_DistXStd_Obj_28_RR : 71|8@0+ (0.05,0) [0|12.75] "m" ADC
 SG_ ARC_OD_DistYStd_Obj_28_RR : 79|8@0+ (0.1,0) [0|25.5] "m" ADC
 SG_ ARC_OD_VabsXStd_Obj_28_RR : 87|7@0+ (0.1,0) [0|12.7] "m/s" ADC
 SG_ ARC_OD_VabsYStd_Obj_28_RR : 80|7@0+ (0.2,0) [0|25.4] "m/s" ADC
 SG_ ARC_OD_AabsXStd_Obj_28_RR : 89|7@0+ (0.25,0) [0|31.75] "m/s^2" ADC

BO_ 1118 ARC_OD_26_27_RR: 64 ARC
 SG_ DistHeight_Obj_27_RR : 487|8@0+ (0.2,-10) [-10|41] "m" ADC
 SG_ DistHeight_Obj_26_RR : 479|8@0+ (0.2,-10) [-10|41] "m" ADC
 SG_ ARC_OD_DistX_Obj_26_RR : 7|12@0+ (0.1,-152) [-152|257.5] "m" ADC
 SG_ ARC_OD_Classification_Obj_26_RR : 98|3@0+ (1,0) [0|7] "" ADC
 SG_ ARC_OD_AabsYStd_Obj_26_RR : 111|8@0+ (0.25,0) [0|63.75] "m/s^2" ADC
 SG_ ARC_OD_ClassConf_Obj_26_RR : 119|7@0+ (1,0) [0|127] "%" ADC
 SG_ ARC_OD_ProbOfExist_Obj_26_RR : 112|7@0+ (1,0) [0|127] "%" ADC
 SG_ ARC_OD_VabsX_Obj_26_RR : 11|11@0+ (0.125,-128) [-128|127.875] "m/s" ADC
 SG_ ARC_OD_DynProp_Obj_26_RR : 130|3@0+ (1,0) [0|7] "" ADC
 SG_ ARC_OD_Length_Obj_26_RR : 136|7@0+ (0.2,0) [0|25.4] "m" ADC
 SG_ ARC_OD_MaintenanceState_Obj_26_R : 145|2@0+ (1,0) [0|3] "" ADC
 SG_ ARC_OD_Width_Obj_26_RR : 159|7@0+ (0.2,0) [0|25.4] "m" ADC
 SG_ ARC_OD_RCS_Obj_26_RR : 152|9@0+ (0.2,-51.1) [-51.1|51.1] "dBsm" ADC
 SG_ ARC_OD_Orientation_Obj_26_RR : 175|10@0+ (0.01,-5.11) [-5.11|5.12] "rad" ADC
 SG_ ARC_OD_LifeCycle_Obj_26_RR : 207|16@0+ (1,0) [0|65535] "" ADC
 SG_ ARC_OD_DistX_Obj_27_RR : 223|12@0+ (0.1,-152) [-152|257.5] "m" ADC
 SG_ ARC_OD_VabsX_Obj_27_RR : 227|11@0+ (0.125,-128) [-128|127.875] "m/s" ADC
 SG_ ARC_OD_AabsX_Obj_27_RR : 232|9@0+ (0.125,-31.875) [-31.875|32] "m/s^2" ADC
 SG_ ARC_OD_AabsX_Obj_26_RR : 16|9@0+ (0.125,-31.875) [-31.875|32] "m/s^2" ADC
 SG_ ARC_OD_DistY_Obj_27_RR : 255|12@0+ (0.0875,-179.113) [-179.113|179.2] "m" ADC
 SG_ ARC_OD_VabsY_Obj_27_RR : 259|11@0+ (0.125,-128) [-128|127.875] "m/s" ADC
 SG_ ARC_OD_AabsY_Obj_27_RR : 264|9@0+ (0.125,-31.875) [-31.875|32] "m/s^2" ADC
 SG_ ARC_OD_DistXStd_Obj_27_RR : 287|8@0+ (0.05,0) [0|12.75] "m" ADC
 SG_ ARC_OD_DistYStd_Obj_27_RR : 295|8@0+ (0.1,0) [0|25.5] "m" ADC
 SG_ ARC_OD_VabsXStd_Obj_27_RR : 303|7@0+ (0.1,0) [0|12.7] "m/s" ADC
 SG_ ARC_OD_VabsYStd_Obj_27_RR : 296|7@0+ (0.2,0) [0|25.4] "m/s" ADC
 SG_ ARC_OD_AabsXStd_Obj_27_RR : 305|7@0+ (0.25,0) [0|31.75] "m/s^2" ADC
 SG_ ARC_OD_Classification_Obj_27_RR : 314|3@0+ (1,0) [0|7] "" ADC
 SG_ ARC_OD_AabsYStd_Obj_27_RR : 327|8@0+ (0.25,0) [0|63.75] "m/s^2" ADC
 SG_ ARC_OD_ClassConf_Obj_27_RR : 335|7@0+ (1,0) [0|127] "%" ADC
 SG_ ARC_OD_DistY_Obj_26_RR : 39|12@0+ (0.0875,-179.113) [-179.113|179.2] "m" ADC
 SG_ ARC_OD_ProbOfExist_Obj_27_RR : 328|7@0+ (1,0) [0|127] "%" ADC
 SG_ ARC_OD_DynProp_Obj_27_RR : 346|3@0+ (1,0) [0|7] "" ADC
 SG_ ARC_OD_Length_Obj_27_RR : 352|7@0+ (0.2,0) [0|25.4] "m" ADC
 SG_ ARC_OD_MaintenanceState_Obj_27_R : 361|2@0+ (1,0) [0|3] "" ADC
 SG_ ARC_OD_Width_Obj_27_RR : 375|7@0+ (0.2,0) [0|25.4] "m" ADC
 SG_ ARC_OD_RCS_Obj_27_RR : 368|9@0+ (0.2,-51.1) [-51.1|51.1] "dBsm" ADC
 SG_ ARC_OD_Orientation_Obj_27_RR : 391|10@0+ (0.01,-5.11) [-5.11|5.12] "rad" ADC
 SG_ ARC_OD_LifeCycle_Obj_27_RR : 423|16@0+ (1,0) [0|65535] "" ADC
 SG_ ARC_OD_ObstacleProb_Obj_26_RR : 447|7@0+ (1,0) [0|127] "%" ADC
 SG_ ARC_OD_ObstacleProb_Obj_27_RR : 455|7@0+ (1,0) [0|127] "%" ADC
 SG_ ARC_OD_VabsY_Obj_26_RR : 43|11@0+ (0.125,-128) [-128|127.875] "m/s" ADC
 SG_ ARC_OD_ID_26_RR : 463|8@0+ (1,0) [0|255] "" ADC
 SG_ ARC_OD_ID_27_RR : 471|8@0+ (1,0) [0|255] "" ADC
 SG_ ARC_OD_MsgCounter_Obj_26_27_RR : 491|4@0+ (1,0) [0|15] "" ADC
 SG_ ARC_OD_CRC8_Obj_26_27_RR : 511|8@0+ (1,0) [0|256] "" ADC
 SG_ ARC_OD_AabsY_Obj_26_RR : 48|9@0+ (0.125,-31.875) [-31.875|32] "m/s^2" ADC
 SG_ ARC_OD_DistXStd_Obj_26_RR : 71|8@0+ (0.05,0) [0|12.75] "m" ADC
 SG_ ARC_OD_DistYStd_Obj_26_RR : 79|8@0+ (0.1,0) [0|25.5] "m" ADC
 SG_ ARC_OD_VabsXStd_Obj_26_RR : 87|7@0+ (0.1,0) [0|12.7] "m/s" ADC
 SG_ ARC_OD_VabsYStd_Obj_26_RR : 80|7@0+ (0.2,0) [0|25.4] "m/s" ADC
 SG_ ARC_OD_AabsXStd_Obj_26_RR : 89|7@0+ (0.25,0) [0|31.75] "m/s^2" ADC

BO_ 1117 ARC_OD_24_25_RR: 64 ARC
 SG_ DistHeight_Obj_25_RR : 487|8@0+ (0.2,-10) [-10|41] "m" ADC
 SG_ DistHeight_Obj_24_RR : 479|8@0+ (0.2,-10) [-10|41] "m" ADC
 SG_ ARC_OD_DistX_Obj_24_RR : 7|12@0+ (0.1,-152) [-152|257.5] "m" ADC
 SG_ ARC_OD_Classification_Obj_24_RR : 98|3@0+ (1,0) [0|7] "" ADC
 SG_ ARC_OD_AabsYStd_Obj_24_RR : 111|8@0+ (0.25,0) [0|63.75] "m/s^2" ADC
 SG_ ARC_OD_ClassConf_Obj_24_RR : 119|7@0+ (1,0) [0|127] "%" ADC
 SG_ ARC_OD_ProbOfExist_Obj_24_RR : 112|7@0+ (1,0) [0|127] "%" ADC
 SG_ ARC_OD_VabsX_Obj_24_RR : 11|11@0+ (0.125,-128) [-128|127.875] "m/s" ADC
 SG_ ARC_OD_DynProp_Obj_24_RR : 130|3@0+ (1,0) [0|7] "" ADC
 SG_ ARC_OD_Length_Obj_24_RR : 136|7@0+ (0.2,0) [0|25.4] "m" ADC
 SG_ ARC_OD_MaintenanceState_Obj_24_R : 145|2@0+ (1,0) [0|3] "" ADC
 SG_ ARC_OD_Width_Obj_24_RR : 159|7@0+ (0.2,0) [0|25.4] "m" ADC
 SG_ ARC_OD_RCS_Obj_24_RR : 152|9@0+ (0.2,-51.1) [-51.1|51.1] "dBsm" ADC
 SG_ ARC_OD_Orientation_Obj_24_RR : 175|10@0+ (0.01,-5.11) [-5.11|5.12] "rad" ADC
 SG_ ARC_OD_LifeCycle_Obj_24_RR : 207|16@0+ (1,0) [0|65535] "" ADC
 SG_ ARC_OD_DistX_Obj_25_RR : 223|12@0+ (0.1,-152) [-152|257.5] "m" ADC
 SG_ ARC_OD_VabsX_Obj_25_RR : 227|11@0+ (0.125,-128) [-128|127.875] "m/s" ADC
 SG_ ARC_OD_AabsX_Obj_25_RR : 232|9@0+ (0.125,-31.875) [-31.875|32] "m/s^2" ADC
 SG_ ARC_OD_AabsX_Obj_24_RR : 16|9@0+ (0.125,-31.875) [-31.875|32] "m/s^2" ADC
 SG_ ARC_OD_DistY_Obj_25_RR : 255|12@0+ (0.0875,-179.113) [-179.113|179.2] "m" ADC
 SG_ ARC_OD_VabsY_Obj_25_RR : 259|11@0+ (0.125,-128) [-128|127.875] "m/s" ADC
 SG_ ARC_OD_AabsY_Obj_25_RR : 264|9@0+ (0.125,-31.875) [-31.875|32] "m/s^2" ADC
 SG_ ARC_OD_DistXStd_Obj_25_RR : 287|8@0+ (0.05,0) [0|12.75] "m" ADC
 SG_ ARC_OD_DistYStd_Obj_25_RR : 295|8@0+ (0.1,0) [0|25.5] "m" ADC
 SG_ ARC_OD_VabsXStd_Obj_25_RR : 303|7@0+ (0.1,0) [0|12.7] "m/s" ADC
 SG_ ARC_OD_VabsYStd_Obj_25_RR : 296|7@0+ (0.2,0) [0|25.4] "m/s" ADC
 SG_ ARC_OD_AabsXStd_Obj_25_RR : 305|7@0+ (0.25,0) [0|31.75] "m/s^2" ADC
 SG_ ARC_OD_Classification_Obj_25_RR : 314|3@0+ (1,0) [0|7] "" ADC
 SG_ ARC_OD_AabsYStd_Obj_25_RR : 327|8@0+ (0.25,0) [0|63.75] "m/s^2" ADC
 SG_ ARC_OD_ClassConf_Obj_25_RR : 335|7@0+ (1,0) [0|127] "%" ADC
 SG_ ARC_OD_DistY_Obj_24_RR : 39|12@0+ (0.0875,-179.113) [-179.113|179.2] "m" ADC
 SG_ ARC_OD_ProbOfExist_Obj_25_RR : 328|7@0+ (1,0) [0|127] "%" ADC
 SG_ ARC_OD_DynProp_Obj_25_RR : 346|3@0+ (1,0) [0|7] "" ADC
 SG_ ARC_OD_Length_Obj_25_RR : 352|7@0+ (0.2,0) [0|25.4] "m" ADC
 SG_ ARC_OD_MaintenanceState_Obj_25_R : 361|2@0+ (1,0) [0|3] "" ADC
 SG_ ARC_OD_Width_Obj_25_RR : 375|7@0+ (0.2,0) [0|25.4] "m" ADC
 SG_ ARC_OD_RCS_Obj_25_RR : 368|9@0+ (0.2,-51.1) [-51.1|51.1] "dBsm" ADC
 SG_ ARC_OD_Orientation_Obj_25_RR : 391|10@0+ (0.01,-5.11) [-5.11|5.12] "rad" ADC
 SG_ ARC_OD_LifeCycle_Obj_25_RR : 423|16@0+ (1,0) [0|65535] "" ADC
 SG_ ARC_OD_ObstacleProb_Obj_24_RR : 447|7@0+ (1,0) [0|127] "%" ADC
 SG_ ARC_OD_ObstacleProb_Obj_25_RR : 455|7@0+ (1,0) [0|127] "%" ADC
 SG_ ARC_OD_VabsY_Obj_24_RR : 43|11@0+ (0.125,-128) [-128|127.875] "m/s" ADC
 SG_ ARC_OD_ID_24_RR : 463|8@0+ (1,0) [0|255] "" ADC
 SG_ ARC_OD_ID_25_RR : 471|8@0+ (1,0) [0|255] "" ADC
 SG_ ARC_OD_MsgCounter_Obj_24_25_RR : 491|4@0+ (1,0) [0|15] "" ADC
 SG_ ARC_OD_CRC8_Obj_24_25_RR : 511|8@0+ (1,0) [0|256] "" ADC
 SG_ ARC_OD_AabsY_Obj_24_RR : 48|9@0+ (0.125,-31.875) [-31.875|32] "m/s^2" ADC
 SG_ ARC_OD_DistXStd_Obj_24_RR : 71|8@0+ (0.05,0) [0|12.75] "m" ADC
 SG_ ARC_OD_DistYStd_Obj_24_RR : 79|8@0+ (0.1,0) [0|25.5] "m" ADC
 SG_ ARC_OD_VabsXStd_Obj_24_RR : 87|7@0+ (0.1,0) [0|12.7] "m/s" ADC
 SG_ ARC_OD_VabsYStd_Obj_24_RR : 80|7@0+ (0.2,0) [0|25.4] "m/s" ADC
 SG_ ARC_OD_AabsXStd_Obj_24_RR : 89|7@0+ (0.25,0) [0|31.75] "m/s^2" ADC

BO_ 1116 ARC_OD_22_23_RR: 64 ARC
 SG_ DistHeight_Obj_23_RR : 487|8@0+ (0.2,-10) [-10|41] "m" ADC
 SG_ DistHeight_Obj_22_RR : 479|8@0+ (0.2,-10) [-10|41] "m" ADC
 SG_ ARC_OD_DistX_Obj_22_RR : 7|12@0+ (0.1,-152) [-152|257.5] "m" ADC
 SG_ ARC_OD_Classification_Obj_22_RR : 98|3@0+ (1,0) [0|7] "" ADC
 SG_ ARC_OD_AabsYStd_Obj_22_RR : 111|8@0+ (0.25,0) [0|63.75] "m/s^2" ADC
 SG_ ARC_OD_ClassConf_Obj_22_RR : 119|7@0+ (1,0) [0|127] "%" ADC
 SG_ ARC_OD_ProbOfExist_Obj_22_RR : 112|7@0+ (1,0) [0|127] "%" ADC
 SG_ ARC_OD_VabsX_Obj_22_RR : 11|11@0+ (0.125,-128) [-128|127.875] "m/s" ADC
 SG_ ARC_OD_DynProp_Obj_22_RR : 130|3@0+ (1,0) [0|7] "" ADC
 SG_ ARC_OD_Length_Obj_22_RR : 136|7@0+ (0.2,0) [0|25.4] "m" ADC
 SG_ ARC_OD_MaintenanceState_Obj_22_R : 145|2@0+ (1,0) [0|3] "" ADC
 SG_ ARC_OD_Width_Obj_22_RR : 159|7@0+ (0.2,0) [0|25.4] "m" ADC
 SG_ ARC_OD_RCS_Obj_22_RR : 152|9@0+ (0.2,-51.1) [-51.1|51.1] "dBsm" ADC
 SG_ ARC_OD_Orientation_Obj_22_RR : 175|10@0+ (0.01,-5.11) [-5.11|5.12] "rad" ADC
 SG_ ARC_OD_LifeCycle_Obj_22_RR : 207|16@0+ (1,0) [0|65535] "" ADC
 SG_ ARC_OD_DistX_Obj_23_RR : 223|12@0+ (0.1,-152) [-152|257.5] "m" ADC
 SG_ ARC_OD_VabsX_Obj_23_RR : 227|11@0+ (0.125,-128) [-128|127.875] "m/s" ADC
 SG_ ARC_OD_AabsX_Obj_23_RR : 232|9@0+ (0.125,-31.875) [-31.875|32] "m/s^2" ADC
 SG_ ARC_OD_AabsX_Obj_22_RR : 16|9@0+ (0.125,-31.875) [-31.875|32] "m/s^2" ADC
 SG_ ARC_OD_DistY_Obj_23_RR : 255|12@0+ (0.0875,-179.113) [-179.113|179.2] "m" ADC
 SG_ ARC_OD_VabsY_Obj_23_RR : 259|11@0+ (0.125,-128) [-128|127.875] "m/s" ADC
 SG_ ARC_OD_AabsY_Obj_23_RR : 264|9@0+ (0.125,-31.875) [-31.875|32] "m/s^2" ADC
 SG_ ARC_OD_DistXStd_Obj_23_RR : 287|8@0+ (0.05,0) [0|12.75] "m" ADC
 SG_ ARC_OD_DistYStd_Obj_23_RR : 295|8@0+ (0.1,0) [0|25.5] "m" ADC
 SG_ ARC_OD_VabsXStd_Obj_23_RR : 303|7@0+ (0.1,0) [0|12.7] "m/s" ADC
 SG_ ARC_OD_VabsYStd_Obj_23_RR : 296|7@0+ (0.2,0) [0|25.4] "m/s" ADC
 SG_ ARC_OD_AabsXStd_Obj_23_RR : 305|7@0+ (0.25,0) [0|31.75] "m/s^2" ADC
 SG_ ARC_OD_Classification_Obj_23_RR : 314|3@0+ (1,0) [0|7] "" ADC
 SG_ ARC_OD_AabsYStd_Obj_23_RR : 327|8@0+ (0.25,0) [0|63.75] "m/s^2" ADC
 SG_ ARC_OD_ClassConf_Obj_23_RR : 335|7@0+ (1,0) [0|127] "%" ADC
 SG_ ARC_OD_DistY_Obj_22_RR : 39|12@0+ (0.0875,-179.113) [-179.113|179.2] "m" ADC
 SG_ ARC_OD_ProbOfExist_Obj_23_RR : 328|7@0+ (1,0) [0|127] "%" ADC
 SG_ ARC_OD_DynProp_Obj_23_RR : 346|3@0+ (1,0) [0|7] "" ADC
 SG_ ARC_OD_Length_Obj_23_RR : 352|7@0+ (0.2,0) [0|25.4] "m" ADC
 SG_ ARC_OD_MaintenanceState_Obj_23_R : 361|2@0+ (1,0) [0|3] "" ADC
 SG_ ARC_OD_Width_Obj_23_RR : 375|7@0+ (0.2,0) [0|25.4] "m" ADC
 SG_ ARC_OD_RCS_Obj_23_RR : 368|9@0+ (0.2,-51.1) [-51.1|51.1] "dBsm" ADC
 SG_ ARC_OD_Orientation_Obj_23_RR : 391|10@0+ (0.01,-5.11) [-5.11|5.12] "rad" ADC
 SG_ ARC_OD_LifeCycle_Obj_23_RR : 423|16@0+ (1,0) [0|65535] "" ADC
 SG_ ARC_OD_ObstacleProb_Obj_22_RR : 447|7@0+ (1,0) [0|127] "%" ADC
 SG_ ARC_OD_ObstacleProb_Obj_23_RR : 455|7@0+ (1,0) [0|127] "%" ADC
 SG_ ARC_OD_VabsY_Obj_22_RR : 43|11@0+ (0.125,-128) [-128|127.875] "m/s" ADC
 SG_ ARC_OD_ID_22_RR : 463|8@0+ (1,0) [0|255] "" ADC
 SG_ ARC_OD_ID_23_RR : 471|8@0+ (1,0) [0|255] "" ADC
 SG_ ARC_OD_MsgCounter_Obj_22_23_RR : 491|4@0+ (1,0) [0|15] "" ADC
 SG_ ARC_OD_CRC8_Obj_22_23_RR : 511|8@0+ (1,0) [0|256] "" ADC
 SG_ ARC_OD_AabsY_Obj_22_RR : 48|9@0+ (0.125,-31.875) [-31.875|32] "m/s^2" ADC
 SG_ ARC_OD_DistXStd_Obj_22_RR : 71|8@0+ (0.05,0) [0|12.75] "m" ADC
 SG_ ARC_OD_DistYStd_Obj_22_RR : 79|8@0+ (0.1,0) [0|25.5] "m" ADC
 SG_ ARC_OD_VabsXStd_Obj_22_RR : 87|7@0+ (0.1,0) [0|12.7] "m/s" ADC
 SG_ ARC_OD_VabsYStd_Obj_22_RR : 80|7@0+ (0.2,0) [0|25.4] "m/s" ADC
 SG_ ARC_OD_AabsXStd_Obj_22_RR : 89|7@0+ (0.25,0) [0|31.75] "m/s^2" ADC

BO_ 1115 ARC_OD_20_21_RR: 64 ARC
 SG_ DistHeight_Obj_21_RR : 487|8@0+ (0.2,-10) [-10|41] "m" ADC
 SG_ DistHeight_Obj_20_RR : 479|8@0+ (0.2,-10) [-10|41] "m" ADC
 SG_ ARC_OD_DistX_Obj_20_RR : 7|12@0+ (0.1,-152) [-152|257.5] "m" ADC
 SG_ ARC_OD_Classification_Obj_20_RR : 98|3@0+ (1,0) [0|7] "" ADC
 SG_ ARC_OD_AabsYStd_Obj_20_RR : 111|8@0+ (0.25,0) [0|63.75] "m/s^2" ADC
 SG_ ARC_OD_ClassConf_Obj_20_RR : 119|7@0+ (1,0) [0|127] "%" ADC
 SG_ ARC_OD_ProbOfExist_Obj_20_RR : 112|7@0+ (1,0) [0|127] "%" ADC
 SG_ ARC_OD_VabsX_Obj_20_RR : 11|11@0+ (0.125,-128) [-128|127.875] "m/s" ADC
 SG_ ARC_OD_DynProp_Obj_20_RR : 130|3@0+ (1,0) [0|7] "" ADC
 SG_ ARC_OD_Length_Obj_20_RR : 136|7@0+ (0.2,0) [0|25.4] "m" ADC
 SG_ ARC_OD_MaintenanceState_Obj_20_R : 145|2@0+ (1,0) [0|3] "" ADC
 SG_ ARC_OD_Width_Obj_20_RR : 159|7@0+ (0.2,0) [0|25.4] "m" ADC
 SG_ ARC_OD_RCS_Obj_20_RR : 152|9@0+ (0.2,-51.1) [-51.1|51.1] "dBsm" ADC
 SG_ ARC_OD_Orientation_Obj_20_RR : 175|10@0+ (0.01,-5.11) [-5.11|5.12] "rad" ADC
 SG_ ARC_OD_LifeCycle_Obj_20_RR : 207|16@0+ (1,0) [0|65535] "" ADC
 SG_ ARC_OD_DistX_Obj_21_RR : 223|12@0+ (0.1,-152) [-152|257.5] "m" ADC
 SG_ ARC_OD_VabsX_Obj_21_RR : 227|11@0+ (0.125,-128) [-128|127.875] "m/s" ADC
 SG_ ARC_OD_AabsX_Obj_21_RR : 232|9@0+ (0.125,-31.875) [-31.875|32] "m/s^2" ADC
 SG_ ARC_OD_AabsX_Obj_20_RR : 16|9@0+ (0.125,-31.875) [-31.875|32] "m/s^2" ADC
 SG_ ARC_OD_DistY_Obj_21_RR : 255|12@0+ (0.0875,-179.113) [-179.113|179.2] "m" ADC
 SG_ ARC_OD_VabsY_Obj_21_RR : 259|11@0+ (0.125,-128) [-128|127.875] "m/s" ADC
 SG_ ARC_OD_AabsY_Obj_21_RR : 264|9@0+ (0.125,-31.875) [-31.875|32] "m/s^2" ADC
 SG_ ARC_OD_DistXStd_Obj_21_RR : 287|8@0+ (0.05,0) [0|12.75] "m" ADC
 SG_ ARC_OD_DistYStd_Obj_21_RR : 295|8@0+ (0.1,0) [0|25.5] "m" ADC
 SG_ ARC_OD_VabsXStd_Obj_21_RR : 303|7@0+ (0.1,0) [0|12.7] "m/s" ADC
 SG_ ARC_OD_VabsYStd_Obj_21_RR : 296|7@0+ (0.2,0) [0|25.4] "m/s" ADC
 SG_ ARC_OD_AabsXStd_Obj_21_RR : 305|7@0+ (0.25,0) [0|31.75] "m/s^2" ADC
 SG_ ARC_OD_Classification_Obj_21_RR : 314|3@0+ (1,0) [0|7] "" ADC
 SG_ ARC_OD_AabsYStd_Obj_21_RR : 327|8@0+ (0.25,0) [0|63.75] "m/s^2" ADC
 SG_ ARC_OD_ClassConf_Obj_21_RR : 335|7@0+ (1,0) [0|127] "%" ADC
 SG_ ARC_OD_DistY_Obj_20_RR : 39|12@0+ (0.0875,-179.113) [-179.113|179.2] "m" ADC
 SG_ ARC_OD_ProbOfExist_Obj_21_RR : 328|7@0+ (1,0) [0|127] "%" ADC
 SG_ ARC_OD_DynProp_Obj_21_RR : 346|3@0+ (1,0) [0|7] "" ADC
 SG_ ARC_OD_Length_Obj_21_RR : 352|7@0+ (0.2,0) [0|25.4] "m" ADC
 SG_ ARC_OD_MaintenanceState_Obj_21_R : 361|2@0+ (1,0) [0|3] "" ADC
 SG_ ARC_OD_Width_Obj_21_RR : 375|7@0+ (0.2,0) [0|25.4] "m" ADC
 SG_ ARC_OD_RCS_Obj_21_RR : 368|9@0+ (0.2,-51.1) [-51.1|51.1] "dBsm" ADC
 SG_ ARC_OD_Orientation_Obj_21_RR : 391|10@0+ (0.01,-5.11) [-5.11|5.12] "rad" ADC
 SG_ ARC_OD_LifeCycle_Obj_21_RR : 423|16@0+ (1,0) [0|65535] "" ADC
 SG_ ARC_OD_ObstacleProb_Obj_20_RR : 447|7@0+ (1,0) [0|127] "%" ADC
 SG_ ARC_OD_ObstacleProb_Obj_21_RR : 455|7@0+ (1,0) [0|127] "%" ADC
 SG_ ARC_OD_VabsY_Obj_20_RR : 43|11@0+ (0.125,-128) [-128|127.875] "m/s" ADC
 SG_ ARC_OD_ID_20_RR : 463|8@0+ (1,0) [0|255] "" ADC
 SG_ ARC_OD_ID_21_RR : 471|8@0+ (1,0) [0|255] "" ADC
 SG_ ARC_OD_MsgCounter_Obj_20_21_RR : 491|4@0+ (1,0) [0|15] "" ADC
 SG_ ARC_OD_CRC8_Obj_20_21_RR : 511|8@0+ (1,0) [0|256] "" ADC
 SG_ ARC_OD_AabsY_Obj_20_RR : 48|9@0+ (0.125,-31.875) [-31.875|32] "m/s^2" ADC
 SG_ ARC_OD_DistXStd_Obj_20_RR : 71|8@0+ (0.05,0) [0|12.75] "m" ADC
 SG_ ARC_OD_DistYStd_Obj_20_RR : 79|8@0+ (0.1,0) [0|25.5] "m" ADC
 SG_ ARC_OD_VabsXStd_Obj_20_RR : 87|7@0+ (0.1,0) [0|12.7] "m/s" ADC
 SG_ ARC_OD_VabsYStd_Obj_20_RR : 80|7@0+ (0.2,0) [0|25.4] "m/s" ADC
 SG_ ARC_OD_AabsXStd_Obj_20_RR : 89|7@0+ (0.25,0) [0|31.75] "m/s^2" ADC

BO_ 1114 ARC_OD_18_19_RR: 64 ARC
 SG_ DistHeight_Obj_19_RR : 487|8@0+ (0.2,-10) [-10|41] "m" ADC
 SG_ DistHeight_Obj_18_RR : 479|8@0+ (0.2,-10) [-10|41] "m" ADC
 SG_ ARC_OD_DistX_Obj_18_RR : 7|12@0+ (0.1,-152) [-152|257.5] "m" ADC
 SG_ ARC_OD_Classification_Obj_18_RR : 98|3@0+ (1,0) [0|7] "" ADC
 SG_ ARC_OD_AabsYStd_Obj_18_RR : 111|8@0+ (0.25,0) [0|63.75] "m/s^2" ADC
 SG_ ARC_OD_ClassConf_Obj_18_RR : 119|7@0+ (1,0) [0|127] "%" ADC
 SG_ ARC_OD_ProbOfExist_Obj_18_RR : 112|7@0+ (1,0) [0|127] "%" ADC
 SG_ ARC_OD_VabsX_Obj_18_RR : 11|11@0+ (0.125,-128) [-128|127.875] "m/s" ADC
 SG_ ARC_OD_DynProp_Obj_18_RR : 130|3@0+ (1,0) [0|7] "" ADC
 SG_ ARC_OD_Length_Obj_18_RR : 136|7@0+ (0.2,0) [0|25.4] "m" ADC
 SG_ ARC_OD_MaintenanceState_Obj_18_R : 145|2@0+ (1,0) [0|3] "" ADC
 SG_ ARC_OD_Width_Obj_18_RR : 159|7@0+ (0.2,0) [0|25.4] "m" ADC
 SG_ ARC_OD_RCS_Obj_18_RR : 152|9@0+ (0.2,-51.1) [-51.1|51.1] "dBsm" ADC
 SG_ ARC_OD_Orientation_Obj_18_RR : 175|10@0+ (0.01,-5.11) [-5.11|5.12] "rad" ADC
 SG_ ARC_OD_LifeCycle_Obj_18_RR : 207|16@0+ (1,0) [0|65535] "" ADC
 SG_ ARC_OD_DistX_Obj_19_RR : 223|12@0+ (0.1,-152) [-152|257.5] "m" ADC
 SG_ ARC_OD_VabsX_Obj_19_RR : 227|11@0+ (0.125,-128) [-128|127.875] "m/s" ADC
 SG_ ARC_OD_AabsX_Obj_19_RR : 232|9@0+ (0.125,-31.875) [-31.875|32] "m/s^2" ADC
 SG_ ARC_OD_AabsX_Obj_18_RR : 16|9@0+ (0.125,-31.875) [-31.875|32] "m/s^2" ADC
 SG_ ARC_OD_DistY_Obj_19_RR : 255|12@0+ (0.0875,-179.113) [-179.113|179.2] "m" ADC
 SG_ ARC_OD_VabsY_Obj_19_RR : 259|11@0+ (0.125,-128) [-128|127.875] "m/s" ADC
 SG_ ARC_OD_AabsY_Obj_19_RR : 264|9@0+ (0.125,-31.875) [-31.875|32] "m/s^2" ADC
 SG_ ARC_OD_DistXStd_Obj_19_RR : 287|8@0+ (0.05,0) [0|12.75] "m" ADC
 SG_ ARC_OD_DistYStd_Obj_19_RR : 295|8@0+ (0.1,0) [0|25.5] "m" ADC
 SG_ ARC_OD_VabsXStd_Obj_19_RR : 303|7@0+ (0.1,0) [0|12.7] "m/s" ADC
 SG_ ARC_OD_VabsYStd_Obj_19_RR : 296|7@0+ (0.2,0) [0|25.4] "m/s" ADC
 SG_ ARC_OD_AabsXStd_Obj_19_RR : 305|7@0+ (0.25,0) [0|31.75] "m/s^2" ADC
 SG_ ARC_OD_Classification_Obj_19_RR : 314|3@0+ (1,0) [0|7] "" ADC
 SG_ ARC_OD_AabsYStd_Obj_19_RR : 327|8@0+ (0.25,0) [0|63.75] "m/s^2" ADC
 SG_ ARC_OD_ClassConf_Obj_19_RR : 335|7@0+ (1,0) [0|127] "%" ADC
 SG_ ARC_OD_DistY_Obj_18_RR : 39|12@0+ (0.0875,-179.113) [-179.113|179.2] "m" ADC
 SG_ ARC_OD_ProbOfExist_Obj_19_RR : 328|7@0+ (1,0) [0|127] "%" ADC
 SG_ ARC_OD_DynProp_Obj_19_RR : 346|3@0+ (1,0) [0|7] "" ADC
 SG_ ARC_OD_Length_Obj_19_RR : 352|7@0+ (0.2,0) [0|25.4] "m" ADC
 SG_ ARC_OD_MaintenanceState_Obj_19_R : 361|2@0+ (1,0) [0|3] "" ADC
 SG_ ARC_OD_Width_Obj_19_RR : 375|7@0+ (0.2,0) [0|25.4] "m" ADC
 SG_ ARC_OD_RCS_Obj_19_RR : 368|9@0+ (0.2,-51.1) [-51.1|51.1] "dBsm" ADC
 SG_ ARC_OD_Orientation_Obj_19_RR : 391|10@0+ (0.01,-5.11) [-5.11|5.12] "rad" ADC
 SG_ ARC_OD_LifeCycle_Obj_19_RR : 423|16@0+ (1,0) [0|65535] "" ADC
 SG_ ARC_OD_ObstacleProb_Obj_18_RR : 447|7@0+ (1,0) [0|127] "%" ADC
 SG_ ARC_OD_ObstacleProb_Obj_19_RR : 455|7@0+ (1,0) [0|127] "%" ADC
 SG_ ARC_OD_VabsY_Obj_18_RR : 43|11@0+ (0.125,-128) [-128|127.875] "m/s" ADC
 SG_ ARC_OD_ID_18_RR : 463|8@0+ (1,0) [0|255] "" ADC
 SG_ ARC_OD_ID_19_RR : 471|8@0+ (1,0) [0|255] "" ADC
 SG_ ARC_OD_MsgCounter_Obj_18_19_RR : 491|4@0+ (1,0) [0|15] "" ADC
 SG_ ARC_OD_CRC8_Obj_18_19_RR : 511|8@0+ (1,0) [0|256] "" ADC
 SG_ ARC_OD_AabsY_Obj_18_RR : 48|9@0+ (0.125,-31.875) [-31.875|32] "m/s^2" ADC
 SG_ ARC_OD_DistXStd_Obj_18_RR : 71|8@0+ (0.05,0) [0|12.75] "m" ADC
 SG_ ARC_OD_DistYStd_Obj_18_RR : 79|8@0+ (0.1,0) [0|25.5] "m" ADC
 SG_ ARC_OD_VabsXStd_Obj_18_RR : 87|7@0+ (0.1,0) [0|12.7] "m/s" ADC
 SG_ ARC_OD_VabsYStd_Obj_18_RR : 80|7@0+ (0.2,0) [0|25.4] "m/s" ADC
 SG_ ARC_OD_AabsXStd_Obj_18_RR : 89|7@0+ (0.25,0) [0|31.75] "m/s^2" ADC

BO_ 1113 ARC_OD_16_17_RR: 64 ARC
 SG_ DistHeight_Obj_17_RR : 487|8@0+ (0.2,-10) [-10|41] "m" ADC
 SG_ DistHeight_Obj_16_RR : 479|8@0+ (0.2,-10) [-10|41] "m" ADC
 SG_ ARC_OD_DistX_Obj_16_RR : 7|12@0+ (0.1,-152) [-152|257.5] "m" ADC
 SG_ ARC_OD_Classification_Obj_16_RR : 98|3@0+ (1,0) [0|7] "" ADC
 SG_ ARC_OD_AabsYStd_Obj_16_RR : 111|8@0+ (0.25,0) [0|63.75] "m/s^2" ADC
 SG_ ARC_OD_ClassConf_Obj_16_RR : 119|7@0+ (1,0) [0|127] "%" ADC
 SG_ ARC_OD_ProbOfExist_Obj_16_RR : 112|7@0+ (1,0) [0|127] "%" ADC
 SG_ ARC_OD_VabsX_Obj_16_RR : 11|11@0+ (0.125,-128) [-128|127.875] "m/s" ADC
 SG_ ARC_OD_DynProp_Obj_16_RR : 130|3@0+ (1,0) [0|7] "" ADC
 SG_ ARC_OD_Length_Obj_16_RR : 136|7@0+ (0.2,0) [0|25.4] "m" ADC
 SG_ ARC_OD_MaintenanceState_Obj_16_R : 145|2@0+ (1,0) [0|3] "" ADC
 SG_ ARC_OD_Width_Obj_16_RR : 159|7@0+ (0.2,0) [0|25.4] "m" ADC
 SG_ ARC_OD_RCS_Obj_16_RR : 152|9@0+ (0.2,-51.1) [-51.1|51.1] "dBsm" ADC
 SG_ ARC_OD_Orientation_Obj_16_RR : 175|10@0+ (0.01,-5.11) [-5.11|5.12] "rad" ADC
 SG_ ARC_OD_LifeCycle_Obj_16_RR : 207|16@0+ (1,0) [0|65535] "" ADC
 SG_ ARC_OD_DistX_Obj_17_RR : 223|12@0+ (0.1,-152) [-152|257.5] "m" ADC
 SG_ ARC_OD_VabsX_Obj_17_RR : 227|11@0+ (0.125,-128) [-128|127.875] "m/s" ADC
 SG_ ARC_OD_AabsX_Obj_17_RR : 232|9@0+ (0.125,-31.875) [-31.875|32] "m/s^2" ADC
 SG_ ARC_OD_AabsX_Obj_16_RR : 16|9@0+ (0.125,-31.875) [-31.875|32] "m/s^2" ADC
 SG_ ARC_OD_DistY_Obj_17_RR : 255|12@0+ (0.0875,-179.113) [-179.113|179.2] "m" ADC
 SG_ ARC_OD_VabsY_Obj_17_RR : 259|11@0+ (0.125,-128) [-128|127.875] "m/s" ADC
 SG_ ARC_OD_AabsY_Obj_17_RR : 264|9@0+ (0.125,-31.875) [-31.875|32] "m/s^2" ADC
 SG_ ARC_OD_DistXStd_Obj_17_RR : 287|8@0+ (0.05,0) [0|12.75] "m" ADC
 SG_ ARC_OD_DistYStd_Obj_17_RR : 295|8@0+ (0.1,0) [0|25.5] "m" ADC
 SG_ ARC_OD_VabsXStd_Obj_17_RR : 303|7@0+ (0.1,0) [0|12.7] "m/s" ADC
 SG_ ARC_OD_VabsYStd_Obj_17_RR : 296|7@0+ (0.2,0) [0|25.4] "m/s" ADC
 SG_ ARC_OD_AabsXStd_Obj_17_RR : 305|7@0+ (0.25,0) [0|31.75] "m/s^2" ADC
 SG_ ARC_OD_Classification_Obj_17_RR : 314|3@0+ (1,0) [0|7] "" ADC
 SG_ ARC_OD_AabsYStd_Obj_17_RR : 327|8@0+ (0.25,0) [0|63.75] "m/s^2" ADC
 SG_ ARC_OD_ClassConf_Obj_17_RR : 335|7@0+ (1,0) [0|127] "%" ADC
 SG_ ARC_OD_DistY_Obj_16_RR : 39|12@0+ (0.0875,-179.113) [-179.113|179.2] "m" ADC
 SG_ ARC_OD_ProbOfExist_Obj_17_RR : 328|7@0+ (1,0) [0|127] "%" ADC
 SG_ ARC_OD_DynProp_Obj_17_RR : 346|3@0+ (1,0) [0|7] "" ADC
 SG_ ARC_OD_Length_Obj_17_RR : 352|7@0+ (0.2,0) [0|25.4] "m" ADC
 SG_ ARC_OD_MaintenanceState_Obj_17_R : 361|2@0+ (1,0) [0|3] "" ADC
 SG_ ARC_OD_Width_Obj_17_RR : 375|7@0+ (0.2,0) [0|25.4] "m" ADC
 SG_ ARC_OD_RCS_Obj_17_RR : 368|9@0+ (0.2,-51.1) [-51.1|51.1] "dBsm" ADC
 SG_ ARC_OD_Orientation_Obj_17_RR : 391|10@0+ (0.01,-5.11) [-5.11|5.12] "rad" ADC
 SG_ ARC_OD_LifeCycle_Obj_17_RR : 423|16@0+ (1,0) [0|65535] "" ADC
 SG_ ARC_OD_ObstacleProb_Obj_16_RR : 447|7@0+ (1,0) [0|127] "%" ADC
 SG_ ARC_OD_ObstacleProb_Obj_17_RR : 455|7@0+ (1,0) [0|127] "%" ADC
 SG_ ARC_OD_VabsY_Obj_16_RR : 43|11@0+ (0.125,-128) [-128|127.875] "m/s" ADC
 SG_ ARC_OD_ID_16_RR : 463|8@0+ (1,0) [0|255] "" ADC
 SG_ ARC_OD_ID_17_RR : 471|8@0+ (1,0) [0|255] "" ADC
 SG_ ARC_OD_MsgCounter_Obj_16_17_RR : 491|4@0+ (1,0) [0|15] "" ADC
 SG_ ARC_OD_CRC8_Obj_16_17_RR : 511|8@0+ (1,0) [0|256] "" ADC
 SG_ ARC_OD_AabsY_Obj_16_RR : 48|9@0+ (0.125,-31.875) [-31.875|32] "m/s^2" ADC
 SG_ ARC_OD_DistXStd_Obj_16_RR : 71|8@0+ (0.05,0) [0|12.75] "m" ADC
 SG_ ARC_OD_DistYStd_Obj_16_RR : 79|8@0+ (0.1,0) [0|25.5] "m" ADC
 SG_ ARC_OD_VabsXStd_Obj_16_RR : 87|7@0+ (0.1,0) [0|12.7] "m/s" ADC
 SG_ ARC_OD_VabsYStd_Obj_16_RR : 80|7@0+ (0.2,0) [0|25.4] "m/s" ADC
 SG_ ARC_OD_AabsXStd_Obj_16_RR : 89|7@0+ (0.25,0) [0|31.75] "m/s^2" ADC

BO_ 1112 ARC_OD_14_15_RR: 64 ARC
 SG_ DistHeight_Obj_15_RR : 487|8@0+ (0.2,-10) [-10|41] "m" ADC
 SG_ DistHeight_Obj_14_RR : 479|8@0+ (0.2,-10) [-10|41] "m" ADC
 SG_ ARC_OD_DistX_Obj_14_RR : 7|12@0+ (0.1,-152) [-152|257.5] "m" ADC
 SG_ ARC_OD_Classification_Obj_14_RR : 98|3@0+ (1,0) [0|7] "" ADC
 SG_ ARC_OD_AabsYStd_Obj_14_RR : 111|8@0+ (0.25,0) [0|63.75] "m/s^2" ADC
 SG_ ARC_OD_ClassConf_Obj_14_RR : 119|7@0+ (1,0) [0|127] "%" ADC
 SG_ ARC_OD_ProbOfExist_Obj_14_RR : 112|7@0+ (1,0) [0|127] "%" ADC
 SG_ ARC_OD_VabsX_Obj_14_RR : 11|11@0+ (0.125,-128) [-128|127.875] "m/s" ADC
 SG_ ARC_OD_DynProp_Obj_14_RR : 130|3@0+ (1,0) [0|7] "" ADC
 SG_ ARC_OD_Length_Obj_14_RR : 136|7@0+ (0.2,0) [0|25.4] "m" ADC
 SG_ ARC_OD_MaintenanceState_Obj_14_R : 145|2@0+ (1,0) [0|3] "" ADC
 SG_ ARC_OD_Width_Obj_14_RR : 159|7@0+ (0.2,0) [0|25.4] "m" ADC
 SG_ ARC_OD_RCS_Obj_14_RR : 152|9@0+ (0.2,-51.1) [-51.1|51.1] "dBsm" ADC
 SG_ ARC_OD_Orientation_Obj_14_RR : 175|10@0+ (0.01,-5.11) [-5.11|5.12] "rad" ADC
 SG_ ARC_OD_LifeCycle_Obj_14_RR : 207|16@0+ (1,0) [0|65535] "" ADC
 SG_ ARC_OD_DistX_Obj_15_RR : 223|12@0+ (0.1,-152) [-152|257.5] "m" ADC
 SG_ ARC_OD_VabsX_Obj_15_RR : 227|11@0+ (0.125,-128) [-128|127.875] "m/s" ADC
 SG_ ARC_OD_AabsX_Obj_15_RR : 232|9@0+ (0.125,-31.875) [-31.875|32] "m/s^2" ADC
 SG_ ARC_OD_AabsX_Obj_14_RR : 16|9@0+ (0.125,-31.875) [-31.875|32] "m/s^2" ADC
 SG_ ARC_OD_DistY_Obj_15_RR : 255|12@0+ (0.0875,-179.113) [-179.113|179.2] "m" ADC
 SG_ ARC_OD_VabsY_Obj_15_RR : 259|11@0+ (0.125,-128) [-128|127.875] "m/s" ADC
 SG_ ARC_OD_AabsY_Obj_15_RR : 264|9@0+ (0.125,-31.875) [-31.875|32] "m/s^2" ADC
 SG_ ARC_OD_DistXStd_Obj_15_RR : 287|8@0+ (0.05,0) [0|12.75] "m" ADC
 SG_ ARC_OD_DistYStd_Obj_15_RR : 295|8@0+ (0.1,0) [0|25.5] "m" ADC
 SG_ ARC_OD_VabsXStd_Obj_15_RR : 303|7@0+ (0.1,0) [0|12.7] "m/s" ADC
 SG_ ARC_OD_VabsYStd_Obj_15_RR : 296|7@0+ (0.2,0) [0|25.4] "m/s" ADC
 SG_ ARC_OD_AabsXStd_Obj_15_RR : 305|7@0+ (0.25,0) [0|31.75] "m/s^2" ADC
 SG_ ARC_OD_Classification_Obj_15_RR : 314|3@0+ (1,0) [0|7] "" ADC
 SG_ ARC_OD_AabsYStd_Obj_15_RR : 327|8@0+ (0.25,0) [0|63.75] "m/s^2" ADC
 SG_ ARC_OD_ClassConf_Obj_15_RR : 335|7@0+ (1,0) [0|127] "%" ADC
 SG_ ARC_OD_DistY_Obj_14_RR : 39|12@0+ (0.0875,-179.113) [-179.113|179.2] "m" ADC
 SG_ ARC_OD_ProbOfExist_Obj_15_RR : 328|7@0+ (1,0) [0|127] "%" ADC
 SG_ ARC_OD_DynProp_Obj_15_RR : 346|3@0+ (1,0) [0|7] "" ADC
 SG_ ARC_OD_Length_Obj_15_RR : 352|7@0+ (0.2,0) [0|25.4] "m" ADC
 SG_ ARC_OD_MaintenanceState_Obj_15_R : 361|2@0+ (1,0) [0|3] "" ADC
 SG_ ARC_OD_Width_Obj_15_RR : 375|7@0+ (0.2,0) [0|25.4] "m" ADC
 SG_ ARC_OD_RCS_Obj_15_RR : 368|9@0+ (0.2,-51.1) [-51.1|51.1] "dBsm" ADC
 SG_ ARC_OD_Orientation_Obj_15_RR : 391|10@0+ (0.01,-5.11) [-5.11|5.12] "rad" ADC
 SG_ ARC_OD_LifeCycle_Obj_15_RR : 423|16@0+ (1,0) [0|65535] "" ADC
 SG_ ARC_OD_ObstacleProb_Obj_14_RR : 447|7@0+ (1,0) [0|127] "%" ADC
 SG_ ARC_OD_ObstacleProb_Obj_15_RR : 455|7@0+ (1,0) [0|127] "%" ADC
 SG_ ARC_OD_VabsY_Obj_14_RR : 43|11@0+ (0.125,-128) [-128|127.875] "m/s" ADC
 SG_ ARC_OD_ID_14_RR : 463|8@0+ (1,0) [0|255] "" ADC
 SG_ ARC_OD_ID_15_RR : 471|8@0+ (1,0) [0|255] "" ADC
 SG_ ARC_OD_MsgCounter_Obj_14_15_RR : 491|4@0+ (1,0) [0|15] "" ADC
 SG_ ARC_OD_CRC8_Obj_14_15_RR : 511|8@0+ (1,0) [0|256] "" ADC
 SG_ ARC_OD_AabsY_Obj_14_RR : 48|9@0+ (0.125,-31.875) [-31.875|32] "m/s^2" ADC
 SG_ ARC_OD_DistXStd_Obj_14_RR : 71|8@0+ (0.05,0) [0|12.75] "m" ADC
 SG_ ARC_OD_DistYStd_Obj_14_RR : 79|8@0+ (0.1,0) [0|25.5] "m" ADC
 SG_ ARC_OD_VabsXStd_Obj_14_RR : 87|7@0+ (0.1,0) [0|12.7] "m/s" ADC
 SG_ ARC_OD_VabsYStd_Obj_14_RR : 80|7@0+ (0.2,0) [0|25.4] "m/s" ADC
 SG_ ARC_OD_AabsXStd_Obj_14_RR : 89|7@0+ (0.25,0) [0|31.75] "m/s^2" ADC

BO_ 1111 ARC_OD_12_13_RR: 64 ARC
 SG_ DistHeight_Obj_13_RR : 487|8@0+ (0.2,-10) [-10|41] "m" ADC
 SG_ DistHeight_Obj_12_RR : 479|8@0+ (0.2,-10) [-10|41] "m" ADC
 SG_ ARC_OD_DistX_Obj_12_RR : 7|12@0+ (0.1,-152) [-152|257.5] "m" ADC
 SG_ ARC_OD_Classification_Obj_12_RR : 98|3@0+ (1,0) [0|7] "" ADC
 SG_ ARC_OD_AabsYStd_Obj_12_RR : 111|8@0+ (0.25,0) [0|63.75] "m/s^2" ADC
 SG_ ARC_OD_ClassConf_Obj_12_RR : 119|7@0+ (1,0) [0|127] "%" ADC
 SG_ ARC_OD_ProbOfExist_Obj_12_RR : 112|7@0+ (1,0) [0|127] "%" ADC
 SG_ ARC_OD_VabsX_Obj_12_RR : 11|11@0+ (0.125,-128) [-128|127.875] "m/s" ADC
 SG_ ARC_OD_DynProp_Obj_12_RR : 130|3@0+ (1,0) [0|7] "" ADC
 SG_ ARC_OD_Length_Obj_12_RR : 136|7@0+ (0.2,0) [0|25.4] "m" ADC
 SG_ ARC_OD_MaintenanceState_Obj_12_R : 145|2@0+ (1,0) [0|3] "" ADC
 SG_ ARC_OD_Width_Obj_12_RR : 159|7@0+ (0.2,0) [0|25.4] "m" ADC
 SG_ ARC_OD_RCS_Obj_12_RR : 152|9@0+ (0.2,-51.1) [-51.1|51.1] "dBsm" ADC
 SG_ ARC_OD_Orientation_Obj_12_RR : 175|10@0+ (0.01,-5.11) [-5.11|5.12] "rad" ADC
 SG_ ARC_OD_LifeCycle_Obj_12_RR : 207|16@0+ (1,0) [0|65535] "" ADC
 SG_ ARC_OD_DistX_Obj_13_RR : 223|12@0+ (0.1,-152) [-152|257.5] "m" ADC
 SG_ ARC_OD_VabsX_Obj_13_RR : 227|11@0+ (0.125,-128) [-128|127.875] "m/s" ADC
 SG_ ARC_OD_AabsX_Obj_13_RR : 232|9@0+ (0.125,-31.875) [-31.875|32] "m/s^2" ADC
 SG_ ARC_OD_AabsX_Obj_12_RR : 16|9@0+ (0.125,-31.875) [-31.875|32] "m/s^2" ADC
 SG_ ARC_OD_DistY_Obj_13_RR : 255|12@0+ (0.0875,-179.113) [-179.113|179.2] "m" ADC
 SG_ ARC_OD_VabsY_Obj_13_RR : 259|11@0+ (0.125,-128) [-128|127.875] "m/s" ADC
 SG_ ARC_OD_AabsY_Obj_13_RR : 264|9@0+ (0.125,-31.875) [-31.875|32] "m/s^2" ADC
 SG_ ARC_OD_DistXStd_Obj_13_RR : 287|8@0+ (0.05,0) [0|12.75] "m" ADC
 SG_ ARC_OD_DistYStd_Obj_13_RR : 295|8@0+ (0.1,0) [0|25.5] "m" ADC
 SG_ ARC_OD_VabsXStd_Obj_13_RR : 303|7@0+ (0.1,0) [0|12.7] "m/s" ADC
 SG_ ARC_OD_VabsYStd_Obj_13_RR : 296|7@0+ (0.2,0) [0|25.4] "m/s" ADC
 SG_ ARC_OD_AabsXStd_Obj_13_RR : 305|7@0+ (0.25,0) [0|31.75] "m/s^2" ADC
 SG_ ARC_OD_Classification_Obj_13_RR : 314|3@0+ (1,0) [0|7] "" ADC
 SG_ ARC_OD_AabsYStd_Obj_13_RR : 327|8@0+ (0.25,0) [0|63.75] "m/s^2" ADC
 SG_ ARC_OD_ClassConf_Obj_13_RR : 335|7@0+ (1,0) [0|127] "%" ADC
 SG_ ARC_OD_DistY_Obj_12_RR : 39|12@0+ (0.0875,-179.113) [-179.113|179.2] "m" ADC
 SG_ ARC_OD_ProbOfExist_Obj_13_RR : 328|7@0+ (1,0) [0|127] "%" ADC
 SG_ ARC_OD_DynProp_Obj_13_RR : 346|3@0+ (1,0) [0|7] "" ADC
 SG_ ARC_OD_Length_Obj_13_RR : 352|7@0+ (0.2,0) [0|25.4] "m" ADC
 SG_ ARC_OD_MaintenanceState_Obj_13_R : 361|2@0+ (1,0) [0|3] "" ADC
 SG_ ARC_OD_Width_Obj_13_RR : 375|7@0+ (0.2,0) [0|25.4] "m" ADC
 SG_ ARC_OD_RCS_Obj_13_RR : 368|9@0+ (0.2,-51.1) [-51.1|51.1] "dBsm" ADC
 SG_ ARC_OD_Orientation_Obj_13_RR : 391|10@0+ (0.01,-5.11) [-5.11|5.12] "rad" ADC
 SG_ ARC_OD_LifeCycle_Obj_13_RR : 423|16@0+ (1,0) [0|65535] "" ADC
 SG_ ARC_OD_ObstacleProb_Obj_12_RR : 447|7@0+ (1,0) [0|127] "%" ADC
 SG_ ARC_OD_ObstacleProb_Obj_13_RR : 455|7@0+ (1,0) [0|127] "%" ADC
 SG_ ARC_OD_VabsY_Obj_12_RR : 43|11@0+ (0.125,-128) [-128|127.875] "m/s" ADC
 SG_ ARC_OD_ID_12_RR : 463|8@0+ (1,0) [0|255] "" ADC
 SG_ ARC_OD_ID_13_RR : 471|8@0+ (1,0) [0|255] "" ADC
 SG_ ARC_OD_MsgCounter_Obj_12_13_RR : 491|4@0+ (1,0) [0|15] "" ADC
 SG_ ARC_OD_CRC8_Obj_12_13_RR : 511|8@0+ (1,0) [0|256] "" ADC
 SG_ ARC_OD_AabsY_Obj_12_RR : 48|9@0+ (0.125,-31.875) [-31.875|32] "m/s^2" ADC
 SG_ ARC_OD_DistXStd_Obj_12_RR : 71|8@0+ (0.05,0) [0|12.75] "m" ADC
 SG_ ARC_OD_DistYStd_Obj_12_RR : 79|8@0+ (0.1,0) [0|25.5] "m" ADC
 SG_ ARC_OD_VabsXStd_Obj_12_RR : 87|7@0+ (0.1,0) [0|12.7] "m/s" ADC
 SG_ ARC_OD_VabsYStd_Obj_12_RR : 80|7@0+ (0.2,0) [0|25.4] "m/s" ADC
 SG_ ARC_OD_AabsXStd_Obj_12_RR : 89|7@0+ (0.25,0) [0|31.75] "m/s^2" ADC

BO_ 1110 ARC_OD_10_11_RR: 64 ARC
 SG_ DistHeight_Obj_11_RR : 487|8@0+ (0.2,-10) [-10|41] "m" ADC
 SG_ DistHeight_Obj_10_RR : 479|8@0+ (0.2,-10) [-10|41] "m" ADC
 SG_ ARC_OD_DistX_Obj_10_RR : 7|12@0+ (0.1,-152) [-152|257.5] "m" ADC
 SG_ ARC_OD_Classification_Obj_10_RR : 98|3@0+ (1,0) [0|7] "" ADC
 SG_ ARC_OD_AabsYStd_Obj_10_RR : 111|8@0+ (0.25,0) [0|63.75] "m/s^2" ADC
 SG_ ARC_OD_ClassConf_Obj_10_RR : 119|7@0+ (1,0) [0|127] "%" ADC
 SG_ ARC_OD_ProbOfExist_Obj_10_RR : 112|7@0+ (1,0) [0|127] "%" ADC
 SG_ ARC_OD_VabsX_Obj_10_RR : 11|11@0+ (0.125,-128) [-128|127.875] "m/s" ADC
 SG_ ARC_OD_DynProp_Obj_10_RR : 130|3@0+ (1,0) [0|7] "" ADC
 SG_ ARC_OD_Length_Obj_10_RR : 136|7@0+ (0.2,0) [0|25.4] "m" ADC
 SG_ ARC_OD_MaintenanceState_Obj_10_R : 145|2@0+ (1,0) [0|3] "" ADC
 SG_ ARC_OD_Width_Obj_10_RR : 159|7@0+ (0.2,0) [0|25.4] "m" ADC
 SG_ ARC_OD_RCS_Obj_10_RR : 152|9@0+ (0.2,-51.1) [-51.1|51.1] "dBsm" ADC
 SG_ ARC_OD_Orientation_Obj_10_RR : 175|10@0+ (0.01,-5.11) [-5.11|5.12] "rad" ADC
 SG_ ARC_OD_LifeCycle_Obj_10_RR : 207|16@0+ (1,0) [0|65535] "" ADC
 SG_ ARC_OD_DistX_Obj_11_RR : 223|12@0+ (0.1,-152) [-152|257.5] "m" ADC
 SG_ ARC_OD_VabsX_Obj_11_RR : 227|11@0+ (0.125,-128) [-128|127.875] "m/s" ADC
 SG_ ARC_OD_AabsX_Obj_11_RR : 232|9@0+ (0.125,-31.875) [-31.875|32] "m/s^2" ADC
 SG_ ARC_OD_AabsX_Obj_10_RR : 16|9@0+ (0.125,-31.875) [-31.875|32] "m/s^2" ADC
 SG_ ARC_OD_DistY_Obj_11_RR : 255|12@0+ (0.0875,-179.113) [-179.113|179.2] "m" ADC
 SG_ ARC_OD_VabsY_Obj_11_RR : 259|11@0+ (0.125,-128) [-128|127.875] "m/s" ADC
 SG_ ARC_OD_AabsY_Obj_11_RR : 264|9@0+ (0.125,-31.875) [-31.875|32] "m/s^2" ADC
 SG_ ARC_OD_DistXStd_Obj_11_RR : 287|8@0+ (0.05,0) [0|12.75] "m" ADC
 SG_ ARC_OD_DistYStd_Obj_11_RR : 295|8@0+ (0.1,0) [0|25.5] "m" ADC
 SG_ ARC_OD_VabsXStd_Obj_11_RR : 303|7@0+ (0.1,0) [0|12.7] "m/s" ADC
 SG_ ARC_OD_VabsYStd_Obj_11_RR : 296|7@0+ (0.2,0) [0|25.4] "m/s" ADC
 SG_ ARC_OD_AabsXStd_Obj_11_RR : 305|7@0+ (0.25,0) [0|31.75] "m/s^2" ADC
 SG_ ARC_OD_Classification_Obj_11_RR : 314|3@0+ (1,0) [0|7] "" ADC
 SG_ ARC_OD_AabsYStd_Obj_11_RR : 327|8@0+ (0.25,0) [0|63.75] "m/s^2" ADC
 SG_ ARC_OD_ClassConf_Obj_11_RR : 335|7@0+ (1,0) [0|127] "%" ADC
 SG_ ARC_OD_DistY_Obj_10_RR : 39|12@0+ (0.0875,-179.113) [-179.113|179.2] "m" ADC
 SG_ ARC_OD_ProbOfExist_Obj_11_RR : 328|7@0+ (1,0) [0|127] "%" ADC
 SG_ ARC_OD_DynProp_Obj_11_RR : 346|3@0+ (1,0) [0|7] "" ADC
 SG_ ARC_OD_Length_Obj_11_RR : 352|7@0+ (0.2,0) [0|25.4] "m" ADC
 SG_ ARC_OD_MaintenanceState_Obj_11_R : 361|2@0+ (1,0) [0|3] "" ADC
 SG_ ARC_OD_Width_Obj_11_RR : 375|7@0+ (0.2,0) [0|25.4] "m" ADC
 SG_ ARC_OD_RCS_Obj_11_RR : 368|9@0+ (0.2,-51.1) [-51.1|51.1] "dBsm" ADC
 SG_ ARC_OD_Orientation_Obj_11_RR : 391|10@0+ (0.01,-5.11) [-5.11|5.12] "rad" ADC
 SG_ ARC_OD_LifeCycle_Obj_11_RR : 423|16@0+ (1,0) [0|65535] "" ADC
 SG_ ARC_OD_ObstacleProb_Obj_10_RR : 447|7@0+ (1,0) [0|127] "%" ADC
 SG_ ARC_OD_ObstacleProb_Obj_11_RR : 455|7@0+ (1,0) [0|127] "%" ADC
 SG_ ARC_OD_VabsY_Obj_10_RR : 43|11@0+ (0.125,-128) [-128|127.875] "m/s" ADC
 SG_ ARC_OD_ID_10_RR : 463|8@0+ (1,0) [0|255] "" ADC
 SG_ ARC_OD_ID_11_RR : 471|8@0+ (1,0) [0|255] "" ADC
 SG_ ARC_OD_MsgCounter_Obj_10_11_RR : 491|4@0+ (1,0) [0|15] "" ADC
 SG_ ARC_OD_CRC8_Obj_10_11_RR : 511|8@0+ (1,0) [0|256] "" ADC
 SG_ ARC_OD_AabsY_Obj_10_RR : 48|9@0+ (0.125,-31.875) [-31.875|32] "m/s^2" ADC
 SG_ ARC_OD_DistXStd_Obj_10_RR : 71|8@0+ (0.05,0) [0|12.75] "m" ADC
 SG_ ARC_OD_DistYStd_Obj_10_RR : 79|8@0+ (0.1,0) [0|25.5] "m" ADC
 SG_ ARC_OD_VabsXStd_Obj_10_RR : 87|7@0+ (0.1,0) [0|12.7] "m/s" ADC
 SG_ ARC_OD_VabsYStd_Obj_10_RR : 80|7@0+ (0.2,0) [0|25.4] "m/s" ADC
 SG_ ARC_OD_AabsXStd_Obj_10_RR : 89|7@0+ (0.25,0) [0|31.75] "m/s^2" ADC

BO_ 1109 ARC_OD_08_09_RR: 64 ARC
 SG_ DistHeight_Obj_09_RR : 487|8@0+ (0.2,-10) [-10|41] "m" ADC
 SG_ DistHeight_Obj_08_RR : 479|8@0+ (0.2,-10) [-10|41] "m" ADC
 SG_ ARC_OD_DistX_Obj_08_RR : 7|12@0+ (0.1,-152) [-152|257.5] "m" ADC
 SG_ ARC_OD_Classification_Obj_08_RR : 98|3@0+ (1,0) [0|7] "" ADC
 SG_ ARC_OD_AabsYStd_Obj_08_RR : 111|8@0+ (0.25,0) [0|63.75] "m/s^2" ADC
 SG_ ARC_OD_ClassConf_Obj_08_RR : 119|7@0+ (1,0) [0|127] "%" ADC
 SG_ ARC_OD_ProbOfExist_Obj_08_RR : 112|7@0+ (1,0) [0|127] "%" ADC
 SG_ ARC_OD_VabsX_Obj_08_RR : 11|11@0+ (0.125,-128) [-128|127.875] "m/s" ADC
 SG_ ARC_OD_DynProp_Obj_08_RR : 130|3@0+ (1,0) [0|7] "" ADC
 SG_ ARC_OD_Length_Obj_08_RR : 136|7@0+ (0.2,0) [0|25.4] "m" ADC
 SG_ ARC_OD_MaintenanceState_Obj_08_R : 145|2@0+ (1,0) [0|3] "" ADC
 SG_ ARC_OD_Width_Obj_08_RR : 159|7@0+ (0.2,0) [0|25.4] "m" ADC
 SG_ ARC_OD_RCS_Obj_08_RR : 152|9@0+ (0.2,-51.1) [-51.1|51.1] "dBsm" ADC
 SG_ ARC_OD_Orientation_Obj_08_RR : 175|10@0+ (0.01,-5.11) [-5.11|5.12] "rad" ADC
 SG_ ARC_OD_LifeCycle_Obj_08_RR : 207|16@0+ (1,0) [0|65535] "" ADC
 SG_ ARC_OD_DistX_Obj_09_RR : 223|12@0+ (0.1,-152) [-152|257.5] "m" ADC
 SG_ ARC_OD_VabsX_Obj_09_RR : 227|11@0+ (0.125,-128) [-128|127.875] "m/s" ADC
 SG_ ARC_OD_AabsX_Obj_09_RR : 232|9@0+ (0.125,-31.875) [-31.875|32] "m/s^2" ADC
 SG_ ARC_OD_AabsX_Obj_08_RR : 16|9@0+ (0.125,-31.875) [-31.875|32] "m/s^2" ADC
 SG_ ARC_OD_DistY_Obj_09_RR : 255|12@0+ (0.0875,-179.113) [-179.113|179.2] "m" ADC
 SG_ ARC_OD_VabsY_Obj_09_RR : 259|11@0+ (0.125,-128) [-128|127.875] "m/s" ADC
 SG_ ARC_OD_AabsY_Obj_09_RR : 264|9@0+ (0.125,-31.875) [-31.875|32] "m/s^2" ADC
 SG_ ARC_OD_DistXStd_Obj_09_RR : 287|8@0+ (0.05,0) [0|12.75] "m" ADC
 SG_ ARC_OD_DistYStd_Obj_09_RR : 295|8@0+ (0.1,0) [0|25.5] "m" ADC
 SG_ ARC_OD_VabsXStd_Obj_09_RR : 303|7@0+ (0.1,0) [0|12.7] "m/s" ADC
 SG_ ARC_OD_VabsYStd_Obj_09_RR : 296|7@0+ (0.2,0) [0|25.4] "m/s" ADC
 SG_ ARC_OD_AabsXStd_Obj_09_RR : 305|7@0+ (0.25,0) [0|31.75] "m/s^2" ADC
 SG_ ARC_OD_Classification_Obj_09_RR : 314|3@0+ (1,0) [0|7] "" ADC
 SG_ ARC_OD_AabsYStd_Obj_09_RR : 327|8@0+ (0.25,0) [0|63.75] "m/s^2" ADC
 SG_ ARC_OD_ClassConf_Obj_09_RR : 335|7@0+ (1,0) [0|127] "%" ADC
 SG_ ARC_OD_DistY_Obj_08_RR : 39|12@0+ (0.0875,-179.113) [-179.113|179.2] "m" ADC
 SG_ ARC_OD_ProbOfExist_Obj_09_RR : 328|7@0+ (1,0) [0|127] "%" ADC
 SG_ ARC_OD_DynProp_Obj_09_RR : 346|3@0+ (1,0) [0|7] "" ADC
 SG_ ARC_OD_Length_Obj_09_RR : 352|7@0+ (0.2,0) [0|25.4] "m" ADC
 SG_ ARC_OD_MaintenanceState_Obj_09_R : 361|2@0+ (1,0) [0|3] "" ADC
 SG_ ARC_OD_Width_Obj_09_RR : 375|7@0+ (0.2,0) [0|25.4] "m" ADC
 SG_ ARC_OD_RCS_Obj_09_RR : 368|9@0+ (0.2,-51.1) [-51.1|51.1] "dBsm" ADC
 SG_ ARC_OD_Orientation_Obj_09_RR : 391|10@0+ (0.01,-5.11) [-5.11|5.12] "rad" ADC
 SG_ ARC_OD_LifeCycle_Obj_09_RR : 423|16@0+ (1,0) [0|65535] "" ADC
 SG_ ARC_OD_ObstacleProb_Obj_08_RR : 447|7@0+ (1,0) [0|127] "%" ADC
 SG_ ARC_OD_ObstacleProb_Obj_09_RR : 455|7@0+ (1,0) [0|127] "%" ADC
 SG_ ARC_OD_VabsY_Obj_08_RR : 43|11@0+ (0.125,-128) [-128|127.875] "m/s" ADC
 SG_ ARC_OD_ID_08_RR : 463|8@0+ (1,0) [0|255] "" ADC
 SG_ ARC_OD_ID_09_RR : 471|8@0+ (1,0) [0|255] "" ADC
 SG_ ARC_OD_MsgCounter_Obj_08_09_RR : 491|4@0+ (1,0) [0|15] "" ADC
 SG_ ARC_OD_CRC8_Obj_08_09_RR : 511|8@0+ (1,0) [0|256] "" ADC
 SG_ ARC_OD_AabsY_Obj_08_RR : 48|9@0+ (0.125,-31.875) [-31.875|32] "m/s^2" ADC
 SG_ ARC_OD_DistXStd_Obj_08_RR : 71|8@0+ (0.05,0) [0|12.75] "m" ADC
 SG_ ARC_OD_DistYStd_Obj_08_RR : 79|8@0+ (0.1,0) [0|25.5] "m" ADC
 SG_ ARC_OD_VabsXStd_Obj_08_RR : 87|7@0+ (0.1,0) [0|12.7] "m/s" ADC
 SG_ ARC_OD_VabsYStd_Obj_08_RR : 80|7@0+ (0.2,0) [0|25.4] "m/s" ADC
 SG_ ARC_OD_AabsXStd_Obj_08_RR : 89|7@0+ (0.25,0) [0|31.75] "m/s^2" ADC

BO_ 1108 ARC_OD_06_07_RR: 64 ARC
 SG_ DistHeight_Obj_07_RR : 487|8@0+ (0.2,-10) [-10|41] "m" ADC
 SG_ DistHeight_Obj_06_RR : 479|8@0+ (0.2,-10) [-10|41] "m" ADC
 SG_ ARC_OD_DistX_Obj_06_RR : 7|12@0+ (0.1,-152) [-152|257.5] "m" ADC
 SG_ ARC_OD_Classification_Obj_06_RR : 98|3@0+ (1,0) [0|7] "" ADC
 SG_ ARC_OD_AabsYStd_Obj_06_RR : 111|8@0+ (0.25,0) [0|63.75] "m/s^2" ADC
 SG_ ARC_OD_ClassConf_Obj_06_RR : 119|7@0+ (1,0) [0|127] "%" ADC
 SG_ ARC_OD_ProbOfExist_Obj_06_RR : 112|7@0+ (1,0) [0|127] "%" ADC
 SG_ ARC_OD_VabsX_Obj_06_RR : 11|11@0+ (0.125,-128) [-128|127.875] "m/s" ADC
 SG_ ARC_OD_DynProp_Obj_06_RR : 130|3@0+ (1,0) [0|7] "" ADC
 SG_ ARC_OD_Length_Obj_06_RR : 136|7@0+ (0.2,0) [0|25.4] "m" ADC
 SG_ ARC_OD_MaintenanceState_Obj_06_R : 145|2@0+ (1,0) [0|3] "" ADC
 SG_ ARC_OD_Width_Obj_06_RR : 159|7@0+ (0.2,0) [0|25.4] "m" ADC
 SG_ ARC_OD_RCS_Obj_06_RR : 152|9@0+ (0.2,-51.1) [-51.1|51.1] "dBsm" ADC
 SG_ ARC_OD_Orientation_Obj_06_RR : 175|10@0+ (0.01,-5.11) [-5.11|5.12] "rad" ADC
 SG_ ARC_OD_LifeCycle_Obj_06_RR : 207|16@0+ (1,0) [0|65535] "" ADC
 SG_ ARC_OD_DistX_Obj_07_RR : 223|12@0+ (0.1,-152) [-152|257.5] "m" ADC
 SG_ ARC_OD_VabsX_Obj_07_RR : 227|11@0+ (0.125,-128) [-128|127.875] "m/s" ADC
 SG_ ARC_OD_AabsX_Obj_07_RR : 232|9@0+ (0.125,-31.875) [-31.875|32] "m/s^2" ADC
 SG_ ARC_OD_AabsX_Obj_06_RR : 16|9@0+ (0.125,-31.875) [-31.875|32] "m/s^2" ADC
 SG_ ARC_OD_DistY_Obj_07_RR : 255|12@0+ (0.0875,-179.113) [-179.113|179.2] "m" ADC
 SG_ ARC_OD_VabsY_Obj_07_RR : 259|11@0+ (0.125,-128) [-128|127.875] "m/s" ADC
 SG_ ARC_OD_AabsY_Obj_07_RR : 264|9@0+ (0.125,-31.875) [-31.875|32] "m/s^2" ADC
 SG_ ARC_OD_DistXStd_Obj_07_RR : 287|8@0+ (0.05,0) [0|12.75] "m" ADC
 SG_ ARC_OD_DistYStd_Obj_07_RR : 295|8@0+ (0.1,0) [0|25.5] "m" ADC
 SG_ ARC_OD_VabsXStd_Obj_07_RR : 303|7@0+ (0.1,0) [0|12.7] "m/s" ADC
 SG_ ARC_OD_VabsYStd_Obj_07_RR : 296|7@0+ (0.2,0) [0|25.4] "m/s" ADC
 SG_ ARC_OD_AabsXStd_Obj_07_RR : 305|7@0+ (0.25,0) [0|31.75] "m/s^2" ADC
 SG_ ARC_OD_Classification_Obj_07_RR : 314|3@0+ (1,0) [0|7] "" ADC
 SG_ ARC_OD_AabsYStd_Obj_07_RR : 327|8@0+ (0.25,0) [0|63.75] "m/s^2" ADC
 SG_ ARC_OD_ClassConf_Obj_07_RR : 335|7@0+ (1,0) [0|127] "%" ADC
 SG_ ARC_OD_DistY_Obj_06_RR : 39|12@0+ (0.0875,-179.113) [-179.113|179.2] "m" ADC
 SG_ ARC_OD_ProbOfExist_Obj_07_RR : 328|7@0+ (1,0) [0|127] "%" ADC
 SG_ ARC_OD_DynProp_Obj_07_RR : 346|3@0+ (1,0) [0|7] "" ADC
 SG_ ARC_OD_Length_Obj_07_RR : 352|7@0+ (0.2,0) [0|25.4] "m" ADC
 SG_ ARC_OD_MaintenanceState_Obj_07_R : 361|2@0+ (1,0) [0|3] "" ADC
 SG_ ARC_OD_Width_Obj_07_RR : 375|7@0+ (0.2,0) [0|25.4] "m" ADC
 SG_ ARC_OD_RCS_Obj_07_RR : 368|9@0+ (0.2,-51.1) [-51.1|51.1] "dBsm" ADC
 SG_ ARC_OD_Orientation_Obj_07_RR : 391|10@0+ (0.01,-5.11) [-5.11|5.12] "rad" ADC
 SG_ ARC_OD_LifeCycle_Obj_07_RR : 423|16@0+ (1,0) [0|65535] "" ADC
 SG_ ARC_OD_ObstacleProb_Obj_06_RR : 447|7@0+ (1,0) [0|127] "%" ADC
 SG_ ARC_OD_ObstacleProb_Obj_07_RR : 455|7@0+ (1,0) [0|127] "%" ADC
 SG_ ARC_OD_VabsY_Obj_06_RR : 43|11@0+ (0.125,-128) [-128|127.875] "m/s" ADC
 SG_ ARC_OD_ID_06_RR : 463|8@0+ (1,0) [0|255] "" ADC
 SG_ ARC_OD_ID_07_RR : 471|8@0+ (1,0) [0|255] "" ADC
 SG_ ARC_OD_MsgCounter_Obj_06_07_RR : 491|4@0+ (1,0) [0|15] "" ADC
 SG_ ARC_OD_CRC8_Obj_06_07_RR : 511|8@0+ (1,0) [0|256] "" ADC
 SG_ ARC_OD_AabsY_Obj_06_RR : 48|9@0+ (0.125,-31.875) [-31.875|32] "m/s^2" ADC
 SG_ ARC_OD_DistXStd_Obj_06_RR : 71|8@0+ (0.05,0) [0|12.75] "m" ADC
 SG_ ARC_OD_DistYStd_Obj_06_RR : 79|8@0+ (0.1,0) [0|25.5] "m" ADC
 SG_ ARC_OD_VabsXStd_Obj_06_RR : 87|7@0+ (0.1,0) [0|12.7] "m/s" ADC
 SG_ ARC_OD_VabsYStd_Obj_06_RR : 80|7@0+ (0.2,0) [0|25.4] "m/s" ADC
 SG_ ARC_OD_AabsXStd_Obj_06_RR : 89|7@0+ (0.25,0) [0|31.75] "m/s^2" ADC

BO_ 1107 ARC_OD_04_05_RR: 64 ARC
 SG_ DistHeight_Obj_05_RR : 487|8@0+ (0.2,-10) [-10|41] "m" ADC
 SG_ DistHeight_Obj_04_RR : 479|8@0+ (0.2,-10) [-10|41] "m" ADC
 SG_ ARC_OD_DistX_Obj_04_RR : 7|12@0+ (0.1,-152) [-152|257.5] "m" ADC
 SG_ ARC_OD_Classification_Obj_04_RR : 98|3@0+ (1,0) [0|7] "" ADC
 SG_ ARC_OD_AabsYStd_Obj_04_RR : 111|8@0+ (0.25,0) [0|63.75] "m/s^2" ADC
 SG_ ARC_OD_ClassConf_Obj_04_RR : 119|7@0+ (1,0) [0|127] "%" ADC
 SG_ ARC_OD_ProbOfExist_Obj_04_RR : 112|7@0+ (1,0) [0|127] "%" ADC
 SG_ ARC_OD_VabsX_Obj_04_RR : 11|11@0+ (0.125,-128) [-128|127.875] "m/s" ADC
 SG_ ARC_OD_DynProp_Obj_04_RR : 130|3@0+ (1,0) [0|7] "" ADC
 SG_ ARC_OD_Length_Obj_04_RR : 136|7@0+ (0.2,0) [0|25.4] "m" ADC
 SG_ ARC_OD_MaintenanceState_Obj_04_R : 145|2@0+ (1,0) [0|3] "" ADC
 SG_ ARC_OD_Width_Obj_04_RR : 159|7@0+ (0.2,0) [0|25.4] "m" ADC
 SG_ ARC_OD_RCS_Obj_04_RR : 152|9@0+ (0.2,-51.1) [-51.1|51.1] "dBsm" ADC
 SG_ ARC_OD_Orientation_Obj_04_RR : 175|10@0+ (0.01,-5.11) [-5.11|5.12] "rad" ADC
 SG_ ARC_OD_LifeCycle_Obj_04_RR : 207|16@0+ (1,0) [0|65535] "" ADC
 SG_ ARC_OD_DistX_Obj_05_RR : 223|12@0+ (0.1,-152) [-152|257.5] "m" ADC
 SG_ ARC_OD_VabsX_Obj_05_RR : 227|11@0+ (0.125,-128) [-128|127.875] "m/s" ADC
 SG_ ARC_OD_AabsX_Obj_05_RR : 232|9@0+ (0.125,-31.875) [-31.875|32] "m/s^2" ADC
 SG_ ARC_OD_AabsX_Obj_04_RR : 16|9@0+ (0.125,-31.875) [-31.875|32] "m/s^2" ADC
 SG_ ARC_OD_DistY_Obj_05_RR : 255|12@0+ (0.0875,-179.113) [-179.113|179.2] "m" ADC
 SG_ ARC_OD_VabsY_Obj_05_RR : 259|11@0+ (0.125,-128) [-128|127.875] "m/s" ADC
 SG_ ARC_OD_AabsY_Obj_05_RR : 264|9@0+ (0.125,-31.875) [-31.875|32] "m/s^2" ADC
 SG_ ARC_OD_DistXStd_Obj_05_RR : 287|8@0+ (0.05,0) [0|12.75] "m" ADC
 SG_ ARC_OD_DistYStd_Obj_05_RR : 295|8@0+ (0.1,0) [0|25.5] "m" ADC
 SG_ ARC_OD_VabsXStd_Obj_05_RR : 303|7@0+ (0.1,0) [0|12.7] "m/s" ADC
 SG_ ARC_OD_VabsYStd_Obj_05_RR : 296|7@0+ (0.2,0) [0|25.4] "m/s" ADC
 SG_ ARC_OD_AabsXStd_Obj_05_RR : 305|7@0+ (0.25,0) [0|31.75] "m/s^2" ADC
 SG_ ARC_OD_Classification_Obj_05_RR : 314|3@0+ (1,0) [0|7] "" ADC
 SG_ ARC_OD_AabsYStd_Obj_05_RR : 327|8@0+ (0.25,0) [0|63.75] "m/s^2" ADC
 SG_ ARC_OD_ClassConf_Obj_05_RR : 335|7@0+ (1,0) [0|127] "%" ADC
 SG_ ARC_OD_DistY_Obj_04_RR : 39|12@0+ (0.0875,-179.113) [-179.113|179.2] "m" ADC
 SG_ ARC_OD_ProbOfExist_Obj_05_RR : 328|7@0+ (1,0) [0|127] "%" ADC
 SG_ ARC_OD_DynProp_Obj_05_RR : 346|3@0+ (1,0) [0|7] "" ADC
 SG_ ARC_OD_Length_Obj_05_RR : 352|7@0+ (0.2,0) [0|25.4] "m" ADC
 SG_ ARC_OD_MaintenanceState_Obj_05_R : 361|2@0+ (1,0) [0|3] "" ADC
 SG_ ARC_OD_Width_Obj_05_RR : 375|7@0+ (0.2,0) [0|25.4] "m" ADC
 SG_ ARC_OD_RCS_Obj_05_RR : 368|9@0+ (0.2,-51.1) [-51.1|51.1] "dBsm" ADC
 SG_ ARC_OD_Orientation_Obj_05_RR : 391|10@0+ (0.01,-5.11) [-5.11|5.12] "rad" ADC
 SG_ ARC_OD_LifeCycle_Obj_05_RR : 423|16@0+ (1,0) [0|65535] "" ADC
 SG_ ARC_OD_ObstacleProb_Obj_04_RR : 447|7@0+ (1,0) [0|127] "%" ADC
 SG_ ARC_OD_ObstacleProb_Obj_05_RR : 455|7@0+ (1,0) [0|127] "%" ADC
 SG_ ARC_OD_VabsY_Obj_04_RR : 43|11@0+ (0.125,-128) [-128|127.875] "m/s" ADC
 SG_ ARC_OD_ID_04_RR : 463|8@0+ (1,0) [0|255] "" ADC
 SG_ ARC_OD_ID_05_RR : 471|8@0+ (1,0) [0|255] "" ADC
 SG_ ARC_OD_MsgCounter_Obj_04_05_RR : 491|4@0+ (1,0) [0|15] "" ADC
 SG_ ARC_OD_CRC8_Obj_04_05_RR : 511|8@0+ (1,0) [0|256] "" ADC
 SG_ ARC_OD_AabsY_Obj_04_RR : 48|9@0+ (0.125,-31.875) [-31.875|32] "m/s^2" ADC
 SG_ ARC_OD_DistXStd_Obj_04_RR : 71|8@0+ (0.05,0) [0|12.75] "m" ADC
 SG_ ARC_OD_DistYStd_Obj_04_RR : 79|8@0+ (0.1,0) [0|25.5] "m" ADC
 SG_ ARC_OD_VabsXStd_Obj_04_RR : 87|7@0+ (0.1,0) [0|12.7] "m/s" ADC
 SG_ ARC_OD_VabsYStd_Obj_04_RR : 80|7@0+ (0.2,0) [0|25.4] "m/s" ADC
 SG_ ARC_OD_AabsXStd_Obj_04_RR : 89|7@0+ (0.25,0) [0|31.75] "m/s^2" ADC

BO_ 1106 ARC_OD_02_03_RR: 64 ARC
 SG_ DistHeight_Obj_03_RR : 487|8@0+ (0.2,-10) [-10|41] "m" ADC
 SG_ DistHeight_Obj_02_RR : 479|8@0+ (0.2,-10) [-10|41] "m" ADC
 SG_ ARC_OD_DistX_Obj_02_RR : 7|12@0+ (0.1,-152) [-152|257.5] "m" ADC
 SG_ ARC_OD_Classification_Obj_02_RR : 98|3@0+ (1,0) [0|7] "" ADC
 SG_ ARC_OD_AabsYStd_Obj_02_RR : 111|8@0+ (0.25,0) [0|63.75] "m/s^2" ADC
 SG_ ARC_OD_ClassConf_Obj_02_RR : 119|7@0+ (1,0) [0|127] "%" ADC
 SG_ ARC_OD_ProbOfExist_Obj_02_RR : 112|7@0+ (1,0) [0|127] "%" ADC
 SG_ ARC_OD_VabsX_Obj_02_RR : 11|11@0+ (0.125,-128) [-128|127.875] "m/s" ADC
 SG_ ARC_OD_DynProp_Obj_02_RR : 130|3@0+ (1,0) [0|7] "" ADC
 SG_ ARC_OD_Length_Obj_02_RR : 136|7@0+ (0.2,0) [0|25.4] "m" ADC
 SG_ ARC_OD_MaintenanceState_Obj_02_R : 145|2@0+ (1,0) [0|3] "" ADC
 SG_ ARC_OD_Width_Obj_02_RR : 159|7@0+ (0.2,0) [0|25.4] "m" ADC
 SG_ ARC_OD_RCS_Obj_02_RR : 152|9@0+ (0.2,-51.1) [-51.1|51.1] "dBsm" ADC
 SG_ ARC_OD_Orientation_Obj_02_RR : 175|10@0+ (0.01,-5.11) [-5.11|5.12] "rad" ADC
 SG_ ARC_OD_LifeCycle_Obj_02_RR : 207|16@0+ (1,0) [0|65535] "" ADC
 SG_ ARC_OD_DistX_Obj_03_RR : 223|12@0+ (0.1,-152) [-152|257.5] "m" ADC
 SG_ ARC_OD_VabsX_Obj_03_RR : 227|11@0+ (0.125,-128) [-128|127.875] "m/s" ADC
 SG_ ARC_OD_AabsX_Obj_03_RR : 232|9@0+ (0.125,-31.875) [-31.875|32] "m/s^2" ADC
 SG_ ARC_OD_AabsX_Obj_02_RR : 16|9@0+ (0.125,-31.875) [-31.875|32] "m/s^2" ADC
 SG_ ARC_OD_DistY_Obj_03_RR : 255|12@0+ (0.0875,-179.113) [-179.113|179.2] "m" ADC
 SG_ ARC_OD_VabsY_Obj_03_RR : 259|11@0+ (0.125,-128) [-128|127.875] "m/s" ADC
 SG_ ARC_OD_AabsY_Obj_03_RR : 264|9@0+ (0.125,-31.875) [-31.875|32] "m/s^2" ADC
 SG_ ARC_OD_DistXStd_Obj_03_RR : 287|8@0+ (0.05,0) [0|12.75] "m" ADC
 SG_ ARC_OD_DistYStd_Obj_03_RR : 295|8@0+ (0.1,0) [0|25.5] "m" ADC
 SG_ ARC_OD_VabsXStd_Obj_03_RR : 303|7@0+ (0.1,0) [0|12.7] "m/s" ADC
 SG_ ARC_OD_VabsYStd_Obj_03_RR : 296|7@0+ (0.2,0) [0|25.4] "m/s" ADC
 SG_ ARC_OD_AabsXStd_Obj_03_RR : 305|7@0+ (0.25,0) [0|31.75] "m/s^2" ADC
 SG_ ARC_OD_Classification_Obj_03_RR : 314|3@0+ (1,0) [0|7] "" ADC
 SG_ ARC_OD_AabsYStd_Obj_03_RR : 327|8@0+ (0.25,0) [0|63.75] "m/s^2" ADC
 SG_ ARC_OD_ClassConf_Obj_03_RR : 335|7@0+ (1,0) [0|127] "%" ADC
 SG_ ARC_OD_DistY_Obj_02_RR : 39|12@0+ (0.0875,-179.113) [-179.113|179.2] "m" ADC
 SG_ ARC_OD_ProbOfExist_Obj_03_RR : 328|7@0+ (1,0) [0|127] "%" ADC
 SG_ ARC_OD_DynProp_Obj_03_RR : 346|3@0+ (1,0) [0|7] "" ADC
 SG_ ARC_OD_Length_Obj_03_RR : 352|7@0+ (0.2,0) [0|25.4] "m" ADC
 SG_ ARC_OD_MaintenanceState_Obj_03_R : 361|2@0+ (1,0) [0|3] "" ADC
 SG_ ARC_OD_Width_Obj_03_RR : 375|7@0+ (0.2,0) [0|25.4] "m" ADC
 SG_ ARC_OD_RCS_Obj_03_RR : 368|9@0+ (0.2,-51.1) [-51.1|51.1] "dBsm" ADC
 SG_ ARC_OD_Orientation_Obj_03_RR : 391|10@0+ (0.01,-5.11) [-5.11|5.12] "rad" ADC
 SG_ ARC_OD_LifeCycle_Obj_03_RR : 423|16@0+ (1,0) [0|65535] "" ADC
 SG_ ARC_OD_ObstacleProb_Obj_02_RR : 447|7@0+ (1,0) [0|127] "%" ADC
 SG_ ARC_OD_ObstacleProb_Obj_03_RR : 455|7@0+ (1,0) [0|127] "%" ADC
 SG_ ARC_OD_VabsY_Obj_02_RR : 43|11@0+ (0.125,-128) [-128|127.875] "m/s" ADC
 SG_ ARC_OD_ID_02_RR : 463|8@0+ (1,0) [0|255] "" ADC
 SG_ ARC_OD_ID_03_RR : 471|8@0+ (1,0) [0|255] "" ADC
 SG_ ARC_OD_MsgCounter_Obj_02_03_RR : 491|4@0+ (1,0) [0|15] "" ADC
 SG_ ARC_OD_CRC8_Obj_02_03_RR : 511|8@0+ (1,0) [0|256] "" ADC
 SG_ ARC_OD_AabsY_Obj_02_RR : 48|9@0+ (0.125,-31.875) [-31.875|32] "m/s^2" ADC
 SG_ ARC_OD_DistXStd_Obj_02_RR : 71|8@0+ (0.05,0) [0|12.75] "m" ADC
 SG_ ARC_OD_DistYStd_Obj_02_RR : 79|8@0+ (0.1,0) [0|25.5] "m" ADC
 SG_ ARC_OD_VabsXStd_Obj_02_RR : 87|7@0+ (0.1,0) [0|12.7] "m/s" ADC
 SG_ ARC_OD_VabsYStd_Obj_02_RR : 80|7@0+ (0.2,0) [0|25.4] "m/s" ADC
 SG_ ARC_OD_AabsXStd_Obj_02_RR : 89|7@0+ (0.25,0) [0|31.75] "m/s^2" ADC

BO_ 1105 ARC_OD_00_01_RR: 64 ARC
 SG_ DistHeight_Obj_01_RR : 487|8@0+ (0.2,-10) [-10|41] "m" ADC
 SG_ DistHeight_Obj_00_RR : 479|8@0+ (0.2,-10) [-10|41] "m" ADC
 SG_ ARC_OD_DistX_Obj_00_RR : 7|12@0+ (0.1,-152) [-152|257.5] "m" ADC
 SG_ ARC_OD_Classification_Obj_00_RR : 98|3@0+ (1,0) [0|7] "" ADC
 SG_ ARC_OD_AabsYStd_Obj_00_RR : 111|8@0+ (0.25,0) [0|63.75] "m/s^2" ADC
 SG_ ARC_OD_ClassConf_Obj_00_RR : 119|7@0+ (1,0) [0|127] "%" ADC
 SG_ ARC_OD_ProbOfExist_Obj_00_RR : 112|7@0+ (1,0) [0|127] "%" ADC
 SG_ ARC_OD_VabsX_Obj_00_RR : 11|11@0+ (0.125,-128) [-128|127.875] "m/s" ADC
 SG_ ARC_OD_DynProp_Obj_00_RR : 130|3@0+ (1,0) [0|7] "" ADC
 SG_ ARC_OD_Length_Obj_00_RR : 136|7@0+ (0.2,0) [0|25.4] "m" ADC
 SG_ ARC_OD_MaintenanceState_Obj_00_R : 145|2@0+ (1,0) [0|3] "" ADC
 SG_ ARC_OD_Width_Obj_00_RR : 159|7@0+ (0.2,0) [0|25.4] "m" ADC
 SG_ ARC_OD_RCS_Obj_00_RR : 152|9@0+ (0.2,-51.1) [-51.1|51.1] "dBsm" ADC
 SG_ ARC_OD_Orientation_Obj_00_RR : 175|10@0+ (0.01,-5.11) [-5.11|5.12] "rad" ADC
 SG_ ARC_OD_LifeCycle_Obj_00_RR : 207|16@0+ (1,0) [0|65535] "" ADC
 SG_ ARC_OD_DistX_Obj_01_RR : 223|12@0+ (0.1,-152) [-152|257.5] "m" ADC
 SG_ ARC_OD_VabsX_Obj_01_RR : 227|11@0+ (0.125,-128) [-128|127.875] "m/s" ADC
 SG_ ARC_OD_AabsX_Obj_01_RR : 232|9@0+ (0.125,-31.875) [-31.875|32] "m/s^2" ADC
 SG_ ARC_OD_AabsX_Obj_00_RR : 16|9@0+ (0.125,-31.875) [-31.875|32] "m/s^2" ADC
 SG_ ARC_OD_DistY_Obj_01_RR : 255|12@0+ (0.0875,-179.113) [-179.113|179.2] "m" ADC
 SG_ ARC_OD_VabsY_Obj_01_RR : 259|11@0+ (0.125,-128) [-128|127.875] "m/s" ADC
 SG_ ARC_OD_AabsY_Obj_01_RR : 264|9@0+ (0.125,-31.875) [-31.875|32] "m/s^2" ADC
 SG_ ARC_OD_DistXStd_Obj_01_RR : 287|8@0+ (0.05,0) [0|12.75] "m" ADC
 SG_ ARC_OD_DistYStd_Obj_01_RR : 295|8@0+ (0.1,0) [0|25.5] "m" ADC
 SG_ ARC_OD_VabsXStd_Obj_01_RR : 303|7@0+ (0.1,0) [0|12.7] "m/s" ADC
 SG_ ARC_OD_VabsYStd_Obj_01_RR : 296|7@0+ (0.2,0) [0|25.4] "m/s" ADC
 SG_ ARC_OD_AabsXStd_Obj_01_RR : 305|7@0+ (0.25,0) [0|31.75] "m/s^2" ADC
 SG_ ARC_OD_Classification_Obj_01_RR : 314|3@0+ (1,0) [0|7] "" ADC
 SG_ ARC_OD_AabsYStd_Obj_01_RR : 327|8@0+ (0.25,0) [0|63.75] "m/s^2" ADC
 SG_ ARC_OD_ClassConf_Obj_01_RR : 335|7@0+ (1,0) [0|127] "%" ADC
 SG_ ARC_OD_DistY_Obj_00_RR : 39|12@0+ (0.0875,-179.113) [-179.113|179.2] "m" ADC
 SG_ ARC_OD_ProbOfExist_Obj_01_RR : 328|7@0+ (1,0) [0|127] "%" ADC
 SG_ ARC_OD_DynProp_Obj_01_RR : 346|3@0+ (1,0) [0|7] "" ADC
 SG_ ARC_OD_Length_Obj_01_RR : 352|7@0+ (0.2,0) [0|25.4] "m" ADC
 SG_ ARC_OD_MaintenanceState_Obj_01_R : 361|2@0+ (1,0) [0|3] "" ADC
 SG_ ARC_OD_Width_Obj_01_RR : 375|7@0+ (0.2,0) [0|25.4] "m" ADC
 SG_ ARC_OD_RCS_Obj_01_RR : 368|9@0+ (0.2,-51.1) [-51.1|51.1] "dBsm" ADC
 SG_ ARC_OD_Orientation_Obj_01_RR : 391|10@0+ (0.01,-5.11) [-5.11|5.12] "rad" ADC
 SG_ ARC_OD_LifeCycle_Obj_01_RR : 423|16@0+ (1,0) [0|65535] "" ADC
 SG_ ARC_OD_ObstacleProb_Obj_00_RR : 447|7@0+ (1,0) [0|127] "%" ADC
 SG_ ARC_OD_ObstacleProb_Obj_01_RR : 455|7@0+ (1,0) [0|127] "%" ADC
 SG_ ARC_OD_VabsY_Obj_00_RR : 43|11@0+ (0.125,-128) [-128|127.875] "m/s" ADC
 SG_ ARC_OD_ID_00_RR : 463|8@0+ (1,0) [0|255] "" ADC
 SG_ ARC_OD_ID_01_RR : 471|8@0+ (1,0) [0|255] "" ADC
 SG_ ARC_OD_MsgCounter_Obj_00_01_RR : 491|4@0+ (1,0) [0|15] "" ADC
 SG_ ARC_OD_CRC8_Obj_00_01_RR : 511|8@0+ (1,0) [0|255] "" ADC
 SG_ ARC_OD_AabsY_Obj_00_RR : 48|9@0+ (0.125,-31.875) [-31.875|32] "m/s^2" ADC
 SG_ ARC_OD_DistXStd_Obj_00_RR : 71|8@0+ (0.05,0) [0|12.75] "m" ADC
 SG_ ARC_OD_DistYStd_Obj_00_RR : 79|8@0+ (0.1,0) [0|25.5] "m" ADC
 SG_ ARC_OD_VabsXStd_Obj_00_RR : 87|7@0+ (0.1,0) [0|12.7] "m/s" ADC
 SG_ ARC_OD_VabsYStd_Obj_00_RR : 80|7@0+ (0.2,0) [0|25.4] "m/s" ADC
 SG_ ARC_OD_AabsXStd_Obj_00_RR : 89|7@0+ (0.25,0) [0|31.75] "m/s^2" ADC

BO_ 1616 ARC_OD_Header_FL: 32 ARC
 SG_ ARC_OD_TimeStampGlobSec_FL : 7|32@0+ (1,0) [0|4294970000] "s" ADC
 SG_ ARC_OD_CycleCounter_FL : 119|16@0+ (1,0) [0|65535] "" ADC
 SG_ ARC_OD_NumOfObjects_FL : 135|6@0+ (1,0) [0|63] "" ADC
 SG_ ARC_OD_TaskValidFlag_FL : 129|1@0+ (1,0) [0|1] "" ADC
 SG_ ARC_OD_ExtendedCycleFlag_FL : 128|1@0+ (1,0) [0|1] "" ADC
 SG_ ARC_OD_Latency_FL : 143|11@0+ (0.1,0) [0|284.7] "ms" ADC
 SG_ ARC_OD_MsgCounter_Header_FL : 235|4@0+ (1,0) [0|15] "" ADC
 SG_ ARC_OD_CRC8_Header_FL : 255|8@0+ (1,0) [0|255] "" ADC
 SG_ ARC_OD_TimeStampGlobNanoSec_FL : 39|32@0+ (1,0) [0|4294970000] "ns" ADC
 SG_ ARC_OD_TimeStampLocal_FL : 71|32@0+ (1,0) [0|4294970000] "us" ADC
 SG_ ARC_OD_MeasCounter_FL : 103|16@0+ (1,0) [0|65535] "" ADC

BO_ 1360 ARC_OD_Header_FR: 32 ARC
 SG_ ARC_OD_TimeStampGlobSec_FR : 7|32@0+ (1,0) [0|4294970000] "s" ADC
 SG_ ARC_OD_CycleCounter_FR : 119|16@0+ (1,0) [0|65535] "" ADC
 SG_ ARC_OD_NumOfObjects_FR : 135|6@0+ (1,0) [0|63] "" ADC
 SG_ ARC_OD_TaskValidFlag_FR : 129|1@0+ (1,0) [0|1] "" ADC
 SG_ ARC_OD_ExtendedCycleFlag_FR : 128|1@0+ (1,0) [0|1] "" ADC
 SG_ ARC_OD_Latency_FR : 143|11@0+ (0.1,0) [0|284.7] "ms" ADC
 SG_ ARC_OD_MsgCounter_Header_FR : 235|4@0+ (1,0) [0|15] "" ADC
 SG_ ARC_OD_CRC8_Header_FR : 255|8@0+ (1,0) [0|255] "" ADC
 SG_ ARC_OD_TimeStampGlobNanoSec_FR : 39|32@0+ (1,0) [0|4294970000] "ns" ADC
 SG_ ARC_OD_TimeStampLocal_FR : 71|32@0+ (1,0) [0|4294970000] "us" ADC
 SG_ ARC_OD_MeasCounter_FR : 103|16@0+ (1,0) [0|65535] "" ADC

BO_ 1104 ARC_OD_Header_RR: 32 ARC
 SG_ ARC_OD_TimeStampGlobSec_RR : 7|32@0+ (1,0) [0|4294970000] "s" ADC
 SG_ ARC_OD_CycleCounter_RR : 119|16@0+ (1,0) [0|65535] "" ADC
 SG_ ARC_OD_NumOfObjects_RR : 135|6@0+ (1,0) [0|63] "" ADC
 SG_ ARC_OD_TaskValidFlag_RR : 129|1@0+ (1,0) [0|1] "" ADC
 SG_ ARC_OD_ExtendedCycleFlag_RR : 128|1@0+ (1,0) [0|1] "" ADC
 SG_ ARC_OD_Latency_RR : 143|11@0+ (0.1,0) [0|284.7] "ms" ADC
 SG_ ARC_OD_MsgCounter_Header_RR : 235|4@0+ (1,0) [0|15] "" ADC
 SG_ ARC_OD_CRC8_Header_RR : 255|8@0+ (1,0) [0|255] "" ADC
 SG_ ARC_OD_TimeStampGlobNanoSec_RR : 39|32@0+ (1,0) [0|4294970000] "ns" ADC
 SG_ ARC_OD_TimeStampLocal_RR : 71|32@0+ (1,0) [0|4294970000] "us" ADC
 SG_ ARC_OD_MeasCounter_RR : 103|16@0+ (1,0) [0|65535] "" ADC

BO_ 102 ARC_CONFIG_STATE_FR: 32 ARC
 SG_ ARC_ERROR_STATE_FR : 9|1@0+ (1,0) [0|1] "" Vector__XXX
 SG_ ARC_CFG_Mode_FR : 7|8@0+ (1,0) [0|255] "" ADC
 SG_ ARC_CFG_TmeSynEnFl_FR : 8|1@0+ (1,0) [0|1] "" ADC
 SG_ ARC_CONFIG_STATE_FR_RC : 235|4@0+ (1,0) [0|15] "" ADC
 SG_ ARC_CONFIG_STATE_FR_CRC : 255|8@0+ (1,0) [0|255] "" ADC

BO_ 105 ARC_CONFIG_STATE_FL: 32 ARC
 SG_ ARC_ERROR_STATE_FL : 9|1@0+ (1,0) [0|1] "" Vector__XXX
 SG_ ARC_CFG_Mode_FL : 7|8@0+ (1,0) [0|255] "" ADC
 SG_ ARC_CFG_TmeSynEnFl_FL : 8|1@0+ (1,0) [0|1] "" ADC
 SG_ ARC_CONFIG_STATE_FL_RC : 235|4@0+ (1,0) [0|15] "" ADC
 SG_ ARC_CONFIG_STATE_FL_CRC : 255|8@0+ (1,0) [0|255] "" ADC

BO_ 99 ARC_CONFIG_STATE_RR: 32 ARC
 SG_ ARC_ERROR_STATE_RR : 9|1@0+ (1,0) [0|1] "" Vector__XXX
 SG_ ARC_CFG_Mode_RR : 7|8@0+ (1,0) [0|255] "" ADC
 SG_ ARC_CFG_TmeSynEnFl_RR : 8|1@0+ (1,0) [0|1] "" ADC
 SG_ ARC_CONFIG_STATE_RR_RC : 235|4@0+ (1,0) [0|15] "" ADC
 SG_ ARC_CONFIG_STATE_RR_CRC : 255|8@0+ (1,0) [0|255] "" ADC

BO_ 96 ARC_CONFIG_STATE_RL: 32 ARC
 SG_ ARC_ERROR_STATE_RL : 9|1@0+ (1,0) [0|1] "" Vector__XXX
 SG_ ARC_CFG_Mode_RL : 7|8@0+ (1,0) [0|255] "" ADC
 SG_ ARC_CFG_TmeSynEnFl_RL : 8|1@0+ (1,0) [0|1] "" ADC
 SG_ ARC_CONFIG_STATE_RL_RC : 235|4@0+ (1,0) [0|15] "" ADC
 SG_ ARC_CONFIG_STATE_RL_CRC : 255|8@0+ (1,0) [0|255] "" ADC

BO_ 848 ARC_OD_Header_RL: 32 ARC
 SG_ ARC_OD_TimeStampGlobSec_RL : 7|32@0+ (1,0) [0|4294970000] "s" ADC
 SG_ ARC_OD_CycleCounter_RL : 119|16@0+ (1,0) [0|65535] "" ADC
 SG_ ARC_OD_NumOfObjects_RL : 135|6@0+ (1,0) [0|63] "" ADC
 SG_ ARC_OD_TaskValidFlag_RL : 129|1@0+ (1,0) [0|1] "" ADC
 SG_ ARC_OD_ExtendedCycleFlag_RL : 128|1@0+ (1,0) [0|1] "" ADC
 SG_ ARC_OD_Latency_RL : 143|11@0+ (0.1,0) [0|284.7] "ms" ADC
 SG_ ARC_OD_MsgCounter_Header_RL : 235|4@0+ (1,0) [0|15] "" ADC
 SG_ ARC_OD_CRC8_Header_RL : 255|8@0+ (1,0) [0|255] "" ADC
 SG_ ARC_OD_TimeStampGlobNanoSec_RL : 39|32@0+ (1,0) [0|4294970000] "ns" ADC
 SG_ ARC_OD_TimeStampLocal_RL : 71|32@0+ (1,0) [0|4294970000] "us" ADC
 SG_ ARC_OD_MeasCounter_RL : 103|16@0+ (1,0) [0|65535] "" ADC

BO_ 849 ARC_OD_00_01_RL: 64 ARC
 SG_ DistHeight_Obj_01_RL : 487|8@0+ (0.2,-10) [-10|41] "m" ADC
 SG_ DistHeight_Obj_00_RL : 479|8@0+ (0.2,-10) [-10|41] "m" ADC
 SG_ ARC_OD_DistX_Obj_00_RL : 7|12@0+ (0.1,-152) [-152|257.5] "m" ADC
 SG_ ARC_OD_Classification_Obj_00_RL : 98|3@0+ (1,0) [0|7] "" ADC
 SG_ ARC_OD_AabsYStd_Obj_00_RL : 111|8@0+ (0.25,0) [0|63.75] "m/s^2" ADC
 SG_ ARC_OD_ClassConf_Obj_00_RL : 119|7@0+ (1,0) [0|127] "%" ADC
 SG_ ARC_OD_ProbOfExist_Obj_00_RL : 112|7@0+ (1,0) [0|127] "%" ADC
 SG_ ARC_OD_VabsX_Obj_00_RL : 11|11@0+ (0.125,-128) [-128|127.875] "m/s" ADC
 SG_ ARC_OD_DynProp_Obj_00_RL : 130|3@0+ (1,0) [0|7] "" ADC
 SG_ ARC_OD_Length_Obj_00_RL : 136|7@0+ (0.2,0) [0|25.4] "m" ADC
 SG_ ARC_OD_MaintenanceState_Obj_0061 : 145|2@0+ (1,0) [0|3] "" ADC
 SG_ ARC_OD_Width_Obj_00_RL : 159|7@0+ (0.2,0) [0|25.4] "m" ADC
 SG_ ARC_OD_RCS_Obj_00_RL : 152|9@0+ (0.2,-51.1) [-51.1|51.1] "dBsm" ADC
 SG_ ARC_OD_Orientation_Obj_00_RL : 175|10@0+ (0.01,-5.11) [-5.11|5.12] "rad" ADC
 SG_ ARC_OD_LifeCycle_Obj_00_RL : 207|16@0+ (1,0) [0|65535] "" ADC
 SG_ ARC_OD_DistX_Obj_01_RL : 223|12@0+ (0.1,-152) [-152|257.5] "m" ADC
 SG_ ARC_OD_VabsX_Obj_01_RL : 227|11@0+ (0.125,-128) [-128|127.875] "m/s" ADC
 SG_ ARC_OD_AabsX_Obj_01_RL : 232|9@0+ (0.125,-31.875) [-31.875|32] "m/s^2" ADC
 SG_ ARC_OD_AabsX_Obj_00_RL : 16|9@0+ (0.125,-31.875) [-31.875|32] "m/s^2" ADC
 SG_ ARC_OD_DistY_Obj_01_RL : 255|12@0+ (0.0875,-179.113) [-179.113|179.2] "m" ADC
 SG_ ARC_OD_VabsY_Obj_01_RL : 259|11@0+ (0.125,-128) [-128|127.875] "m/s" ADC
 SG_ ARC_OD_AabsY_Obj_01_RL : 264|9@0+ (0.125,-31.875) [-31.875|32] "m/s^2" ADC
 SG_ ARC_OD_DistXStd_Obj_01_RL : 287|8@0+ (0.05,0) [0|12.75] "m" ADC
 SG_ ARC_OD_DistYStd_Obj_01_RL : 295|8@0+ (0.1,0) [0|25.5] "m" ADC
 SG_ ARC_OD_VabsXStd_Obj_01_RL : 303|7@0+ (0.1,0) [0|12.7] "m/s" ADC
 SG_ ARC_OD_VabsYStd_Obj_01_RL : 296|7@0+ (0.2,0) [0|25.4] "m/s" ADC
 SG_ ARC_OD_AabsXStd_Obj_01_RL : 305|7@0+ (0.25,0) [0|31.75] "m/s^2" ADC
 SG_ ARC_OD_Classification_Obj_01_RL : 314|3@0+ (1,0) [0|7] "" ADC
 SG_ ARC_OD_AabsYStd_Obj_01_RL : 327|8@0+ (0.25,0) [0|63.75] "m/s^2" ADC
 SG_ ARC_OD_ClassConf_Obj_01_RL : 335|7@0+ (1,0) [0|127] "%" ADC
 SG_ ARC_OD_DistY_Obj_00_RL : 39|12@0+ (0.0875,-179.113) [-179.113|179.2] "m" ADC
 SG_ ARC_OD_ProbOfExist_Obj_01_RL : 328|7@0+ (1,0) [0|127] "%" ADC
 SG_ ARC_OD_DynProp_Obj_01_RL : 346|3@0+ (1,0) [0|7] "" ADC
 SG_ ARC_OD_Length_Obj_01_RL : 352|7@0+ (0.2,0) [0|25.4] "m" ADC
 SG_ ARC_OD_MaintenanceState_Obj_0062 : 361|2@0+ (1,0) [0|3] "" ADC
 SG_ ARC_OD_Width_Obj_01_RL : 375|7@0+ (0.2,0) [0|25.4] "m" ADC
 SG_ ARC_OD_RCS_Obj_01_RL : 368|9@0+ (0.2,-51.1) [-51.1|51.1] "dBsm" ADC
 SG_ ARC_OD_Orientation_Obj_01_RL : 391|10@0+ (0.01,-5.11) [-5.11|5.12] "rad" ADC
 SG_ ARC_OD_LifeCycle_Obj_01_RL : 423|16@0+ (1,0) [0|65535] "" ADC
 SG_ ARC_OD_ObstacleProb_Obj_00_RL : 447|7@0+ (1,0) [0|127] "%" ADC
 SG_ ARC_OD_ObstacleProb_Obj_01_RL : 455|7@0+ (1,0) [0|127] "%" ADC
 SG_ ARC_OD_VabsY_Obj_00_RL : 43|11@0+ (0.125,-128) [-128|127.875] "m/s" ADC
 SG_ ARC_OD_ID_00_RL : 463|8@0+ (1,0) [0|255] "" ADC
 SG_ ARC_OD_ID_01_RL : 471|8@0+ (1,0) [0|255] "" ADC
 SG_ ARC_OD_MsgCounter_Obj_00_01_RL : 491|4@0+ (1,0) [0|15] "" ADC
 SG_ ARC_OD_CRC8_Obj_00_01_RL : 511|8@0+ (1,0) [0|255] "" ADC
 SG_ ARC_OD_AabsY_Obj_00_RL : 48|9@0+ (0.125,-31.875) [-31.875|32] "m/s^2" ADC
 SG_ ARC_OD_DistXStd_Obj_00_RL : 71|8@0+ (0.05,0) [0|12.75] "m" ADC
 SG_ ARC_OD_DistYStd_Obj_00_RL : 79|8@0+ (0.1,0) [0|25.5] "m" ADC
 SG_ ARC_OD_VabsXStd_Obj_00_RL : 87|7@0+ (0.1,0) [0|12.7] "m/s" ADC
 SG_ ARC_OD_VabsYStd_Obj_00_RL : 80|7@0+ (0.2,0) [0|25.4] "m/s" ADC
 SG_ ARC_OD_AabsXStd_Obj_00_RL : 89|7@0+ (0.25,0) [0|31.75] "m/s^2" ADC

BO_ 850 ARC_OD_02_03_RL: 64 ARC
 SG_ DistHeight_Obj_03_RL : 487|8@0+ (0.2,-10) [-10|41] "m" ADC
 SG_ DistHeight_Obj_02_RL : 479|8@0+ (0.2,-10) [-10|41] "m" ADC
 SG_ ARC_OD_DistX_Obj_02_RL : 7|12@0+ (0.1,-152) [-152|257.5] "m" ADC
 SG_ ARC_OD_Classification_Obj_02_RL : 98|3@0+ (1,0) [0|7] "" ADC
 SG_ ARC_OD_AabsYStd_Obj_02_RL : 111|8@0+ (0.25,0) [0|63.75] "m/s^2" ADC
 SG_ ARC_OD_ClassConf_Obj_02_RL : 119|7@0+ (1,0) [0|127] "%" ADC
 SG_ ARC_OD_ProbOfExist_Obj_02_RL : 112|7@0+ (1,0) [0|127] "%" ADC
 SG_ ARC_OD_VabsX_Obj_02_RL : 11|11@0+ (0.125,-128) [-128|127.875] "m/s" ADC
 SG_ ARC_OD_DynProp_Obj_02_RL : 130|3@0+ (1,0) [0|7] "" ADC
 SG_ ARC_OD_Length_Obj_02_RL : 136|7@0+ (0.2,0) [0|25.4] "m" ADC
 SG_ ARC_OD_MaintenanceState_Obj_0063 : 145|2@0+ (1,0) [0|3] "" ADC
 SG_ ARC_OD_Width_Obj_02_RL : 159|7@0+ (0.2,0) [0|25.4] "m" ADC
 SG_ ARC_OD_RCS_Obj_02_RL : 152|9@0+ (0.2,-51.1) [-51.1|51.1] "dBsm" ADC
 SG_ ARC_OD_Orientation_Obj_02_RL : 175|10@0+ (0.01,-5.11) [-5.11|5.12] "rad" ADC
 SG_ ARC_OD_LifeCycle_Obj_02_RL : 207|16@0+ (1,0) [0|65535] "" ADC
 SG_ ARC_OD_DistX_Obj_03_RL : 223|12@0+ (0.1,-152) [-152|257.5] "m" ADC
 SG_ ARC_OD_VabsX_Obj_03_RL : 227|11@0+ (0.125,-128) [-128|127.875] "m/s" ADC
 SG_ ARC_OD_AabsX_Obj_03_RL : 232|9@0+ (0.125,-31.875) [-31.875|32] "m/s^2" ADC
 SG_ ARC_OD_AabsX_Obj_02_RL : 16|9@0+ (0.125,-31.875) [-31.875|32] "m/s^2" ADC
 SG_ ARC_OD_DistY_Obj_03_RL : 255|12@0+ (0.0875,-179.113) [-179.113|179.2] "m" ADC
 SG_ ARC_OD_VabsY_Obj_03_RL : 259|11@0+ (0.125,-128) [-128|127.875] "m/s" ADC
 SG_ ARC_OD_AabsY_Obj_03_RL : 264|9@0+ (0.125,-31.875) [-31.875|32] "m/s^2" ADC
 SG_ ARC_OD_DistXStd_Obj_03_RL : 287|8@0+ (0.05,0) [0|12.75] "m" ADC
 SG_ ARC_OD_DistYStd_Obj_03_RL : 295|8@0+ (0.1,0) [0|25.5] "m" ADC
 SG_ ARC_OD_VabsXStd_Obj_03_RL : 303|7@0+ (0.1,0) [0|12.7] "m/s" ADC
 SG_ ARC_OD_VabsYStd_Obj_03_RL : 296|7@0+ (0.2,0) [0|25.4] "m/s" ADC
 SG_ ARC_OD_AabsXStd_Obj_03_RL : 305|7@0+ (0.25,0) [0|31.75] "m/s^2" ADC
 SG_ ARC_OD_Classification_Obj_03_RL : 314|3@0+ (1,0) [0|7] "" ADC
 SG_ ARC_OD_AabsYStd_Obj_03_RL : 327|8@0+ (0.25,0) [0|63.75] "m/s^2" ADC
 SG_ ARC_OD_ClassConf_Obj_03_RL : 335|7@0+ (1,0) [0|127] "%" ADC
 SG_ ARC_OD_DistY_Obj_02_RL : 39|12@0+ (0.0875,-179.113) [-179.113|179.2] "m" ADC
 SG_ ARC_OD_ProbOfExist_Obj_03_RL : 328|7@0+ (1,0) [0|127] "%" ADC
 SG_ ARC_OD_DynProp_Obj_03_RL : 346|3@0+ (1,0) [0|7] "" ADC
 SG_ ARC_OD_Length_Obj_03_RL : 352|7@0+ (0.2,0) [0|25.4] "m" ADC
 SG_ ARC_OD_MaintenanceState_Obj_0064 : 361|2@0+ (1,0) [0|3] "" ADC
 SG_ ARC_OD_Width_Obj_03_RL : 375|7@0+ (0.2,0) [0|25.4] "m" ADC
 SG_ ARC_OD_RCS_Obj_03_RL : 368|9@0+ (0.2,-51.1) [-51.1|51.1] "dBsm" ADC
 SG_ ARC_OD_Orientation_Obj_03_RL : 391|10@0+ (0.01,-5.11) [-5.11|5.12] "rad" ADC
 SG_ ARC_OD_LifeCycle_Obj_03_RL : 423|16@0+ (1,0) [0|65535] "" ADC
 SG_ ARC_OD_ObstacleProb_Obj_02_RL : 447|7@0+ (1,0) [0|127] "%" ADC
 SG_ ARC_OD_ObstacleProb_Obj_03_RL : 455|7@0+ (1,0) [0|127] "%" ADC
 SG_ ARC_OD_VabsY_Obj_02_RL : 43|11@0+ (0.125,-128) [-128|127.875] "m/s" ADC
 SG_ ARC_OD_ID_02_RL : 463|8@0+ (1,0) [0|255] "" ADC
 SG_ ARC_OD_ID_03_RL : 471|8@0+ (1,0) [0|255] "" ADC
 SG_ ARC_OD_MsgCounter_Obj_02_03_RL : 491|4@0+ (1,0) [0|15] "" ADC
 SG_ ARC_OD_CRC8_Obj_02_03_RL : 511|8@0+ (1,0) [0|255] "" ADC
 SG_ ARC_OD_AabsY_Obj_02_RL : 48|9@0+ (0.125,-31.875) [-31.875|32] "m/s^2" ADC
 SG_ ARC_OD_DistXStd_Obj_02_RL : 71|8@0+ (0.05,0) [0|12.75] "m" ADC
 SG_ ARC_OD_DistYStd_Obj_02_RL : 79|8@0+ (0.1,0) [0|25.5] "m" ADC
 SG_ ARC_OD_VabsXStd_Obj_02_RL : 87|7@0+ (0.1,0) [0|12.7] "m/s" ADC
 SG_ ARC_OD_VabsYStd_Obj_02_RL : 80|7@0+ (0.2,0) [0|25.4] "m/s" ADC
 SG_ ARC_OD_AabsXStd_Obj_02_RL : 89|7@0+ (0.25,0) [0|31.75] "m/s^2" ADC

BO_ 851 ARC_OD_04_05_RL: 64 ARC
 SG_ DistHeight_Obj_05_RL : 487|8@0+ (0.2,-10) [-10|41] "m" ADC
 SG_ DistHeight_Obj_04_RL : 479|8@0+ (0.2,-10) [-10|41] "m" ADC
 SG_ ARC_OD_DistX_Obj_04_RL : 7|12@0+ (0.1,-152) [-152|257.5] "m" ADC
 SG_ ARC_OD_Classification_Obj_04_RL : 98|3@0+ (1,0) [0|7] "" ADC
 SG_ ARC_OD_AabsYStd_Obj_04_RL : 111|8@0+ (0.25,0) [0|63.75] "m/s^2" ADC
 SG_ ARC_OD_ClassConf_Obj_04_RL : 119|7@0+ (1,0) [0|127] "%" ADC
 SG_ ARC_OD_ProbOfExist_Obj_04_RL : 112|7@0+ (1,0) [0|127] "%" ADC
 SG_ ARC_OD_VabsX_Obj_04_RL : 11|11@0+ (0.125,-128) [-128|127.875] "m/s" ADC
 SG_ ARC_OD_DynProp_Obj_04_RL : 130|3@0+ (1,0) [0|7] "" ADC
 SG_ ARC_OD_Length_Obj_04_RL : 136|7@0+ (0.2,0) [0|25.4] "m" ADC
 SG_ ARC_OD_MaintenanceState_Obj_0065 : 145|2@0+ (1,0) [0|3] "" ADC
 SG_ ARC_OD_Width_Obj_04_RL : 159|7@0+ (0.2,0) [0|25.4] "m" ADC
 SG_ ARC_OD_RCS_Obj_04_RL : 152|9@0+ (0.2,-51.1) [-51.1|51.1] "dBsm" ADC
 SG_ ARC_OD_Orientation_Obj_04_RL : 175|10@0+ (0.01,-5.11) [-5.11|5.12] "rad" ADC
 SG_ ARC_OD_LifeCycle_Obj_04_RL : 207|16@0+ (1,0) [0|65535] "" ADC
 SG_ ARC_OD_DistX_Obj_05_RL : 223|12@0+ (0.1,-152) [-152|257.5] "m" ADC
 SG_ ARC_OD_VabsX_Obj_05_RL : 227|11@0+ (0.125,-128) [-128|127.875] "m/s" ADC
 SG_ ARC_OD_AabsX_Obj_05_RL : 232|9@0+ (0.125,-31.875) [-31.875|32] "m/s^2" ADC
 SG_ ARC_OD_AabsX_Obj_04_RL : 16|9@0+ (0.125,-31.875) [-31.875|32] "m/s^2" ADC
 SG_ ARC_OD_DistY_Obj_05_RL : 255|12@0+ (0.0875,-179.113) [-179.113|179.2] "m" ADC
 SG_ ARC_OD_VabsY_Obj_05_RL : 259|11@0+ (0.125,-128) [-128|127.875] "m/s" ADC
 SG_ ARC_OD_AabsY_Obj_05_RL : 264|9@0+ (0.125,-31.875) [-31.875|32] "m/s^2" ADC
 SG_ ARC_OD_DistXStd_Obj_05_RL : 287|8@0+ (0.05,0) [0|12.75] "m" ADC
 SG_ ARC_OD_DistYStd_Obj_05_RL : 295|8@0+ (0.1,0) [0|25.5] "m" ADC
 SG_ ARC_OD_VabsXStd_Obj_05_RL : 303|7@0+ (0.1,0) [0|12.7] "m/s" ADC
 SG_ ARC_OD_VabsYStd_Obj_05_RL : 296|7@0+ (0.2,0) [0|25.4] "m/s" ADC
 SG_ ARC_OD_AabsXStd_Obj_05_RL : 305|7@0+ (0.25,0) [0|31.75] "m/s^2" ADC
 SG_ ARC_OD_Classification_Obj_05_RL : 314|3@0+ (1,0) [0|7] "" ADC
 SG_ ARC_OD_AabsYStd_Obj_05_RL : 327|8@0+ (0.25,0) [0|63.75] "m/s^2" ADC
 SG_ ARC_OD_ClassConf_Obj_05_RL : 335|7@0+ (1,0) [0|127] "%" ADC
 SG_ ARC_OD_DistY_Obj_04_RL : 39|12@0+ (0.0875,-179.113) [-179.113|179.2] "m" ADC
 SG_ ARC_OD_ProbOfExist_Obj_05_RL : 328|7@0+ (1,0) [0|127] "%" ADC
 SG_ ARC_OD_DynProp_Obj_05_RL : 346|3@0+ (1,0) [0|7] "" ADC
 SG_ ARC_OD_Length_Obj_05_RL : 352|7@0+ (0.2,0) [0|25.4] "m" ADC
 SG_ ARC_OD_MaintenanceState_Obj_0066 : 361|2@0+ (1,0) [0|3] "" ADC
 SG_ ARC_OD_Width_Obj_05_RL : 375|7@0+ (0.2,0) [0|25.4] "m" ADC
 SG_ ARC_OD_RCS_Obj_05_RL : 368|9@0+ (0.2,-51.1) [-51.1|51.1] "dBsm" ADC
 SG_ ARC_OD_Orientation_Obj_05_RL : 391|10@0+ (0.01,-5.11) [-5.11|5.12] "rad" ADC
 SG_ ARC_OD_LifeCycle_Obj_05_RL : 423|16@0+ (1,0) [0|65535] "" ADC
 SG_ ARC_OD_ObstacleProb_Obj_04_RL : 447|7@0+ (1,0) [0|127] "%" ADC
 SG_ ARC_OD_ObstacleProb_Obj_05_RL : 455|7@0+ (1,0) [0|127] "%" ADC
 SG_ ARC_OD_VabsY_Obj_04_RL : 43|11@0+ (0.125,-128) [-128|127.875] "m/s" ADC
 SG_ ARC_OD_ID_04_RL : 463|8@0+ (1,0) [0|255] "" ADC
 SG_ ARC_OD_ID_05_RL : 471|8@0+ (1,0) [0|255] "" ADC
 SG_ ARC_OD_MsgCounter_Obj_04_05_RL : 491|4@0+ (1,0) [0|15] "" ADC
 SG_ ARC_OD_CRC8_Obj_04_05_RL : 511|8@0+ (1,0) [0|256] "" ADC
 SG_ ARC_OD_AabsY_Obj_04_RL : 48|9@0+ (0.125,-31.875) [-31.875|32] "m/s^2" ADC
 SG_ ARC_OD_DistXStd_Obj_04_RL : 71|8@0+ (0.05,0) [0|12.75] "m" ADC
 SG_ ARC_OD_DistYStd_Obj_04_RL : 79|8@0+ (0.1,0) [0|25.5] "m" ADC
 SG_ ARC_OD_VabsXStd_Obj_04_RL : 87|7@0+ (0.1,0) [0|12.7] "m/s" ADC
 SG_ ARC_OD_VabsYStd_Obj_04_RL : 80|7@0+ (0.2,0) [0|25.4] "m/s" ADC
 SG_ ARC_OD_AabsXStd_Obj_04_RL : 89|7@0+ (0.25,0) [0|31.75] "m/s^2" ADC

BO_ 852 ARC_OD_06_07_RL: 64 ARC
 SG_ DistHeight_Obj_07_RL : 487|8@0+ (0.2,-10) [-10|41] "m" ADC
 SG_ DistHeight_Obj_06_RL : 479|8@0+ (0.2,-10) [-10|41] "m" ADC
 SG_ ARC_OD_DistX_Obj_06_RL : 7|12@0+ (0.1,-152) [-152|257.5] "m" ADC
 SG_ ARC_OD_Classification_Obj_06_RL : 98|3@0+ (1,0) [0|7] "" ADC
 SG_ ARC_OD_AabsYStd_Obj_06_RL : 111|8@0+ (0.25,0) [0|63.75] "m/s^2" ADC
 SG_ ARC_OD_ClassConf_Obj_06_RL : 119|7@0+ (1,0) [0|127] "%" ADC
 SG_ ARC_OD_ProbOfExist_Obj_06_RL : 112|7@0+ (1,0) [0|127] "%" ADC
 SG_ ARC_OD_VabsX_Obj_06_RL : 11|11@0+ (0.125,-128) [-128|127.875] "m/s" ADC
 SG_ ARC_OD_DynProp_Obj_06_RL : 130|3@0+ (1,0) [0|7] "" ADC
 SG_ ARC_OD_Length_Obj_06_RL : 136|7@0+ (0.2,0) [0|25.4] "m" ADC
 SG_ ARC_OD_MaintenanceState_Obj_0067 : 145|2@0+ (1,0) [0|3] "" ADC
 SG_ ARC_OD_Width_Obj_06_RL : 159|7@0+ (0.2,0) [0|25.4] "m" ADC
 SG_ ARC_OD_RCS_Obj_06_RL : 152|9@0+ (0.2,-51.1) [-51.1|51.1] "dBsm" ADC
 SG_ ARC_OD_Orientation_Obj_06_RL : 175|10@0+ (0.01,-5.11) [-5.11|5.12] "rad" ADC
 SG_ ARC_OD_LifeCycle_Obj_06_RL : 207|16@0+ (1,0) [0|65535] "" ADC
 SG_ ARC_OD_DistX_Obj_07_RL : 223|12@0+ (0.1,-152) [-152|257.5] "m" ADC
 SG_ ARC_OD_VabsX_Obj_07_RL : 227|11@0+ (0.125,-128) [-128|127.875] "m/s" ADC
 SG_ ARC_OD_AabsX_Obj_07_RL : 232|9@0+ (0.125,-31.875) [-31.875|32] "m/s^2" ADC
 SG_ ARC_OD_AabsX_Obj_06_RL : 16|9@0+ (0.125,-31.875) [-31.875|32] "m/s^2" ADC
 SG_ ARC_OD_DistY_Obj_07_RL : 255|12@0+ (0.0875,-179.113) [-179.113|179.2] "m" ADC
 SG_ ARC_OD_VabsY_Obj_07_RL : 259|11@0+ (0.125,-128) [-128|127.875] "m/s" ADC
 SG_ ARC_OD_AabsY_Obj_07_RL : 264|9@0+ (0.125,-31.875) [-31.875|32] "m/s^2" ADC
 SG_ ARC_OD_DistXStd_Obj_07_RL : 287|8@0+ (0.05,0) [0|12.75] "m" ADC
 SG_ ARC_OD_DistYStd_Obj_07_RL : 295|8@0+ (0.1,0) [0|25.5] "m" ADC
 SG_ ARC_OD_VabsXStd_Obj_07_RL : 303|7@0+ (0.1,0) [0|12.7] "m/s" ADC
 SG_ ARC_OD_VabsYStd_Obj_07_RL : 296|7@0+ (0.2,0) [0|25.4] "m/s" ADC
 SG_ ARC_OD_AabsXStd_Obj_07_RL : 305|7@0+ (0.25,0) [0|31.75] "m/s^2" ADC
 SG_ ARC_OD_Classification_Obj_07_RL : 314|3@0+ (1,0) [0|7] "" ADC
 SG_ ARC_OD_AabsYStd_Obj_07_RL : 327|8@0+ (0.25,0) [0|63.75] "m/s^2" ADC
 SG_ ARC_OD_ClassConf_Obj_07_RL : 335|7@0+ (1,0) [0|127] "%" ADC
 SG_ ARC_OD_DistY_Obj_06_RL : 39|12@0+ (0.0875,-179.113) [-179.113|179.2] "m" ADC
 SG_ ARC_OD_ProbOfExist_Obj_07_RL : 328|7@0+ (1,0) [0|127] "%" ADC
 SG_ ARC_OD_DynProp_Obj_07_RL : 346|3@0+ (1,0) [0|7] "" ADC
 SG_ ARC_OD_Length_Obj_07_RL : 352|7@0+ (0.2,0) [0|25.4] "m" ADC
 SG_ ARC_OD_MaintenanceState_Obj_0068 : 361|2@0+ (1,0) [0|3] "" ADC
 SG_ ARC_OD_Width_Obj_07_RL : 375|7@0+ (0.2,0) [0|25.4] "m" ADC
 SG_ ARC_OD_RCS_Obj_07_RL : 368|9@0+ (0.2,-51.1) [-51.1|51.1] "dBsm" ADC
 SG_ ARC_OD_Orientation_Obj_07_RL : 391|10@0+ (0.01,-5.11) [-5.11|5.12] "rad" ADC
 SG_ ARC_OD_LifeCycle_Obj_07_RL : 423|16@0+ (1,0) [0|65535] "" ADC
 SG_ ARC_OD_ObstacleProb_Obj_06_RL : 447|7@0+ (1,0) [0|127] "%" ADC
 SG_ ARC_OD_ObstacleProb_Obj_07_RL : 455|7@0+ (1,0) [0|127] "%" ADC
 SG_ ARC_OD_VabsY_Obj_06_RL : 43|11@0+ (0.125,-128) [-128|127.875] "m/s" ADC
 SG_ ARC_OD_ID_06_RL : 463|8@0+ (1,0) [0|255] "" ADC
 SG_ ARC_OD_ID_07_RL : 471|8@0+ (1,0) [0|255] "" ADC
 SG_ ARC_OD_MsgCounter_Obj_06_07_RL : 491|4@0+ (1,0) [0|15] "" ADC
 SG_ ARC_OD_CRC8_Obj_06_07_RL : 511|8@0+ (1,0) [0|256] "" ADC
 SG_ ARC_OD_AabsY_Obj_06_RL : 48|9@0+ (0.125,-31.875) [-31.875|32] "m/s^2" ADC
 SG_ ARC_OD_DistXStd_Obj_06_RL : 71|8@0+ (0.05,0) [0|12.75] "m" ADC
 SG_ ARC_OD_DistYStd_Obj_06_RL : 79|8@0+ (0.1,0) [0|25.5] "m" ADC
 SG_ ARC_OD_VabsXStd_Obj_06_RL : 87|7@0+ (0.1,0) [0|12.7] "m/s" ADC
 SG_ ARC_OD_VabsYStd_Obj_06_RL : 80|7@0+ (0.2,0) [0|25.4] "m/s" ADC
 SG_ ARC_OD_AabsXStd_Obj_06_RL : 89|7@0+ (0.25,0) [0|31.75] "m/s^2" ADC

BO_ 853 ARC_OD_08_09_RL: 64 ARC
 SG_ DistHeight_Obj_09_RL : 487|8@0+ (0.2,-10) [-10|41] "m" ADC
 SG_ DistHeight_Obj_08_RL : 479|8@0+ (0.2,-10) [-10|41] "m" ADC
 SG_ ARC_OD_DistX_Obj_08_RL : 7|12@0+ (0.1,-152) [-152|257.5] "m" ADC
 SG_ ARC_OD_Classification_Obj_08_RL : 98|3@0+ (1,0) [0|7] "" ADC
 SG_ ARC_OD_AabsYStd_Obj_08_RL : 111|8@0+ (0.25,0) [0|63.75] "m/s^2" ADC
 SG_ ARC_OD_ClassConf_Obj_08_RL : 119|7@0+ (1,0) [0|127] "%" ADC
 SG_ ARC_OD_ProbOfExist_Obj_08_RL : 112|7@0+ (1,0) [0|127] "%" ADC
 SG_ ARC_OD_VabsX_Obj_08_RL : 11|11@0+ (0.125,-128) [-128|127.875] "m/s" ADC
 SG_ ARC_OD_DynProp_Obj_08_RL : 130|3@0+ (1,0) [0|7] "" ADC
 SG_ ARC_OD_Length_Obj_08_RL : 136|7@0+ (0.2,0) [0|25.4] "m" ADC
 SG_ ARC_OD_MaintenanceState_Obj_0069 : 145|2@0+ (1,0) [0|3] "" ADC
 SG_ ARC_OD_Width_Obj_08_RL : 159|7@0+ (0.2,0) [0|25.4] "m" ADC
 SG_ ARC_OD_RCS_Obj_08_RL : 152|9@0+ (0.2,-51.1) [-51.1|51.1] "dBsm" ADC
 SG_ ARC_OD_Orientation_Obj_08_RL : 175|10@0+ (0.01,-5.11) [-5.11|5.12] "rad" ADC
 SG_ ARC_OD_LifeCycle_Obj_08_RL : 207|16@0+ (1,0) [0|65535] "" ADC
 SG_ ARC_OD_DistX_Obj_09_RL : 223|12@0+ (0.1,-152) [-152|257.5] "m" ADC
 SG_ ARC_OD_VabsX_Obj_09_RL : 227|11@0+ (0.125,-128) [-128|127.875] "m/s" ADC
 SG_ ARC_OD_AabsX_Obj_09_RL : 232|9@0+ (0.125,-31.875) [-31.875|32] "m/s^2" ADC
 SG_ ARC_OD_AabsX_Obj_08_RL : 16|9@0+ (0.125,-31.875) [-31.875|32] "m/s^2" ADC
 SG_ ARC_OD_DistY_Obj_09_RL : 255|12@0+ (0.0875,-179.113) [-179.113|179.2] "m" ADC
 SG_ ARC_OD_VabsY_Obj_09_RL : 259|11@0+ (0.125,-128) [-128|127.875] "m/s" ADC
 SG_ ARC_OD_AabsY_Obj_09_RL : 264|9@0+ (0.125,-31.875) [-31.875|32] "m/s^2" ADC
 SG_ ARC_OD_DistXStd_Obj_09_RL : 287|8@0+ (0.05,0) [0|12.75] "m" ADC
 SG_ ARC_OD_DistYStd_Obj_09_RL : 295|8@0+ (0.1,0) [0|25.5] "m" ADC
 SG_ ARC_OD_VabsXStd_Obj_09_RL : 303|7@0+ (0.1,0) [0|12.7] "m/s" ADC
 SG_ ARC_OD_VabsYStd_Obj_09_RL : 296|7@0+ (0.2,0) [0|25.4] "m/s" ADC
 SG_ ARC_OD_AabsXStd_Obj_09_RL : 305|7@0+ (0.25,0) [0|31.75] "m/s^2" ADC
 SG_ ARC_OD_Classification_Obj_09_RL : 314|3@0+ (1,0) [0|7] "" ADC
 SG_ ARC_OD_AabsYStd_Obj_09_RL : 327|8@0+ (0.25,0) [0|63.75] "m/s^2" ADC
 SG_ ARC_OD_ClassConf_Obj_09_RL : 335|7@0+ (1,0) [0|127] "%" ADC
 SG_ ARC_OD_DistY_Obj_08_RL : 39|12@0+ (0.0875,-179.113) [-179.113|179.2] "m" ADC
 SG_ ARC_OD_ProbOfExist_Obj_09_RL : 328|7@0+ (1,0) [0|127] "%" ADC
 SG_ ARC_OD_DynProp_Obj_09_RL : 346|3@0+ (1,0) [0|7] "" ADC
 SG_ ARC_OD_Length_Obj_09_RL : 352|7@0+ (0.2,0) [0|25.4] "m" ADC
 SG_ ARC_OD_MaintenanceState_Obj_0070 : 361|2@0+ (1,0) [0|3] "" ADC
 SG_ ARC_OD_Width_Obj_09_RL : 375|7@0+ (0.2,0) [0|25.4] "m" ADC
 SG_ ARC_OD_RCS_Obj_09_RL : 368|9@0+ (0.2,-51.1) [-51.1|51.1] "dBsm" ADC
 SG_ ARC_OD_Orientation_Obj_09_RL : 391|10@0+ (0.01,-5.11) [-5.11|5.12] "rad" ADC
 SG_ ARC_OD_LifeCycle_Obj_09_RL : 423|16@0+ (1,0) [0|65535] "" ADC
 SG_ ARC_OD_ObstacleProb_Obj_08_RL : 447|7@0+ (1,0) [0|127] "%" ADC
 SG_ ARC_OD_ObstacleProb_Obj_09_RL : 455|7@0+ (1,0) [0|127] "%" ADC
 SG_ ARC_OD_VabsY_Obj_08_RL : 43|11@0+ (0.125,-128) [-128|127.875] "m/s" ADC
 SG_ ARC_OD_ID_08_RL : 463|8@0+ (1,0) [0|255] "" ADC
 SG_ ARC_OD_ID_09_RL : 471|8@0+ (1,0) [0|255] "" ADC
 SG_ ARC_OD_MsgCounter_Obj_08_09_RL : 491|4@0+ (1,0) [0|15] "" ADC
 SG_ ARC_OD_CRC8_Obj_08_09_RL : 511|8@0+ (1,0) [0|256] "" ADC
 SG_ ARC_OD_AabsY_Obj_08_RL : 48|9@0+ (0.125,-31.875) [-31.875|32] "m/s^2" ADC
 SG_ ARC_OD_DistXStd_Obj_08_RL : 71|8@0+ (0.05,0) [0|12.75] "m" ADC
 SG_ ARC_OD_DistYStd_Obj_08_RL : 79|8@0+ (0.1,0) [0|25.5] "m" ADC
 SG_ ARC_OD_VabsXStd_Obj_08_RL : 87|7@0+ (0.1,0) [0|12.7] "m/s" ADC
 SG_ ARC_OD_VabsYStd_Obj_08_RL : 80|7@0+ (0.2,0) [0|25.4] "m/s" ADC
 SG_ ARC_OD_AabsXStd_Obj_08_RL : 89|7@0+ (0.25,0) [0|31.75] "m/s^2" ADC

BO_ 854 ARC_OD_10_11_RL: 64 ARC
 SG_ DistHeight_Obj_11_RL : 487|8@0+ (0.2,-10) [-10|41] "m" ADC
 SG_ DistHeight_Obj_10_RL : 479|8@0+ (0.2,-10) [-10|41] "m" ADC
 SG_ ARC_OD_DistX_Obj_10_RL : 7|12@0+ (0.1,-152) [-152|257.5] "m" ADC
 SG_ ARC_OD_Classification_Obj_10_RL : 98|3@0+ (1,0) [0|7] "" ADC
 SG_ ARC_OD_AabsYStd_Obj_10_RL : 111|8@0+ (0.25,0) [0|63.75] "m/s^2" ADC
 SG_ ARC_OD_ClassConf_Obj_10_RL : 119|7@0+ (1,0) [0|127] "%" ADC
 SG_ ARC_OD_ProbOfExist_Obj_10_RL : 112|7@0+ (1,0) [0|127] "%" ADC
 SG_ ARC_OD_VabsX_Obj_10_RL : 11|11@0+ (0.125,-128) [-128|127.875] "m/s" ADC
 SG_ ARC_OD_DynProp_Obj_10_RL : 130|3@0+ (1,0) [0|7] "" ADC
 SG_ ARC_OD_Length_Obj_10_RL : 136|7@0+ (0.2,0) [0|25.4] "m" ADC
 SG_ ARC_OD_MaintenanceState_Obj_0071 : 145|2@0+ (1,0) [0|3] "" ADC
 SG_ ARC_OD_Width_Obj_10_RL : 159|7@0+ (0.2,0) [0|25.4] "m" ADC
 SG_ ARC_OD_RCS_Obj_10_RL : 152|9@0+ (0.2,-51.1) [-51.1|51.1] "dBsm" ADC
 SG_ ARC_OD_Orientation_Obj_10_RL : 175|10@0+ (0.01,-5.11) [-5.11|5.12] "rad" ADC
 SG_ ARC_OD_LifeCycle_Obj_10_RL : 207|16@0+ (1,0) [0|65535] "" ADC
 SG_ ARC_OD_DistX_Obj_11_RL : 223|12@0+ (0.1,-152) [-152|257.5] "m" ADC
 SG_ ARC_OD_VabsX_Obj_11_RL : 227|11@0+ (0.125,-128) [-128|127.875] "m/s" ADC
 SG_ ARC_OD_AabsX_Obj_11_RL : 232|9@0+ (0.125,-31.875) [-31.875|32] "m/s^2" ADC
 SG_ ARC_OD_AabsX_Obj_10_RL : 16|9@0+ (0.125,-31.875) [-31.875|32] "m/s^2" ADC
 SG_ ARC_OD_DistY_Obj_11_RL : 255|12@0+ (0.0875,-179.113) [-179.113|179.2] "m" ADC
 SG_ ARC_OD_VabsY_Obj_11_RL : 259|11@0+ (0.125,-128) [-128|127.875] "m/s" ADC
 SG_ ARC_OD_AabsY_Obj_11_RL : 264|9@0+ (0.125,-31.875) [-31.875|32] "m/s^2" ADC
 SG_ ARC_OD_DistXStd_Obj_11_RL : 287|8@0+ (0.05,0) [0|12.75] "m" ADC
 SG_ ARC_OD_DistYStd_Obj_11_RL : 295|8@0+ (0.1,0) [0|25.5] "m" ADC
 SG_ ARC_OD_VabsXStd_Obj_11_RL : 303|7@0+ (0.1,0) [0|12.7] "m/s" ADC
 SG_ ARC_OD_VabsYStd_Obj_11_RL : 296|7@0+ (0.2,0) [0|25.4] "m/s" ADC
 SG_ ARC_OD_AabsXStd_Obj_11_RL : 305|7@0+ (0.25,0) [0|31.75] "m/s^2" ADC
 SG_ ARC_OD_Classification_Obj_11_RL : 314|3@0+ (1,0) [0|7] "" ADC
 SG_ ARC_OD_AabsYStd_Obj_11_RL : 327|8@0+ (0.25,0) [0|63.75] "m/s^2" ADC
 SG_ ARC_OD_ClassConf_Obj_11_RL : 335|7@0+ (1,0) [0|127] "%" ADC
 SG_ ARC_OD_DistY_Obj_10_RL : 39|12@0+ (0.0875,-179.113) [-179.113|179.2] "m" ADC
 SG_ ARC_OD_ProbOfExist_Obj_11_RL : 328|7@0+ (1,0) [0|127] "%" ADC
 SG_ ARC_OD_DynProp_Obj_11_RL : 346|3@0+ (1,0) [0|7] "" ADC
 SG_ ARC_OD_Length_Obj_11_RL : 352|7@0+ (0.2,0) [0|25.4] "m" ADC
 SG_ ARC_OD_MaintenanceState_Obj_0072 : 361|2@0+ (1,0) [0|3] "" ADC
 SG_ ARC_OD_Width_Obj_11_RL : 375|7@0+ (0.2,0) [0|25.4] "m" ADC
 SG_ ARC_OD_RCS_Obj_11_RL : 368|9@0+ (0.2,-51.1) [-51.1|51.1] "dBsm" ADC
 SG_ ARC_OD_Orientation_Obj_11_RL : 391|10@0+ (0.01,-5.11) [-5.11|5.12] "rad" ADC
 SG_ ARC_OD_LifeCycle_Obj_11_RL : 423|16@0+ (1,0) [0|65535] "" ADC
 SG_ ARC_OD_ObstacleProb_Obj_10_RL : 447|7@0+ (1,0) [0|127] "%" ADC
 SG_ ARC_OD_ObstacleProb_Obj_11_RL : 455|7@0+ (1,0) [0|127] "%" ADC
 SG_ ARC_OD_VabsY_Obj_10_RL : 43|11@0+ (0.125,-128) [-128|127.875] "m/s" ADC
 SG_ ARC_OD_ID_10_RL : 463|8@0+ (1,0) [0|255] "" ADC
 SG_ ARC_OD_ID_11_RL : 471|8@0+ (1,0) [0|255] "" ADC
 SG_ ARC_OD_MsgCounter_Obj_10_11_RL : 491|4@0+ (1,0) [0|15] "" ADC
 SG_ ARC_OD_CRC8_Obj_10_11_RL : 511|8@0+ (1,0) [0|256] "" ADC
 SG_ ARC_OD_AabsY_Obj_10_RL : 48|9@0+ (0.125,-31.875) [-31.875|32] "m/s^2" ADC
 SG_ ARC_OD_DistXStd_Obj_10_RL : 71|8@0+ (0.05,0) [0|12.75] "m" ADC
 SG_ ARC_OD_DistYStd_Obj_10_RL : 79|8@0+ (0.1,0) [0|25.5] "m" ADC
 SG_ ARC_OD_VabsXStd_Obj_10_RL : 87|7@0+ (0.1,0) [0|12.7] "m/s" ADC
 SG_ ARC_OD_VabsYStd_Obj_10_RL : 80|7@0+ (0.2,0) [0|25.4] "m/s" ADC
 SG_ ARC_OD_AabsXStd_Obj_10_RL : 89|7@0+ (0.25,0) [0|31.75] "m/s^2" ADC

BO_ 855 ARC_OD_12_13_RL: 64 ARC
 SG_ DistHeight_Obj_13_RL : 487|8@0+ (0.2,-10) [-10|41] "m" ADC
 SG_ DistHeight_Obj_12_RL : 479|8@0+ (0.2,-10) [-10|41] "m" ADC
 SG_ ARC_OD_DistX_Obj_12_RL : 7|12@0+ (0.1,-152) [-152|257.5] "m" ADC
 SG_ ARC_OD_Classification_Obj_12_RL : 98|3@0+ (1,0) [0|7] "" ADC
 SG_ ARC_OD_AabsYStd_Obj_12_RL : 111|8@0+ (0.25,0) [0|63.75] "m/s^2" ADC
 SG_ ARC_OD_ClassConf_Obj_12_RL : 119|7@0+ (1,0) [0|127] "%" ADC
 SG_ ARC_OD_ProbOfExist_Obj_12_RL : 112|7@0+ (1,0) [0|127] "%" ADC
 SG_ ARC_OD_VabsX_Obj_12_RL : 11|11@0+ (0.125,-128) [-128|127.875] "m/s" ADC
 SG_ ARC_OD_DynProp_Obj_12_RL : 130|3@0+ (1,0) [0|7] "" ADC
 SG_ ARC_OD_Length_Obj_12_RL : 136|7@0+ (0.2,0) [0|25.4] "m" ADC
 SG_ ARC_OD_MaintenanceState_Obj_0073 : 145|2@0+ (1,0) [0|3] "" ADC
 SG_ ARC_OD_Width_Obj_12_RL : 159|7@0+ (0.2,0) [0|25.4] "m" ADC
 SG_ ARC_OD_RCS_Obj_12_RL : 152|9@0+ (0.2,-51.1) [-51.1|51.1] "dBsm" ADC
 SG_ ARC_OD_Orientation_Obj_12_RL : 175|10@0+ (0.01,-5.11) [-5.11|5.12] "rad" ADC
 SG_ ARC_OD_LifeCycle_Obj_12_RL : 207|16@0+ (1,0) [0|65535] "" ADC
 SG_ ARC_OD_DistX_Obj_13_RL : 223|12@0+ (0.1,-152) [-152|257.5] "m" ADC
 SG_ ARC_OD_VabsX_Obj_13_RL : 227|11@0+ (0.125,-128) [-128|127.875] "m/s" ADC
 SG_ ARC_OD_AabsX_Obj_13_RL : 232|9@0+ (0.125,-31.875) [-31.875|32] "m/s^2" ADC
 SG_ ARC_OD_AabsX_Obj_12_RL : 16|9@0+ (0.125,-31.875) [-31.875|32] "m/s^2" ADC
 SG_ ARC_OD_DistY_Obj_13_RL : 255|12@0+ (0.0875,-179.113) [-179.113|179.2] "m" ADC
 SG_ ARC_OD_VabsY_Obj_13_RL : 259|11@0+ (0.125,-128) [-128|127.875] "m/s" ADC
 SG_ ARC_OD_AabsY_Obj_13_RL : 264|9@0+ (0.125,-31.875) [-31.875|32] "m/s^2" ADC
 SG_ ARC_OD_DistXStd_Obj_13_RL : 287|8@0+ (0.05,0) [0|12.75] "m" ADC
 SG_ ARC_OD_DistYStd_Obj_13_RL : 295|8@0+ (0.1,0) [0|25.5] "m" ADC
 SG_ ARC_OD_VabsXStd_Obj_13_RL : 303|7@0+ (0.1,0) [0|12.7] "m/s" ADC
 SG_ ARC_OD_VabsYStd_Obj_13_RL : 296|7@0+ (0.2,0) [0|25.4] "m/s" ADC
 SG_ ARC_OD_AabsXStd_Obj_13_RL : 305|7@0+ (0.25,0) [0|31.75] "m/s^2" ADC
 SG_ ARC_OD_Classification_Obj_13_RL : 314|3@0+ (1,0) [0|7] "" ADC
 SG_ ARC_OD_AabsYStd_Obj_13_RL : 327|8@0+ (0.25,0) [0|63.75] "m/s^2" ADC
 SG_ ARC_OD_ClassConf_Obj_13_RL : 335|7@0+ (1,0) [0|127] "%" ADC
 SG_ ARC_OD_DistY_Obj_12_RL : 39|12@0+ (0.0875,-179.113) [-179.113|179.2] "m" ADC
 SG_ ARC_OD_ProbOfExist_Obj_13_RL : 328|7@0+ (1,0) [0|127] "%" ADC
 SG_ ARC_OD_DynProp_Obj_13_RL : 346|3@0+ (1,0) [0|7] "" ADC
 SG_ ARC_OD_Length_Obj_13_RL : 352|7@0+ (0.2,0) [0|25.4] "m" ADC
 SG_ ARC_OD_MaintenanceState_Obj_0074 : 361|2@0+ (1,0) [0|3] "" ADC
 SG_ ARC_OD_Width_Obj_13_RL : 375|7@0+ (0.2,0) [0|25.4] "m" ADC
 SG_ ARC_OD_RCS_Obj_13_RL : 368|9@0+ (0.2,-51.1) [-51.1|51.1] "dBsm" ADC
 SG_ ARC_OD_Orientation_Obj_13_RL : 391|10@0+ (0.01,-5.11) [-5.11|5.12] "rad" ADC
 SG_ ARC_OD_LifeCycle_Obj_13_RL : 423|16@0+ (1,0) [0|65535] "" ADC
 SG_ ARC_OD_ObstacleProb_Obj_12_RL : 447|7@0+ (1,0) [0|127] "%" ADC
 SG_ ARC_OD_ObstacleProb_Obj_13_RL : 455|7@0+ (1,0) [0|127] "%" ADC
 SG_ ARC_OD_VabsY_Obj_12_RL : 43|11@0+ (0.125,-128) [-128|127.875] "m/s" ADC
 SG_ ARC_OD_ID_12_RL : 463|8@0+ (1,0) [0|255] "" ADC
 SG_ ARC_OD_ID_13_RL : 471|8@0+ (1,0) [0|255] "" ADC
 SG_ ARC_OD_MsgCounter_Obj_12_13_RL : 491|4@0+ (1,0) [0|15] "" ADC
 SG_ ARC_OD_CRC8_Obj_12_13_RL : 511|8@0+ (1,0) [0|256] "" ADC
 SG_ ARC_OD_AabsY_Obj_12_RL : 48|9@0+ (0.125,-31.875) [-31.875|32] "m/s^2" ADC
 SG_ ARC_OD_DistXStd_Obj_12_RL : 71|8@0+ (0.05,0) [0|12.75] "m" ADC
 SG_ ARC_OD_DistYStd_Obj_12_RL : 79|8@0+ (0.1,0) [0|25.5] "m" ADC
 SG_ ARC_OD_VabsXStd_Obj_12_RL : 87|7@0+ (0.1,0) [0|12.7] "m/s" ADC
 SG_ ARC_OD_VabsYStd_Obj_12_RL : 80|7@0+ (0.2,0) [0|25.4] "m/s" ADC
 SG_ ARC_OD_AabsXStd_Obj_12_RL : 89|7@0+ (0.25,0) [0|31.75] "m/s^2" ADC

CM_ SG_ 1106 ARC_OD_DistX_Obj_02_RR "111";
CM_ SG_ 850 ARC_OD_DistX_Obj_02_RL "111";

BA_DEF_ BO_ "GenMsgCycleTime" INT 0 65535;
BA_DEF_ BO_ "GenMsgSendType" ENUM "Cycle","OnChange","OnWrite","OnWriteWithRepetition","OnChangeWithRepetition","IfActive","IfActiveWithRepetition","NoMsgSendType";
BA_DEF_ BO_ "VFrameFormat" ENUM "StandardCAN","ExtendedCAN","reserved","reserved","reserved","reserved","reserved","reserved","reserved","reserved","reserved","reserved","reserved","reserved","StandardCAN_FD","ExtendedCAN_FD";
BA_DEF_ SG_ "GenSigILSupport" ENUM "No","Yes";
BA_DEF_ SG_ "GenSigInactiveValue" HEX 0 0;
BA_DEF_ SG_ "GenSigSendType" ENUM "Cycle","OnWrite","OnWriteWithRepetition","OnChange","OnChangeWithRepetition","IfActive","IfActiveWithRepetition","NoSigSendType","vector_leerstring";
BA_DEF_ SG_ "GenSigStartValue" FLOAT 0 100000000000;
BA_DEF_DEF_ "GenMsgCycleTime" 0;
BA_DEF_DEF_ "GenMsgSendType" "Cycle";
BA_DEF_DEF_ "VFrameFormat" "StandardCAN";
BA_DEF_DEF_ "GenSigILSupport" "Yes";
BA_DEF_DEF_ "GenSigSendType" "NoSigSendType";
BA_DEF_DEF_ "GenSigStartValue" 0;
BA_DEF_DEF_ "GenSigInactiveValue" 0;
BA_ "GenMsgCycleTime" BO_ 1121 50;
BA_ "VFrameFormat" BO_ 1121 14;
BA_ "GenMsgCycleTime" BO_ 1120 50;
BA_ "VFrameFormat" BO_ 1120 14;
BA_ "GenMsgCycleTime" BO_ 1119 50;
BA_ "VFrameFormat" BO_ 1119 14;
BA_ "GenMsgCycleTime" BO_ 1118 50;
BA_ "VFrameFormat" BO_ 1118 14;
BA_ "GenMsgCycleTime" BO_ 1117 50;
BA_ "VFrameFormat" BO_ 1117 14;
BA_ "GenMsgCycleTime" BO_ 1116 50;
BA_ "VFrameFormat" BO_ 1116 14;
BA_ "GenMsgCycleTime" BO_ 1115 50;
BA_ "VFrameFormat" BO_ 1115 14;
BA_ "GenMsgCycleTime" BO_ 1114 50;
BA_ "VFrameFormat" BO_ 1114 14;
BA_ "GenMsgCycleTime" BO_ 1113 50;
BA_ "VFrameFormat" BO_ 1113 14;
BA_ "GenMsgCycleTime" BO_ 1112 50;
BA_ "VFrameFormat" BO_ 1112 14;
BA_ "GenMsgCycleTime" BO_ 1111 50;
BA_ "VFrameFormat" BO_ 1111 14;
BA_ "GenMsgCycleTime" BO_ 1110 50;
BA_ "VFrameFormat" BO_ 1110 14;
BA_ "GenMsgCycleTime" BO_ 1109 50;
BA_ "VFrameFormat" BO_ 1109 14;
BA_ "GenMsgCycleTime" BO_ 1108 50;
BA_ "VFrameFormat" BO_ 1108 14;
BA_ "GenMsgCycleTime" BO_ 1107 50;
BA_ "VFrameFormat" BO_ 1107 14;
BA_ "GenMsgCycleTime" BO_ 1106 50;
BA_ "VFrameFormat" BO_ 1106 14;
BA_ "GenMsgCycleTime" BO_ 1105 50;
BA_ "VFrameFormat" BO_ 1105 14;
BA_ "GenMsgCycleTime" BO_ 1616 50;
BA_ "VFrameFormat" BO_ 1616 14;
BA_ "GenMsgCycleTime" BO_ 1360 50;
BA_ "VFrameFormat" BO_ 1360 14;
BA_ "GenMsgCycleTime" BO_ 1104 50;
BA_ "VFrameFormat" BO_ 1104 14;
BA_ "GenMsgCycleTime" BO_ 102 500;
BA_ "VFrameFormat" BO_ 102 14;
BA_ "GenMsgCycleTime" BO_ 105 500;
BA_ "VFrameFormat" BO_ 105 14;
BA_ "GenMsgCycleTime" BO_ 99 500;
BA_ "VFrameFormat" BO_ 99 14;
BA_ "GenMsgCycleTime" BO_ 96 500;
BA_ "VFrameFormat" BO_ 96 14;
BA_ "GenMsgCycleTime" BO_ 848 50;
BA_ "VFrameFormat" BO_ 848 14;
BA_ "GenMsgCycleTime" BO_ 849 50;
BA_ "VFrameFormat" BO_ 849 14;
BA_ "GenMsgCycleTime" BO_ 850 50;
BA_ "VFrameFormat" BO_ 850 14;
BA_ "GenMsgCycleTime" BO_ 851 50;
BA_ "VFrameFormat" BO_ 851 14;
BA_ "GenMsgCycleTime" BO_ 852 50;
BA_ "VFrameFormat" BO_ 852 14;
BA_ "GenMsgCycleTime" BO_ 853 50;
BA_ "VFrameFormat" BO_ 853 14;
BA_ "GenMsgCycleTime" BO_ 854 50;
BA_ "VFrameFormat" BO_ 854 14;
BA_ "GenMsgCycleTime" BO_ 855 50;
BA_ "VFrameFormat" BO_ 855 14;
BA_ "GenSigSendType" SG_ 1121 DistHeight_Obj_33_RR 8;
BA_ "GenSigSendType" SG_ 1121 DistHeight_Obj_32_RR 8;
BA_ "GenSigSendType" SG_ 1121 ARC_OD_DistX_Obj_32_RR 8;
BA_ "GenSigSendType" SG_ 1121 ARC_OD_Classification_Obj_32_RR 8;
BA_ "GenSigSendType" SG_ 1121 ARC_OD_AabsYStd_Obj_32_RR 8;
BA_ "GenSigSendType" SG_ 1121 ARC_OD_ClassConf_Obj_32_RR 8;
BA_ "GenSigSendType" SG_ 1121 ARC_OD_ProbOfExist_Obj_32_RR 8;
BA_ "GenSigSendType" SG_ 1121 ARC_OD_VabsX_Obj_32_RR 8;
BA_ "GenSigSendType" SG_ 1121 ARC_OD_DynProp_Obj_32_RR 8;
BA_ "GenSigSendType" SG_ 1121 ARC_OD_Length_Obj_32_RR 8;
BA_ "GenSigSendType" SG_ 1121 ARC_OD_MaintenanceState_Obj_32_R 8;
BA_ "GenSigSendType" SG_ 1121 ARC_OD_Width_Obj_32_RR 8;
BA_ "GenSigSendType" SG_ 1121 ARC_OD_RCS_Obj_32_RR 8;
BA_ "GenSigSendType" SG_ 1121 ARC_OD_Orientation_Obj_32_RR 8;
BA_ "GenSigSendType" SG_ 1121 ARC_OD_LifeCycle_Obj_32_RR 8;
BA_ "GenSigSendType" SG_ 1121 ARC_OD_DistX_Obj_33_RR 8;
BA_ "GenSigSendType" SG_ 1121 ARC_OD_VabsX_Obj_33_RR 8;
BA_ "GenSigSendType" SG_ 1121 ARC_OD_AabsX_Obj_33_RR 8;
BA_ "GenSigSendType" SG_ 1121 ARC_OD_AabsX_Obj_32_RR 8;
BA_ "GenSigSendType" SG_ 1121 ARC_OD_DistY_Obj_33_RR 8;
BA_ "GenSigSendType" SG_ 1121 ARC_OD_VabsY_Obj_33_RR 8;
BA_ "GenSigSendType" SG_ 1121 ARC_OD_AabsY_Obj_33_RR 8;
BA_ "GenSigSendType" SG_ 1121 ARC_OD_DistXStd_Obj_33_RR 8;
BA_ "GenSigSendType" SG_ 1121 ARC_OD_DistYStd_Obj_33_RR 8;
BA_ "GenSigSendType" SG_ 1121 ARC_OD_VabsXStd_Obj_33_RR 8;
BA_ "GenSigSendType" SG_ 1121 ARC_OD_VabsYStd_Obj_33_RR 8;
BA_ "GenSigSendType" SG_ 1121 ARC_OD_AabsXStd_Obj_33_RR 8;
BA_ "GenSigSendType" SG_ 1121 ARC_OD_Classification_Obj_33_RR 8;
BA_ "GenSigSendType" SG_ 1121 ARC_OD_AabsYStd_Obj_33_RR 8;
BA_ "GenSigSendType" SG_ 1121 ARC_OD_ClassConf_Obj_33_RR 8;
BA_ "GenSigSendType" SG_ 1121 ARC_OD_DistY_Obj_32_RR 8;
BA_ "GenSigSendType" SG_ 1121 ARC_OD_ProbOfExist_Obj_33_RR 8;
BA_ "GenSigSendType" SG_ 1121 ARC_OD_DynProp_Obj_33_RR 8;
BA_ "GenSigSendType" SG_ 1121 ARC_OD_Length_Obj_33_RR 8;
BA_ "GenSigSendType" SG_ 1121 ARC_OD_MaintenanceState_Obj_33_R 8;
BA_ "GenSigSendType" SG_ 1121 ARC_OD_Width_Obj_33_RR 8;
BA_ "GenSigSendType" SG_ 1121 ARC_OD_RCS_Obj_33_RR 8;
BA_ "GenSigSendType" SG_ 1121 ARC_OD_Orientation_Obj_33_RR 8;
BA_ "GenSigSendType" SG_ 1121 ARC_OD_LifeCycle_Obj_33_RR 8;
BA_ "GenSigSendType" SG_ 1121 ARC_OD_ObstacleProb_Obj_32_RR 8;
BA_ "GenSigSendType" SG_ 1121 ARC_OD_ObstacleProb_Obj_33_RR 8;
BA_ "GenSigSendType" SG_ 1121 ARC_OD_VabsY_Obj_32_RR 8;
BA_ "GenSigSendType" SG_ 1121 ARC_OD_ID_32_RR 8;
BA_ "GenSigSendType" SG_ 1121 ARC_OD_ID_33_RR 8;
BA_ "GenSigSendType" SG_ 1121 ARC_OD_MsgCounter_Obj_32_33_RR 8;
BA_ "GenSigSendType" SG_ 1121 ARC_OD_CRC8_Obj_32_33_RR 8;
BA_ "GenSigSendType" SG_ 1121 ARC_OD_AabsY_Obj_32_RR 8;
BA_ "GenSigSendType" SG_ 1121 ARC_OD_DistXStd_Obj_32_RR 8;
BA_ "GenSigSendType" SG_ 1121 ARC_OD_DistYStd_Obj_32_RR 8;
BA_ "GenSigSendType" SG_ 1121 ARC_OD_VabsXStd_Obj_32_RR 8;
BA_ "GenSigSendType" SG_ 1121 ARC_OD_VabsYStd_Obj_32_RR 8;
BA_ "GenSigSendType" SG_ 1121 ARC_OD_AabsXStd_Obj_32_RR 8;
BA_ "GenSigSendType" SG_ 1120 DistHeight_Obj_31_RR 8;
BA_ "GenSigSendType" SG_ 1120 DistHeight_Obj_30_RR 8;
BA_ "GenSigSendType" SG_ 1120 ARC_OD_DistX_Obj_30_RR 8;
BA_ "GenSigSendType" SG_ 1120 ARC_OD_Classification_Obj_30_RR 8;
BA_ "GenSigSendType" SG_ 1120 ARC_OD_AabsYStd_Obj_30_RR 8;
BA_ "GenSigSendType" SG_ 1120 ARC_OD_ClassConf_Obj_30_RR 8;
BA_ "GenSigSendType" SG_ 1120 ARC_OD_ProbOfExist_Obj_30_RR 8;
BA_ "GenSigSendType" SG_ 1120 ARC_OD_VabsX_Obj_30_RR 8;
BA_ "GenSigSendType" SG_ 1120 ARC_OD_DynProp_Obj_30_RR 8;
BA_ "GenSigSendType" SG_ 1120 ARC_OD_Length_Obj_30_RR 8;
BA_ "GenSigSendType" SG_ 1120 ARC_OD_MaintenanceState_Obj_30_R 8;
BA_ "GenSigSendType" SG_ 1120 ARC_OD_Width_Obj_30_RR 8;
BA_ "GenSigSendType" SG_ 1120 ARC_OD_RCS_Obj_30_RR 8;
BA_ "GenSigSendType" SG_ 1120 ARC_OD_Orientation_Obj_30_RR 8;
BA_ "GenSigSendType" SG_ 1120 ARC_OD_LifeCycle_Obj_30_RR 8;
BA_ "GenSigSendType" SG_ 1120 ARC_OD_DistX_Obj_31_RR 8;
BA_ "GenSigSendType" SG_ 1120 ARC_OD_VabsX_Obj_31_RR 8;
BA_ "GenSigSendType" SG_ 1120 ARC_OD_AabsX_Obj_31_RR 8;
BA_ "GenSigSendType" SG_ 1120 ARC_OD_AabsX_Obj_30_RR 8;
BA_ "GenSigSendType" SG_ 1120 ARC_OD_DistY_Obj_31_RR 8;
BA_ "GenSigSendType" SG_ 1120 ARC_OD_VabsY_Obj_31_RR 8;
BA_ "GenSigSendType" SG_ 1120 ARC_OD_AabsY_Obj_31_RR 8;
BA_ "GenSigSendType" SG_ 1120 ARC_OD_DistXStd_Obj_31_RR 8;
BA_ "GenSigSendType" SG_ 1120 ARC_OD_DistYStd_Obj_31_RR 8;
BA_ "GenSigSendType" SG_ 1120 ARC_OD_VabsXStd_Obj_31_RR 8;
BA_ "GenSigSendType" SG_ 1120 ARC_OD_VabsYStd_Obj_31_RR 8;
BA_ "GenSigSendType" SG_ 1120 ARC_OD_AabsXStd_Obj_31_RR 8;
BA_ "GenSigSendType" SG_ 1120 ARC_OD_Classification_Obj_31_RR 8;
BA_ "GenSigSendType" SG_ 1120 ARC_OD_AabsYStd_Obj_31_RR 8;
BA_ "GenSigSendType" SG_ 1120 ARC_OD_ClassConf_Obj_31_RR 8;
BA_ "GenSigSendType" SG_ 1120 ARC_OD_DistY_Obj_30_RR 8;
BA_ "GenSigSendType" SG_ 1120 ARC_OD_ProbOfExist_Obj_31_RR 8;
BA_ "GenSigSendType" SG_ 1120 ARC_OD_DynProp_Obj_31_RR 8;
BA_ "GenSigSendType" SG_ 1120 ARC_OD_Length_Obj_31_RR 8;
BA_ "GenSigSendType" SG_ 1120 ARC_OD_MaintenanceState_Obj_31_R 8;
BA_ "GenSigSendType" SG_ 1120 ARC_OD_Width_Obj_31_RR 8;
BA_ "GenSigSendType" SG_ 1120 ARC_OD_RCS_Obj_31_RR 8;
BA_ "GenSigSendType" SG_ 1120 ARC_OD_Orientation_Obj_31_RR 8;
BA_ "GenSigSendType" SG_ 1120 ARC_OD_LifeCycle_Obj_31_RR 8;
BA_ "GenSigSendType" SG_ 1120 ARC_OD_ObstacleProb_Obj_30_RR 8;
BA_ "GenSigSendType" SG_ 1120 ARC_OD_ObstacleProb_Obj_31_RR 8;
BA_ "GenSigSendType" SG_ 1120 ARC_OD_VabsY_Obj_30_RR 8;
BA_ "GenSigSendType" SG_ 1120 ARC_OD_ID_30_RR 8;
BA_ "GenSigSendType" SG_ 1120 ARC_OD_ID_31_RR 8;
BA_ "GenSigSendType" SG_ 1120 ARC_OD_MsgCounter_Obj_30_31_RR 8;
BA_ "GenSigSendType" SG_ 1120 ARC_OD_CRC8_Obj_30_31_RR 8;
BA_ "GenSigSendType" SG_ 1120 ARC_OD_AabsY_Obj_30_RR 8;
BA_ "GenSigSendType" SG_ 1120 ARC_OD_DistXStd_Obj_30_RR 8;
BA_ "GenSigSendType" SG_ 1120 ARC_OD_DistYStd_Obj_30_RR 8;
BA_ "GenSigSendType" SG_ 1120 ARC_OD_VabsXStd_Obj_30_RR 8;
BA_ "GenSigSendType" SG_ 1120 ARC_OD_VabsYStd_Obj_30_RR 8;
BA_ "GenSigSendType" SG_ 1120 ARC_OD_AabsXStd_Obj_30_RR 8;
BA_ "GenSigSendType" SG_ 1119 DistHeight_Obj_29_RR 8;
BA_ "GenSigSendType" SG_ 1119 DistHeight_Obj_28_RR 8;
BA_ "GenSigSendType" SG_ 1119 ARC_OD_DistX_Obj_28_RR 8;
BA_ "GenSigSendType" SG_ 1119 ARC_OD_Classification_Obj_28_RR 8;
BA_ "GenSigSendType" SG_ 1119 ARC_OD_AabsYStd_Obj_28_RR 8;
BA_ "GenSigSendType" SG_ 1119 ARC_OD_ClassConf_Obj_28_RR 8;
BA_ "GenSigSendType" SG_ 1119 ARC_OD_ProbOfExist_Obj_28_RR 8;
BA_ "GenSigSendType" SG_ 1119 ARC_OD_VabsX_Obj_28_RR 8;
BA_ "GenSigSendType" SG_ 1119 ARC_OD_DynProp_Obj_28_RR 8;
BA_ "GenSigSendType" SG_ 1119 ARC_OD_Length_Obj_28_RR 8;
BA_ "GenSigSendType" SG_ 1119 ARC_OD_MaintenanceState_Obj_28_R 8;
BA_ "GenSigSendType" SG_ 1119 ARC_OD_Width_Obj_28_RR 8;
BA_ "GenSigSendType" SG_ 1119 ARC_OD_RCS_Obj_28_RR 8;
BA_ "GenSigSendType" SG_ 1119 ARC_OD_Orientation_Obj_28_RR 8;
BA_ "GenSigSendType" SG_ 1119 ARC_OD_LifeCycle_Obj_28_RR 8;
BA_ "GenSigSendType" SG_ 1119 ARC_OD_DistX_Obj_29_RR 8;
BA_ "GenSigSendType" SG_ 1119 ARC_OD_VabsX_Obj_29_RR 8;
BA_ "GenSigSendType" SG_ 1119 ARC_OD_AabsX_Obj_29_RR 8;
BA_ "GenSigSendType" SG_ 1119 ARC_OD_AabsX_Obj_28_RR 8;
BA_ "GenSigSendType" SG_ 1119 ARC_OD_DistY_Obj_29_RR 8;
BA_ "GenSigSendType" SG_ 1119 ARC_OD_VabsY_Obj_29_RR 8;
BA_ "GenSigSendType" SG_ 1119 ARC_OD_AabsY_Obj_29_RR 8;
BA_ "GenSigSendType" SG_ 1119 ARC_OD_DistXStd_Obj_29_RR 8;
BA_ "GenSigSendType" SG_ 1119 ARC_OD_DistYStd_Obj_29_RR 8;
BA_ "GenSigSendType" SG_ 1119 ARC_OD_VabsXStd_Obj_29_RR 8;
BA_ "GenSigSendType" SG_ 1119 ARC_OD_VabsYStd_Obj_29_RR 8;
BA_ "GenSigSendType" SG_ 1119 ARC_OD_AabsXStd_Obj_29_RR 8;
BA_ "GenSigSendType" SG_ 1119 ARC_OD_Classification_Obj_29_RR 8;
BA_ "GenSigSendType" SG_ 1119 ARC_OD_AabsYStd_Obj_29_RR 8;
BA_ "GenSigSendType" SG_ 1119 ARC_OD_ClassConf_Obj_29_RR 8;
BA_ "GenSigSendType" SG_ 1119 ARC_OD_DistY_Obj_28_RR 8;
BA_ "GenSigSendType" SG_ 1119 ARC_OD_ProbOfExist_Obj_29_RR 8;
BA_ "GenSigSendType" SG_ 1119 ARC_OD_DynProp_Obj_29_RR 8;
BA_ "GenSigSendType" SG_ 1119 ARC_OD_Length_Obj_29_RR 8;
BA_ "GenSigSendType" SG_ 1119 ARC_OD_MaintenanceState_Obj_29_R 8;
BA_ "GenSigSendType" SG_ 1119 ARC_OD_Width_Obj_29_RR 8;
BA_ "GenSigSendType" SG_ 1119 ARC_OD_RCS_Obj_29_RR 8;
BA_ "GenSigSendType" SG_ 1119 ARC_OD_Orientation_Obj_29_RR 8;
BA_ "GenSigSendType" SG_ 1119 ARC_OD_LifeCycle_Obj_29_RR 8;
BA_ "GenSigSendType" SG_ 1119 ARC_OD_ObstacleProb_Obj_28_RR 8;
BA_ "GenSigSendType" SG_ 1119 ARC_OD_ObstacleProb_Obj_29_RR 8;
BA_ "GenSigSendType" SG_ 1119 ARC_OD_VabsY_Obj_28_RR 8;
BA_ "GenSigSendType" SG_ 1119 ARC_OD_ID_28_RR 8;
BA_ "GenSigSendType" SG_ 1119 ARC_OD_ID_29_RR 8;
BA_ "GenSigSendType" SG_ 1119 ARC_OD_MsgCounter_Obj_28_29_RR 8;
BA_ "GenSigSendType" SG_ 1119 ARC_OD_CRC8_Obj_28_29_RR 8;
BA_ "GenSigSendType" SG_ 1119 ARC_OD_AabsY_Obj_28_RR 8;
BA_ "GenSigSendType" SG_ 1119 ARC_OD_DistXStd_Obj_28_RR 8;
BA_ "GenSigSendType" SG_ 1119 ARC_OD_DistYStd_Obj_28_RR 8;
BA_ "GenSigSendType" SG_ 1119 ARC_OD_VabsXStd_Obj_28_RR 8;
BA_ "GenSigSendType" SG_ 1119 ARC_OD_VabsYStd_Obj_28_RR 8;
BA_ "GenSigSendType" SG_ 1119 ARC_OD_AabsXStd_Obj_28_RR 8;
BA_ "GenSigSendType" SG_ 1118 DistHeight_Obj_27_RR 8;
BA_ "GenSigSendType" SG_ 1118 DistHeight_Obj_26_RR 8;
BA_ "GenSigSendType" SG_ 1118 ARC_OD_DistX_Obj_26_RR 8;
BA_ "GenSigSendType" SG_ 1118 ARC_OD_Classification_Obj_26_RR 8;
BA_ "GenSigSendType" SG_ 1118 ARC_OD_AabsYStd_Obj_26_RR 8;
BA_ "GenSigSendType" SG_ 1118 ARC_OD_ClassConf_Obj_26_RR 8;
BA_ "GenSigSendType" SG_ 1118 ARC_OD_ProbOfExist_Obj_26_RR 8;
BA_ "GenSigSendType" SG_ 1118 ARC_OD_VabsX_Obj_26_RR 8;
BA_ "GenSigSendType" SG_ 1118 ARC_OD_DynProp_Obj_26_RR 8;
BA_ "GenSigSendType" SG_ 1118 ARC_OD_Length_Obj_26_RR 8;
BA_ "GenSigSendType" SG_ 1118 ARC_OD_MaintenanceState_Obj_26_R 8;
BA_ "GenSigSendType" SG_ 1118 ARC_OD_Width_Obj_26_RR 8;
BA_ "GenSigSendType" SG_ 1118 ARC_OD_RCS_Obj_26_RR 8;
BA_ "GenSigSendType" SG_ 1118 ARC_OD_Orientation_Obj_26_RR 8;
BA_ "GenSigSendType" SG_ 1118 ARC_OD_LifeCycle_Obj_26_RR 8;
BA_ "GenSigSendType" SG_ 1118 ARC_OD_DistX_Obj_27_RR 8;
BA_ "GenSigSendType" SG_ 1118 ARC_OD_VabsX_Obj_27_RR 8;
BA_ "GenSigSendType" SG_ 1118 ARC_OD_AabsX_Obj_27_RR 8;
BA_ "GenSigSendType" SG_ 1118 ARC_OD_AabsX_Obj_26_RR 8;
BA_ "GenSigSendType" SG_ 1118 ARC_OD_DistY_Obj_27_RR 8;
BA_ "GenSigSendType" SG_ 1118 ARC_OD_VabsY_Obj_27_RR 8;
BA_ "GenSigSendType" SG_ 1118 ARC_OD_AabsY_Obj_27_RR 8;
BA_ "GenSigSendType" SG_ 1118 ARC_OD_DistXStd_Obj_27_RR 8;
BA_ "GenSigSendType" SG_ 1118 ARC_OD_DistYStd_Obj_27_RR 8;
BA_ "GenSigSendType" SG_ 1118 ARC_OD_VabsXStd_Obj_27_RR 8;
BA_ "GenSigSendType" SG_ 1118 ARC_OD_VabsYStd_Obj_27_RR 8;
BA_ "GenSigSendType" SG_ 1118 ARC_OD_AabsXStd_Obj_27_RR 8;
BA_ "GenSigSendType" SG_ 1118 ARC_OD_Classification_Obj_27_RR 8;
BA_ "GenSigSendType" SG_ 1118 ARC_OD_AabsYStd_Obj_27_RR 8;
BA_ "GenSigSendType" SG_ 1118 ARC_OD_ClassConf_Obj_27_RR 8;
BA_ "GenSigSendType" SG_ 1118 ARC_OD_DistY_Obj_26_RR 8;
BA_ "GenSigSendType" SG_ 1118 ARC_OD_ProbOfExist_Obj_27_RR 8;
BA_ "GenSigSendType" SG_ 1118 ARC_OD_DynProp_Obj_27_RR 8;
BA_ "GenSigSendType" SG_ 1118 ARC_OD_Length_Obj_27_RR 8;
BA_ "GenSigSendType" SG_ 1118 ARC_OD_MaintenanceState_Obj_27_R 8;
BA_ "GenSigSendType" SG_ 1118 ARC_OD_Width_Obj_27_RR 8;
BA_ "GenSigSendType" SG_ 1118 ARC_OD_RCS_Obj_27_RR 8;
BA_ "GenSigSendType" SG_ 1118 ARC_OD_Orientation_Obj_27_RR 8;
BA_ "GenSigSendType" SG_ 1118 ARC_OD_LifeCycle_Obj_27_RR 8;
BA_ "GenSigSendType" SG_ 1118 ARC_OD_ObstacleProb_Obj_26_RR 8;
BA_ "GenSigSendType" SG_ 1118 ARC_OD_ObstacleProb_Obj_27_RR 8;
BA_ "GenSigSendType" SG_ 1118 ARC_OD_VabsY_Obj_26_RR 8;
BA_ "GenSigSendType" SG_ 1118 ARC_OD_ID_26_RR 8;
BA_ "GenSigSendType" SG_ 1118 ARC_OD_ID_27_RR 8;
BA_ "GenSigSendType" SG_ 1118 ARC_OD_MsgCounter_Obj_26_27_RR 8;
BA_ "GenSigSendType" SG_ 1118 ARC_OD_CRC8_Obj_26_27_RR 8;
BA_ "GenSigSendType" SG_ 1118 ARC_OD_AabsY_Obj_26_RR 8;
BA_ "GenSigSendType" SG_ 1118 ARC_OD_DistXStd_Obj_26_RR 8;
BA_ "GenSigSendType" SG_ 1118 ARC_OD_DistYStd_Obj_26_RR 8;
BA_ "GenSigSendType" SG_ 1118 ARC_OD_VabsXStd_Obj_26_RR 8;
BA_ "GenSigSendType" SG_ 1118 ARC_OD_VabsYStd_Obj_26_RR 8;
BA_ "GenSigSendType" SG_ 1118 ARC_OD_AabsXStd_Obj_26_RR 8;
BA_ "GenSigSendType" SG_ 1117 DistHeight_Obj_25_RR 8;
BA_ "GenSigSendType" SG_ 1117 DistHeight_Obj_24_RR 8;
BA_ "GenSigSendType" SG_ 1117 ARC_OD_DistX_Obj_24_RR 8;
BA_ "GenSigSendType" SG_ 1117 ARC_OD_Classification_Obj_24_RR 8;
BA_ "GenSigSendType" SG_ 1117 ARC_OD_AabsYStd_Obj_24_RR 8;
BA_ "GenSigSendType" SG_ 1117 ARC_OD_ClassConf_Obj_24_RR 8;
BA_ "GenSigSendType" SG_ 1117 ARC_OD_ProbOfExist_Obj_24_RR 8;
BA_ "GenSigSendType" SG_ 1117 ARC_OD_VabsX_Obj_24_RR 8;
BA_ "GenSigSendType" SG_ 1117 ARC_OD_DynProp_Obj_24_RR 8;
BA_ "GenSigSendType" SG_ 1117 ARC_OD_Length_Obj_24_RR 8;
BA_ "GenSigSendType" SG_ 1117 ARC_OD_MaintenanceState_Obj_24_R 8;
BA_ "GenSigSendType" SG_ 1117 ARC_OD_Width_Obj_24_RR 8;
BA_ "GenSigSendType" SG_ 1117 ARC_OD_RCS_Obj_24_RR 8;
BA_ "GenSigSendType" SG_ 1117 ARC_OD_Orientation_Obj_24_RR 8;
BA_ "GenSigSendType" SG_ 1117 ARC_OD_LifeCycle_Obj_24_RR 8;
BA_ "GenSigSendType" SG_ 1117 ARC_OD_DistX_Obj_25_RR 8;
BA_ "GenSigSendType" SG_ 1117 ARC_OD_VabsX_Obj_25_RR 8;
BA_ "GenSigSendType" SG_ 1117 ARC_OD_AabsX_Obj_25_RR 8;
BA_ "GenSigSendType" SG_ 1117 ARC_OD_AabsX_Obj_24_RR 8;
BA_ "GenSigSendType" SG_ 1117 ARC_OD_DistY_Obj_25_RR 8;
BA_ "GenSigSendType" SG_ 1117 ARC_OD_VabsY_Obj_25_RR 8;
BA_ "GenSigSendType" SG_ 1117 ARC_OD_AabsY_Obj_25_RR 8;
BA_ "GenSigSendType" SG_ 1117 ARC_OD_DistXStd_Obj_25_RR 8;
BA_ "GenSigSendType" SG_ 1117 ARC_OD_DistYStd_Obj_25_RR 8;
BA_ "GenSigSendType" SG_ 1117 ARC_OD_VabsXStd_Obj_25_RR 8;
BA_ "GenSigSendType" SG_ 1117 ARC_OD_VabsYStd_Obj_25_RR 8;
BA_ "GenSigSendType" SG_ 1117 ARC_OD_AabsXStd_Obj_25_RR 8;
BA_ "GenSigSendType" SG_ 1117 ARC_OD_Classification_Obj_25_RR 8;
BA_ "GenSigSendType" SG_ 1117 ARC_OD_AabsYStd_Obj_25_RR 8;
BA_ "GenSigSendType" SG_ 1117 ARC_OD_ClassConf_Obj_25_RR 8;
BA_ "GenSigSendType" SG_ 1117 ARC_OD_DistY_Obj_24_RR 8;
BA_ "GenSigSendType" SG_ 1117 ARC_OD_ProbOfExist_Obj_25_RR 8;
BA_ "GenSigSendType" SG_ 1117 ARC_OD_DynProp_Obj_25_RR 8;
BA_ "GenSigSendType" SG_ 1117 ARC_OD_Length_Obj_25_RR 8;
BA_ "GenSigSendType" SG_ 1117 ARC_OD_MaintenanceState_Obj_25_R 8;
BA_ "GenSigSendType" SG_ 1117 ARC_OD_Width_Obj_25_RR 8;
BA_ "GenSigSendType" SG_ 1117 ARC_OD_RCS_Obj_25_RR 8;
BA_ "GenSigSendType" SG_ 1117 ARC_OD_Orientation_Obj_25_RR 8;
BA_ "GenSigSendType" SG_ 1117 ARC_OD_LifeCycle_Obj_25_RR 8;
BA_ "GenSigSendType" SG_ 1117 ARC_OD_ObstacleProb_Obj_24_RR 8;
BA_ "GenSigSendType" SG_ 1117 ARC_OD_ObstacleProb_Obj_25_RR 8;
BA_ "GenSigSendType" SG_ 1117 ARC_OD_VabsY_Obj_24_RR 8;
BA_ "GenSigSendType" SG_ 1117 ARC_OD_ID_24_RR 8;
BA_ "GenSigSendType" SG_ 1117 ARC_OD_ID_25_RR 8;
BA_ "GenSigSendType" SG_ 1117 ARC_OD_MsgCounter_Obj_24_25_RR 8;
BA_ "GenSigSendType" SG_ 1117 ARC_OD_CRC8_Obj_24_25_RR 8;
BA_ "GenSigSendType" SG_ 1117 ARC_OD_AabsY_Obj_24_RR 8;
BA_ "GenSigSendType" SG_ 1117 ARC_OD_DistXStd_Obj_24_RR 8;
BA_ "GenSigSendType" SG_ 1117 ARC_OD_DistYStd_Obj_24_RR 8;
BA_ "GenSigSendType" SG_ 1117 ARC_OD_VabsXStd_Obj_24_RR 8;
BA_ "GenSigSendType" SG_ 1117 ARC_OD_VabsYStd_Obj_24_RR 8;
BA_ "GenSigSendType" SG_ 1117 ARC_OD_AabsXStd_Obj_24_RR 8;
BA_ "GenSigSendType" SG_ 1116 DistHeight_Obj_23_RR 8;
BA_ "GenSigSendType" SG_ 1116 DistHeight_Obj_22_RR 8;
BA_ "GenSigSendType" SG_ 1116 ARC_OD_DistX_Obj_22_RR 8;
BA_ "GenSigSendType" SG_ 1116 ARC_OD_Classification_Obj_22_RR 8;
BA_ "GenSigSendType" SG_ 1116 ARC_OD_AabsYStd_Obj_22_RR 8;
BA_ "GenSigSendType" SG_ 1116 ARC_OD_ClassConf_Obj_22_RR 8;
BA_ "GenSigSendType" SG_ 1116 ARC_OD_ProbOfExist_Obj_22_RR 8;
BA_ "GenSigSendType" SG_ 1116 ARC_OD_VabsX_Obj_22_RR 8;
BA_ "GenSigSendType" SG_ 1116 ARC_OD_DynProp_Obj_22_RR 8;
BA_ "GenSigSendType" SG_ 1116 ARC_OD_Length_Obj_22_RR 8;
BA_ "GenSigSendType" SG_ 1116 ARC_OD_MaintenanceState_Obj_22_R 8;
BA_ "GenSigSendType" SG_ 1116 ARC_OD_Width_Obj_22_RR 8;
BA_ "GenSigSendType" SG_ 1116 ARC_OD_RCS_Obj_22_RR 8;
BA_ "GenSigSendType" SG_ 1116 ARC_OD_Orientation_Obj_22_RR 8;
BA_ "GenSigSendType" SG_ 1116 ARC_OD_LifeCycle_Obj_22_RR 8;
BA_ "GenSigSendType" SG_ 1116 ARC_OD_DistX_Obj_23_RR 8;
BA_ "GenSigSendType" SG_ 1116 ARC_OD_VabsX_Obj_23_RR 8;
BA_ "GenSigSendType" SG_ 1116 ARC_OD_AabsX_Obj_23_RR 8;
BA_ "GenSigSendType" SG_ 1116 ARC_OD_AabsX_Obj_22_RR 8;
BA_ "GenSigSendType" SG_ 1116 ARC_OD_DistY_Obj_23_RR 8;
BA_ "GenSigSendType" SG_ 1116 ARC_OD_VabsY_Obj_23_RR 8;
BA_ "GenSigSendType" SG_ 1116 ARC_OD_AabsY_Obj_23_RR 8;
BA_ "GenSigSendType" SG_ 1116 ARC_OD_DistXStd_Obj_23_RR 8;
BA_ "GenSigSendType" SG_ 1116 ARC_OD_DistYStd_Obj_23_RR 8;
BA_ "GenSigSendType" SG_ 1116 ARC_OD_VabsXStd_Obj_23_RR 8;
BA_ "GenSigSendType" SG_ 1116 ARC_OD_VabsYStd_Obj_23_RR 8;
BA_ "GenSigSendType" SG_ 1116 ARC_OD_AabsXStd_Obj_23_RR 8;
BA_ "GenSigSendType" SG_ 1116 ARC_OD_Classification_Obj_23_RR 8;
BA_ "GenSigSendType" SG_ 1116 ARC_OD_AabsYStd_Obj_23_RR 8;
BA_ "GenSigSendType" SG_ 1116 ARC_OD_ClassConf_Obj_23_RR 8;
BA_ "GenSigSendType" SG_ 1116 ARC_OD_DistY_Obj_22_RR 8;
BA_ "GenSigSendType" SG_ 1116 ARC_OD_ProbOfExist_Obj_23_RR 8;
BA_ "GenSigSendType" SG_ 1116 ARC_OD_DynProp_Obj_23_RR 8;
BA_ "GenSigSendType" SG_ 1116 ARC_OD_Length_Obj_23_RR 8;
BA_ "GenSigSendType" SG_ 1116 ARC_OD_MaintenanceState_Obj_23_R 8;
BA_ "GenSigSendType" SG_ 1116 ARC_OD_Width_Obj_23_RR 8;
BA_ "GenSigSendType" SG_ 1116 ARC_OD_RCS_Obj_23_RR 8;
BA_ "GenSigSendType" SG_ 1116 ARC_OD_Orientation_Obj_23_RR 8;
BA_ "GenSigSendType" SG_ 1116 ARC_OD_LifeCycle_Obj_23_RR 8;
BA_ "GenSigSendType" SG_ 1116 ARC_OD_ObstacleProb_Obj_22_RR 8;
BA_ "GenSigSendType" SG_ 1116 ARC_OD_ObstacleProb_Obj_23_RR 8;
BA_ "GenSigSendType" SG_ 1116 ARC_OD_VabsY_Obj_22_RR 8;
BA_ "GenSigSendType" SG_ 1116 ARC_OD_ID_22_RR 8;
BA_ "GenSigSendType" SG_ 1116 ARC_OD_ID_23_RR 8;
BA_ "GenSigSendType" SG_ 1116 ARC_OD_MsgCounter_Obj_22_23_RR 8;
BA_ "GenSigSendType" SG_ 1116 ARC_OD_CRC8_Obj_22_23_RR 8;
BA_ "GenSigSendType" SG_ 1116 ARC_OD_AabsY_Obj_22_RR 8;
BA_ "GenSigSendType" SG_ 1116 ARC_OD_DistXStd_Obj_22_RR 8;
BA_ "GenSigSendType" SG_ 1116 ARC_OD_DistYStd_Obj_22_RR 8;
BA_ "GenSigSendType" SG_ 1116 ARC_OD_VabsXStd_Obj_22_RR 8;
BA_ "GenSigSendType" SG_ 1116 ARC_OD_VabsYStd_Obj_22_RR 8;
BA_ "GenSigSendType" SG_ 1116 ARC_OD_AabsXStd_Obj_22_RR 8;
BA_ "GenSigSendType" SG_ 1115 DistHeight_Obj_21_RR 8;
BA_ "GenSigSendType" SG_ 1115 DistHeight_Obj_20_RR 8;
BA_ "GenSigSendType" SG_ 1115 ARC_OD_DistX_Obj_20_RR 8;
BA_ "GenSigSendType" SG_ 1115 ARC_OD_Classification_Obj_20_RR 8;
BA_ "GenSigSendType" SG_ 1115 ARC_OD_AabsYStd_Obj_20_RR 8;
BA_ "GenSigSendType" SG_ 1115 ARC_OD_ClassConf_Obj_20_RR 8;
BA_ "GenSigSendType" SG_ 1115 ARC_OD_ProbOfExist_Obj_20_RR 8;
BA_ "GenSigSendType" SG_ 1115 ARC_OD_VabsX_Obj_20_RR 8;
BA_ "GenSigSendType" SG_ 1115 ARC_OD_DynProp_Obj_20_RR 8;
BA_ "GenSigSendType" SG_ 1115 ARC_OD_Length_Obj_20_RR 8;
BA_ "GenSigSendType" SG_ 1115 ARC_OD_MaintenanceState_Obj_20_R 8;
BA_ "GenSigSendType" SG_ 1115 ARC_OD_Width_Obj_20_RR 8;
BA_ "GenSigSendType" SG_ 1115 ARC_OD_RCS_Obj_20_RR 8;
BA_ "GenSigSendType" SG_ 1115 ARC_OD_Orientation_Obj_20_RR 8;
BA_ "GenSigSendType" SG_ 1115 ARC_OD_LifeCycle_Obj_20_RR 8;
BA_ "GenSigSendType" SG_ 1115 ARC_OD_DistX_Obj_21_RR 8;
BA_ "GenSigSendType" SG_ 1115 ARC_OD_VabsX_Obj_21_RR 8;
BA_ "GenSigSendType" SG_ 1115 ARC_OD_AabsX_Obj_21_RR 8;
BA_ "GenSigSendType" SG_ 1115 ARC_OD_AabsX_Obj_20_RR 8;
BA_ "GenSigSendType" SG_ 1115 ARC_OD_DistY_Obj_21_RR 8;
BA_ "GenSigSendType" SG_ 1115 ARC_OD_VabsY_Obj_21_RR 8;
BA_ "GenSigSendType" SG_ 1115 ARC_OD_AabsY_Obj_21_RR 8;
BA_ "GenSigSendType" SG_ 1115 ARC_OD_DistXStd_Obj_21_RR 8;
BA_ "GenSigSendType" SG_ 1115 ARC_OD_DistYStd_Obj_21_RR 8;
BA_ "GenSigSendType" SG_ 1115 ARC_OD_VabsXStd_Obj_21_RR 8;
BA_ "GenSigSendType" SG_ 1115 ARC_OD_VabsYStd_Obj_21_RR 8;
BA_ "GenSigSendType" SG_ 1115 ARC_OD_AabsXStd_Obj_21_RR 8;
BA_ "GenSigSendType" SG_ 1115 ARC_OD_Classification_Obj_21_RR 8;
BA_ "GenSigSendType" SG_ 1115 ARC_OD_AabsYStd_Obj_21_RR 8;
BA_ "GenSigSendType" SG_ 1115 ARC_OD_ClassConf_Obj_21_RR 8;
BA_ "GenSigSendType" SG_ 1115 ARC_OD_DistY_Obj_20_RR 8;
BA_ "GenSigSendType" SG_ 1115 ARC_OD_ProbOfExist_Obj_21_RR 8;
BA_ "GenSigSendType" SG_ 1115 ARC_OD_DynProp_Obj_21_RR 8;
BA_ "GenSigSendType" SG_ 1115 ARC_OD_Length_Obj_21_RR 8;
BA_ "GenSigSendType" SG_ 1115 ARC_OD_MaintenanceState_Obj_21_R 8;
BA_ "GenSigSendType" SG_ 1115 ARC_OD_Width_Obj_21_RR 8;
BA_ "GenSigSendType" SG_ 1115 ARC_OD_RCS_Obj_21_RR 8;
BA_ "GenSigSendType" SG_ 1115 ARC_OD_Orientation_Obj_21_RR 8;
BA_ "GenSigSendType" SG_ 1115 ARC_OD_LifeCycle_Obj_21_RR 8;
BA_ "GenSigSendType" SG_ 1115 ARC_OD_ObstacleProb_Obj_20_RR 8;
BA_ "GenSigSendType" SG_ 1115 ARC_OD_ObstacleProb_Obj_21_RR 8;
BA_ "GenSigSendType" SG_ 1115 ARC_OD_VabsY_Obj_20_RR 8;
BA_ "GenSigSendType" SG_ 1115 ARC_OD_ID_20_RR 8;
BA_ "GenSigSendType" SG_ 1115 ARC_OD_ID_21_RR 8;
BA_ "GenSigSendType" SG_ 1115 ARC_OD_MsgCounter_Obj_20_21_RR 8;
BA_ "GenSigSendType" SG_ 1115 ARC_OD_CRC8_Obj_20_21_RR 8;
BA_ "GenSigSendType" SG_ 1115 ARC_OD_AabsY_Obj_20_RR 8;
BA_ "GenSigSendType" SG_ 1115 ARC_OD_DistXStd_Obj_20_RR 8;
BA_ "GenSigSendType" SG_ 1115 ARC_OD_DistYStd_Obj_20_RR 8;
BA_ "GenSigSendType" SG_ 1115 ARC_OD_VabsXStd_Obj_20_RR 8;
BA_ "GenSigSendType" SG_ 1115 ARC_OD_VabsYStd_Obj_20_RR 8;
BA_ "GenSigSendType" SG_ 1115 ARC_OD_AabsXStd_Obj_20_RR 8;
BA_ "GenSigSendType" SG_ 1114 DistHeight_Obj_19_RR 8;
BA_ "GenSigSendType" SG_ 1114 DistHeight_Obj_18_RR 8;
BA_ "GenSigSendType" SG_ 1114 ARC_OD_DistX_Obj_18_RR 8;
BA_ "GenSigSendType" SG_ 1114 ARC_OD_Classification_Obj_18_RR 8;
BA_ "GenSigSendType" SG_ 1114 ARC_OD_AabsYStd_Obj_18_RR 8;
BA_ "GenSigSendType" SG_ 1114 ARC_OD_ClassConf_Obj_18_RR 8;
BA_ "GenSigSendType" SG_ 1114 ARC_OD_ProbOfExist_Obj_18_RR 8;
BA_ "GenSigSendType" SG_ 1114 ARC_OD_VabsX_Obj_18_RR 8;
BA_ "GenSigSendType" SG_ 1114 ARC_OD_DynProp_Obj_18_RR 8;
BA_ "GenSigSendType" SG_ 1114 ARC_OD_Length_Obj_18_RR 8;
BA_ "GenSigSendType" SG_ 1114 ARC_OD_MaintenanceState_Obj_18_R 8;
BA_ "GenSigSendType" SG_ 1114 ARC_OD_Width_Obj_18_RR 8;
BA_ "GenSigSendType" SG_ 1114 ARC_OD_RCS_Obj_18_RR 8;
BA_ "GenSigSendType" SG_ 1114 ARC_OD_Orientation_Obj_18_RR 8;
BA_ "GenSigSendType" SG_ 1114 ARC_OD_LifeCycle_Obj_18_RR 8;
BA_ "GenSigSendType" SG_ 1114 ARC_OD_DistX_Obj_19_RR 8;
BA_ "GenSigSendType" SG_ 1114 ARC_OD_VabsX_Obj_19_RR 8;
BA_ "GenSigSendType" SG_ 1114 ARC_OD_AabsX_Obj_19_RR 8;
BA_ "GenSigSendType" SG_ 1114 ARC_OD_AabsX_Obj_18_RR 8;
BA_ "GenSigSendType" SG_ 1114 ARC_OD_DistY_Obj_19_RR 8;
BA_ "GenSigSendType" SG_ 1114 ARC_OD_VabsY_Obj_19_RR 8;
BA_ "GenSigSendType" SG_ 1114 ARC_OD_AabsY_Obj_19_RR 8;
BA_ "GenSigSendType" SG_ 1114 ARC_OD_DistXStd_Obj_19_RR 8;
BA_ "GenSigSendType" SG_ 1114 ARC_OD_DistYStd_Obj_19_RR 8;
BA_ "GenSigSendType" SG_ 1114 ARC_OD_VabsXStd_Obj_19_RR 8;
BA_ "GenSigSendType" SG_ 1114 ARC_OD_VabsYStd_Obj_19_RR 8;
BA_ "GenSigSendType" SG_ 1114 ARC_OD_AabsXStd_Obj_19_RR 8;
BA_ "GenSigSendType" SG_ 1114 ARC_OD_Classification_Obj_19_RR 8;
BA_ "GenSigSendType" SG_ 1114 ARC_OD_AabsYStd_Obj_19_RR 8;
BA_ "GenSigSendType" SG_ 1114 ARC_OD_ClassConf_Obj_19_RR 8;
BA_ "GenSigSendType" SG_ 1114 ARC_OD_DistY_Obj_18_RR 8;
BA_ "GenSigSendType" SG_ 1114 ARC_OD_ProbOfExist_Obj_19_RR 8;
BA_ "GenSigSendType" SG_ 1114 ARC_OD_DynProp_Obj_19_RR 8;
BA_ "GenSigSendType" SG_ 1114 ARC_OD_Length_Obj_19_RR 8;
BA_ "GenSigSendType" SG_ 1114 ARC_OD_MaintenanceState_Obj_19_R 8;
BA_ "GenSigSendType" SG_ 1114 ARC_OD_Width_Obj_19_RR 8;
BA_ "GenSigSendType" SG_ 1114 ARC_OD_RCS_Obj_19_RR 8;
BA_ "GenSigSendType" SG_ 1114 ARC_OD_Orientation_Obj_19_RR 8;
BA_ "GenSigSendType" SG_ 1114 ARC_OD_LifeCycle_Obj_19_RR 8;
BA_ "GenSigSendType" SG_ 1114 ARC_OD_ObstacleProb_Obj_18_RR 8;
BA_ "GenSigSendType" SG_ 1114 ARC_OD_ObstacleProb_Obj_19_RR 8;
BA_ "GenSigSendType" SG_ 1114 ARC_OD_VabsY_Obj_18_RR 8;
BA_ "GenSigSendType" SG_ 1114 ARC_OD_ID_18_RR 8;
BA_ "GenSigSendType" SG_ 1114 ARC_OD_ID_19_RR 8;
BA_ "GenSigSendType" SG_ 1114 ARC_OD_MsgCounter_Obj_18_19_RR 8;
BA_ "GenSigSendType" SG_ 1114 ARC_OD_CRC8_Obj_18_19_RR 8;
BA_ "GenSigSendType" SG_ 1114 ARC_OD_AabsY_Obj_18_RR 8;
BA_ "GenSigSendType" SG_ 1114 ARC_OD_DistXStd_Obj_18_RR 8;
BA_ "GenSigSendType" SG_ 1114 ARC_OD_DistYStd_Obj_18_RR 8;
BA_ "GenSigSendType" SG_ 1114 ARC_OD_VabsXStd_Obj_18_RR 8;
BA_ "GenSigSendType" SG_ 1114 ARC_OD_VabsYStd_Obj_18_RR 8;
BA_ "GenSigSendType" SG_ 1114 ARC_OD_AabsXStd_Obj_18_RR 8;
BA_ "GenSigSendType" SG_ 1113 DistHeight_Obj_17_RR 8;
BA_ "GenSigSendType" SG_ 1113 DistHeight_Obj_16_RR 8;
BA_ "GenSigSendType" SG_ 1113 ARC_OD_DistX_Obj_16_RR 8;
BA_ "GenSigSendType" SG_ 1113 ARC_OD_Classification_Obj_16_RR 8;
BA_ "GenSigSendType" SG_ 1113 ARC_OD_AabsYStd_Obj_16_RR 8;
BA_ "GenSigSendType" SG_ 1113 ARC_OD_ClassConf_Obj_16_RR 8;
BA_ "GenSigSendType" SG_ 1113 ARC_OD_ProbOfExist_Obj_16_RR 8;
BA_ "GenSigSendType" SG_ 1113 ARC_OD_VabsX_Obj_16_RR 8;
BA_ "GenSigSendType" SG_ 1113 ARC_OD_DynProp_Obj_16_RR 8;
BA_ "GenSigSendType" SG_ 1113 ARC_OD_Length_Obj_16_RR 8;
BA_ "GenSigSendType" SG_ 1113 ARC_OD_MaintenanceState_Obj_16_R 8;
BA_ "GenSigSendType" SG_ 1113 ARC_OD_Width_Obj_16_RR 8;
BA_ "GenSigSendType" SG_ 1113 ARC_OD_RCS_Obj_16_RR 8;
BA_ "GenSigSendType" SG_ 1113 ARC_OD_Orientation_Obj_16_RR 8;
BA_ "GenSigSendType" SG_ 1113 ARC_OD_LifeCycle_Obj_16_RR 8;
BA_ "GenSigSendType" SG_ 1113 ARC_OD_DistX_Obj_17_RR 8;
BA_ "GenSigSendType" SG_ 1113 ARC_OD_VabsX_Obj_17_RR 8;
BA_ "GenSigSendType" SG_ 1113 ARC_OD_AabsX_Obj_17_RR 8;
BA_ "GenSigSendType" SG_ 1113 ARC_OD_AabsX_Obj_16_RR 8;
BA_ "GenSigSendType" SG_ 1113 ARC_OD_DistY_Obj_17_RR 8;
BA_ "GenSigSendType" SG_ 1113 ARC_OD_VabsY_Obj_17_RR 8;
BA_ "GenSigSendType" SG_ 1113 ARC_OD_AabsY_Obj_17_RR 8;
BA_ "GenSigSendType" SG_ 1113 ARC_OD_DistXStd_Obj_17_RR 8;
BA_ "GenSigSendType" SG_ 1113 ARC_OD_DistYStd_Obj_17_RR 8;
BA_ "GenSigSendType" SG_ 1113 ARC_OD_VabsXStd_Obj_17_RR 8;
BA_ "GenSigSendType" SG_ 1113 ARC_OD_VabsYStd_Obj_17_RR 8;
BA_ "GenSigSendType" SG_ 1113 ARC_OD_AabsXStd_Obj_17_RR 8;
BA_ "GenSigSendType" SG_ 1113 ARC_OD_Classification_Obj_17_RR 8;
BA_ "GenSigSendType" SG_ 1113 ARC_OD_AabsYStd_Obj_17_RR 8;
BA_ "GenSigSendType" SG_ 1113 ARC_OD_ClassConf_Obj_17_RR 8;
BA_ "GenSigSendType" SG_ 1113 ARC_OD_DistY_Obj_16_RR 8;
BA_ "GenSigSendType" SG_ 1113 ARC_OD_ProbOfExist_Obj_17_RR 8;
BA_ "GenSigSendType" SG_ 1113 ARC_OD_DynProp_Obj_17_RR 8;
BA_ "GenSigSendType" SG_ 1113 ARC_OD_Length_Obj_17_RR 8;
BA_ "GenSigSendType" SG_ 1113 ARC_OD_MaintenanceState_Obj_17_R 8;
BA_ "GenSigSendType" SG_ 1113 ARC_OD_Width_Obj_17_RR 8;
BA_ "GenSigSendType" SG_ 1113 ARC_OD_RCS_Obj_17_RR 8;
BA_ "GenSigSendType" SG_ 1113 ARC_OD_Orientation_Obj_17_RR 8;
BA_ "GenSigSendType" SG_ 1113 ARC_OD_LifeCycle_Obj_17_RR 8;
BA_ "GenSigSendType" SG_ 1113 ARC_OD_ObstacleProb_Obj_16_RR 8;
BA_ "GenSigSendType" SG_ 1113 ARC_OD_ObstacleProb_Obj_17_RR 8;
BA_ "GenSigSendType" SG_ 1113 ARC_OD_VabsY_Obj_16_RR 8;
BA_ "GenSigSendType" SG_ 1113 ARC_OD_ID_16_RR 8;
BA_ "GenSigSendType" SG_ 1113 ARC_OD_ID_17_RR 8;
BA_ "GenSigSendType" SG_ 1113 ARC_OD_MsgCounter_Obj_16_17_RR 8;
BA_ "GenSigSendType" SG_ 1113 ARC_OD_CRC8_Obj_16_17_RR 8;
BA_ "GenSigSendType" SG_ 1113 ARC_OD_AabsY_Obj_16_RR 8;
BA_ "GenSigSendType" SG_ 1113 ARC_OD_DistXStd_Obj_16_RR 8;
BA_ "GenSigSendType" SG_ 1113 ARC_OD_DistYStd_Obj_16_RR 8;
BA_ "GenSigSendType" SG_ 1113 ARC_OD_VabsXStd_Obj_16_RR 8;
BA_ "GenSigSendType" SG_ 1113 ARC_OD_VabsYStd_Obj_16_RR 8;
BA_ "GenSigSendType" SG_ 1113 ARC_OD_AabsXStd_Obj_16_RR 8;
BA_ "GenSigSendType" SG_ 1112 DistHeight_Obj_15_RR 8;
BA_ "GenSigSendType" SG_ 1112 DistHeight_Obj_14_RR 8;
BA_ "GenSigSendType" SG_ 1112 ARC_OD_DistX_Obj_14_RR 8;
BA_ "GenSigSendType" SG_ 1112 ARC_OD_Classification_Obj_14_RR 8;
BA_ "GenSigSendType" SG_ 1112 ARC_OD_AabsYStd_Obj_14_RR 8;
BA_ "GenSigSendType" SG_ 1112 ARC_OD_ClassConf_Obj_14_RR 8;
BA_ "GenSigSendType" SG_ 1112 ARC_OD_ProbOfExist_Obj_14_RR 8;
BA_ "GenSigSendType" SG_ 1112 ARC_OD_VabsX_Obj_14_RR 8;
BA_ "GenSigSendType" SG_ 1112 ARC_OD_DynProp_Obj_14_RR 8;
BA_ "GenSigSendType" SG_ 1112 ARC_OD_Length_Obj_14_RR 8;
BA_ "GenSigSendType" SG_ 1112 ARC_OD_MaintenanceState_Obj_14_R 8;
BA_ "GenSigSendType" SG_ 1112 ARC_OD_Width_Obj_14_RR 8;
BA_ "GenSigSendType" SG_ 1112 ARC_OD_RCS_Obj_14_RR 8;
BA_ "GenSigSendType" SG_ 1112 ARC_OD_Orientation_Obj_14_RR 8;
BA_ "GenSigSendType" SG_ 1112 ARC_OD_LifeCycle_Obj_14_RR 8;
BA_ "GenSigSendType" SG_ 1112 ARC_OD_DistX_Obj_15_RR 8;
BA_ "GenSigSendType" SG_ 1112 ARC_OD_VabsX_Obj_15_RR 8;
BA_ "GenSigSendType" SG_ 1112 ARC_OD_AabsX_Obj_15_RR 8;
BA_ "GenSigSendType" SG_ 1112 ARC_OD_AabsX_Obj_14_RR 8;
BA_ "GenSigSendType" SG_ 1112 ARC_OD_DistY_Obj_15_RR 8;
BA_ "GenSigSendType" SG_ 1112 ARC_OD_VabsY_Obj_15_RR 8;
BA_ "GenSigSendType" SG_ 1112 ARC_OD_AabsY_Obj_15_RR 8;
BA_ "GenSigSendType" SG_ 1112 ARC_OD_DistXStd_Obj_15_RR 8;
BA_ "GenSigSendType" SG_ 1112 ARC_OD_DistYStd_Obj_15_RR 8;
BA_ "GenSigSendType" SG_ 1112 ARC_OD_VabsXStd_Obj_15_RR 8;
BA_ "GenSigSendType" SG_ 1112 ARC_OD_VabsYStd_Obj_15_RR 8;
BA_ "GenSigSendType" SG_ 1112 ARC_OD_AabsXStd_Obj_15_RR 8;
BA_ "GenSigSendType" SG_ 1112 ARC_OD_Classification_Obj_15_RR 8;
BA_ "GenSigSendType" SG_ 1112 ARC_OD_AabsYStd_Obj_15_RR 8;
BA_ "GenSigSendType" SG_ 1112 ARC_OD_ClassConf_Obj_15_RR 8;
BA_ "GenSigSendType" SG_ 1112 ARC_OD_DistY_Obj_14_RR 8;
BA_ "GenSigSendType" SG_ 1112 ARC_OD_ProbOfExist_Obj_15_RR 8;
BA_ "GenSigSendType" SG_ 1112 ARC_OD_DynProp_Obj_15_RR 8;
BA_ "GenSigSendType" SG_ 1112 ARC_OD_Length_Obj_15_RR 8;
BA_ "GenSigSendType" SG_ 1112 ARC_OD_MaintenanceState_Obj_15_R 8;
BA_ "GenSigSendType" SG_ 1112 ARC_OD_Width_Obj_15_RR 8;
BA_ "GenSigSendType" SG_ 1112 ARC_OD_RCS_Obj_15_RR 8;
BA_ "GenSigSendType" SG_ 1112 ARC_OD_Orientation_Obj_15_RR 8;
BA_ "GenSigSendType" SG_ 1112 ARC_OD_LifeCycle_Obj_15_RR 8;
BA_ "GenSigSendType" SG_ 1112 ARC_OD_ObstacleProb_Obj_14_RR 8;
BA_ "GenSigSendType" SG_ 1112 ARC_OD_ObstacleProb_Obj_15_RR 8;
BA_ "GenSigSendType" SG_ 1112 ARC_OD_VabsY_Obj_14_RR 8;
BA_ "GenSigSendType" SG_ 1112 ARC_OD_ID_14_RR 8;
BA_ "GenSigSendType" SG_ 1112 ARC_OD_ID_15_RR 8;
BA_ "GenSigSendType" SG_ 1112 ARC_OD_MsgCounter_Obj_14_15_RR 8;
BA_ "GenSigSendType" SG_ 1112 ARC_OD_CRC8_Obj_14_15_RR 8;
BA_ "GenSigSendType" SG_ 1112 ARC_OD_AabsY_Obj_14_RR 8;
BA_ "GenSigSendType" SG_ 1112 ARC_OD_DistXStd_Obj_14_RR 8;
BA_ "GenSigSendType" SG_ 1112 ARC_OD_DistYStd_Obj_14_RR 8;
BA_ "GenSigSendType" SG_ 1112 ARC_OD_VabsXStd_Obj_14_RR 8;
BA_ "GenSigSendType" SG_ 1112 ARC_OD_VabsYStd_Obj_14_RR 8;
BA_ "GenSigSendType" SG_ 1112 ARC_OD_AabsXStd_Obj_14_RR 8;
BA_ "GenSigSendType" SG_ 1111 DistHeight_Obj_13_RR 8;
BA_ "GenSigSendType" SG_ 1111 DistHeight_Obj_12_RR 8;
BA_ "GenSigSendType" SG_ 1111 ARC_OD_DistX_Obj_12_RR 8;
BA_ "GenSigSendType" SG_ 1111 ARC_OD_Classification_Obj_12_RR 8;
BA_ "GenSigSendType" SG_ 1111 ARC_OD_AabsYStd_Obj_12_RR 8;
BA_ "GenSigSendType" SG_ 1111 ARC_OD_ClassConf_Obj_12_RR 8;
BA_ "GenSigSendType" SG_ 1111 ARC_OD_ProbOfExist_Obj_12_RR 8;
BA_ "GenSigSendType" SG_ 1111 ARC_OD_VabsX_Obj_12_RR 8;
BA_ "GenSigSendType" SG_ 1111 ARC_OD_DynProp_Obj_12_RR 8;
BA_ "GenSigSendType" SG_ 1111 ARC_OD_Length_Obj_12_RR 8;
BA_ "GenSigSendType" SG_ 1111 ARC_OD_MaintenanceState_Obj_12_R 8;
BA_ "GenSigSendType" SG_ 1111 ARC_OD_Width_Obj_12_RR 8;
BA_ "GenSigSendType" SG_ 1111 ARC_OD_RCS_Obj_12_RR 8;
BA_ "GenSigSendType" SG_ 1111 ARC_OD_Orientation_Obj_12_RR 8;
BA_ "GenSigSendType" SG_ 1111 ARC_OD_LifeCycle_Obj_12_RR 8;
BA_ "GenSigSendType" SG_ 1111 ARC_OD_DistX_Obj_13_RR 8;
BA_ "GenSigSendType" SG_ 1111 ARC_OD_VabsX_Obj_13_RR 8;
BA_ "GenSigSendType" SG_ 1111 ARC_OD_AabsX_Obj_13_RR 8;
BA_ "GenSigSendType" SG_ 1111 ARC_OD_AabsX_Obj_12_RR 8;
BA_ "GenSigSendType" SG_ 1111 ARC_OD_DistY_Obj_13_RR 8;
BA_ "GenSigSendType" SG_ 1111 ARC_OD_VabsY_Obj_13_RR 8;
BA_ "GenSigSendType" SG_ 1111 ARC_OD_AabsY_Obj_13_RR 8;
BA_ "GenSigSendType" SG_ 1111 ARC_OD_DistXStd_Obj_13_RR 8;
BA_ "GenSigSendType" SG_ 1111 ARC_OD_DistYStd_Obj_13_RR 8;
BA_ "GenSigSendType" SG_ 1111 ARC_OD_VabsXStd_Obj_13_RR 8;
BA_ "GenSigSendType" SG_ 1111 ARC_OD_VabsYStd_Obj_13_RR 8;
BA_ "GenSigSendType" SG_ 1111 ARC_OD_AabsXStd_Obj_13_RR 8;
BA_ "GenSigSendType" SG_ 1111 ARC_OD_Classification_Obj_13_RR 8;
BA_ "GenSigSendType" SG_ 1111 ARC_OD_AabsYStd_Obj_13_RR 8;
BA_ "GenSigSendType" SG_ 1111 ARC_OD_ClassConf_Obj_13_RR 8;
BA_ "GenSigSendType" SG_ 1111 ARC_OD_DistY_Obj_12_RR 8;
BA_ "GenSigSendType" SG_ 1111 ARC_OD_ProbOfExist_Obj_13_RR 8;
BA_ "GenSigSendType" SG_ 1111 ARC_OD_DynProp_Obj_13_RR 8;
BA_ "GenSigSendType" SG_ 1111 ARC_OD_Length_Obj_13_RR 8;
BA_ "GenSigSendType" SG_ 1111 ARC_OD_MaintenanceState_Obj_13_R 8;
BA_ "GenSigSendType" SG_ 1111 ARC_OD_Width_Obj_13_RR 8;
BA_ "GenSigSendType" SG_ 1111 ARC_OD_RCS_Obj_13_RR 8;
BA_ "GenSigSendType" SG_ 1111 ARC_OD_Orientation_Obj_13_RR 8;
BA_ "GenSigSendType" SG_ 1111 ARC_OD_LifeCycle_Obj_13_RR 8;
BA_ "GenSigSendType" SG_ 1111 ARC_OD_ObstacleProb_Obj_12_RR 8;
BA_ "GenSigSendType" SG_ 1111 ARC_OD_ObstacleProb_Obj_13_RR 8;
BA_ "GenSigSendType" SG_ 1111 ARC_OD_VabsY_Obj_12_RR 8;
BA_ "GenSigSendType" SG_ 1111 ARC_OD_ID_12_RR 8;
BA_ "GenSigSendType" SG_ 1111 ARC_OD_ID_13_RR 8;
BA_ "GenSigSendType" SG_ 1111 ARC_OD_MsgCounter_Obj_12_13_RR 8;
BA_ "GenSigSendType" SG_ 1111 ARC_OD_CRC8_Obj_12_13_RR 8;
BA_ "GenSigSendType" SG_ 1111 ARC_OD_AabsY_Obj_12_RR 8;
BA_ "GenSigSendType" SG_ 1111 ARC_OD_DistXStd_Obj_12_RR 8;
BA_ "GenSigSendType" SG_ 1111 ARC_OD_DistYStd_Obj_12_RR 8;
BA_ "GenSigSendType" SG_ 1111 ARC_OD_VabsXStd_Obj_12_RR 8;
BA_ "GenSigSendType" SG_ 1111 ARC_OD_VabsYStd_Obj_12_RR 8;
BA_ "GenSigSendType" SG_ 1111 ARC_OD_AabsXStd_Obj_12_RR 8;
BA_ "GenSigSendType" SG_ 1110 DistHeight_Obj_11_RR 8;
BA_ "GenSigSendType" SG_ 1110 DistHeight_Obj_10_RR 8;
BA_ "GenSigSendType" SG_ 1110 ARC_OD_DistX_Obj_10_RR 8;
BA_ "GenSigSendType" SG_ 1110 ARC_OD_Classification_Obj_10_RR 8;
BA_ "GenSigSendType" SG_ 1110 ARC_OD_AabsYStd_Obj_10_RR 8;
BA_ "GenSigSendType" SG_ 1110 ARC_OD_ClassConf_Obj_10_RR 8;
BA_ "GenSigSendType" SG_ 1110 ARC_OD_ProbOfExist_Obj_10_RR 8;
BA_ "GenSigSendType" SG_ 1110 ARC_OD_VabsX_Obj_10_RR 8;
BA_ "GenSigSendType" SG_ 1110 ARC_OD_DynProp_Obj_10_RR 8;
BA_ "GenSigSendType" SG_ 1110 ARC_OD_Length_Obj_10_RR 8;
BA_ "GenSigSendType" SG_ 1110 ARC_OD_MaintenanceState_Obj_10_R 8;
BA_ "GenSigSendType" SG_ 1110 ARC_OD_Width_Obj_10_RR 8;
BA_ "GenSigSendType" SG_ 1110 ARC_OD_RCS_Obj_10_RR 8;
BA_ "GenSigSendType" SG_ 1110 ARC_OD_Orientation_Obj_10_RR 8;
BA_ "GenSigSendType" SG_ 1110 ARC_OD_LifeCycle_Obj_10_RR 8;
BA_ "GenSigSendType" SG_ 1110 ARC_OD_DistX_Obj_11_RR 8;
BA_ "GenSigSendType" SG_ 1110 ARC_OD_VabsX_Obj_11_RR 8;
BA_ "GenSigSendType" SG_ 1110 ARC_OD_AabsX_Obj_11_RR 8;
BA_ "GenSigSendType" SG_ 1110 ARC_OD_AabsX_Obj_10_RR 8;
BA_ "GenSigSendType" SG_ 1110 ARC_OD_DistY_Obj_11_RR 8;
BA_ "GenSigSendType" SG_ 1110 ARC_OD_VabsY_Obj_11_RR 8;
BA_ "GenSigSendType" SG_ 1110 ARC_OD_AabsY_Obj_11_RR 8;
BA_ "GenSigSendType" SG_ 1110 ARC_OD_DistXStd_Obj_11_RR 8;
BA_ "GenSigSendType" SG_ 1110 ARC_OD_DistYStd_Obj_11_RR 8;
BA_ "GenSigSendType" SG_ 1110 ARC_OD_VabsXStd_Obj_11_RR 8;
BA_ "GenSigSendType" SG_ 1110 ARC_OD_VabsYStd_Obj_11_RR 8;
BA_ "GenSigSendType" SG_ 1110 ARC_OD_AabsXStd_Obj_11_RR 8;
BA_ "GenSigSendType" SG_ 1110 ARC_OD_Classification_Obj_11_RR 8;
BA_ "GenSigSendType" SG_ 1110 ARC_OD_AabsYStd_Obj_11_RR 8;
BA_ "GenSigSendType" SG_ 1110 ARC_OD_ClassConf_Obj_11_RR 8;
BA_ "GenSigSendType" SG_ 1110 ARC_OD_DistY_Obj_10_RR 8;
BA_ "GenSigSendType" SG_ 1110 ARC_OD_ProbOfExist_Obj_11_RR 8;
BA_ "GenSigSendType" SG_ 1110 ARC_OD_DynProp_Obj_11_RR 8;
BA_ "GenSigSendType" SG_ 1110 ARC_OD_Length_Obj_11_RR 8;
BA_ "GenSigSendType" SG_ 1110 ARC_OD_MaintenanceState_Obj_11_R 8;
BA_ "GenSigSendType" SG_ 1110 ARC_OD_Width_Obj_11_RR 8;
BA_ "GenSigSendType" SG_ 1110 ARC_OD_RCS_Obj_11_RR 8;
BA_ "GenSigSendType" SG_ 1110 ARC_OD_Orientation_Obj_11_RR 8;
BA_ "GenSigSendType" SG_ 1110 ARC_OD_LifeCycle_Obj_11_RR 8;
BA_ "GenSigSendType" SG_ 1110 ARC_OD_ObstacleProb_Obj_10_RR 8;
BA_ "GenSigSendType" SG_ 1110 ARC_OD_ObstacleProb_Obj_11_RR 8;
BA_ "GenSigSendType" SG_ 1110 ARC_OD_VabsY_Obj_10_RR 8;
BA_ "GenSigSendType" SG_ 1110 ARC_OD_ID_10_RR 8;
BA_ "GenSigSendType" SG_ 1110 ARC_OD_ID_11_RR 8;
BA_ "GenSigSendType" SG_ 1110 ARC_OD_MsgCounter_Obj_10_11_RR 8;
BA_ "GenSigSendType" SG_ 1110 ARC_OD_CRC8_Obj_10_11_RR 8;
BA_ "GenSigSendType" SG_ 1110 ARC_OD_AabsY_Obj_10_RR 8;
BA_ "GenSigSendType" SG_ 1110 ARC_OD_DistXStd_Obj_10_RR 8;
BA_ "GenSigSendType" SG_ 1110 ARC_OD_DistYStd_Obj_10_RR 8;
BA_ "GenSigSendType" SG_ 1110 ARC_OD_VabsXStd_Obj_10_RR 8;
BA_ "GenSigSendType" SG_ 1110 ARC_OD_VabsYStd_Obj_10_RR 8;
BA_ "GenSigSendType" SG_ 1110 ARC_OD_AabsXStd_Obj_10_RR 8;
BA_ "GenSigSendType" SG_ 1109 DistHeight_Obj_09_RR 8;
BA_ "GenSigSendType" SG_ 1109 DistHeight_Obj_08_RR 8;
BA_ "GenSigSendType" SG_ 1109 ARC_OD_DistX_Obj_08_RR 8;
BA_ "GenSigSendType" SG_ 1109 ARC_OD_Classification_Obj_08_RR 8;
BA_ "GenSigSendType" SG_ 1109 ARC_OD_AabsYStd_Obj_08_RR 8;
BA_ "GenSigSendType" SG_ 1109 ARC_OD_ClassConf_Obj_08_RR 8;
BA_ "GenSigSendType" SG_ 1109 ARC_OD_ProbOfExist_Obj_08_RR 8;
BA_ "GenSigSendType" SG_ 1109 ARC_OD_VabsX_Obj_08_RR 8;
BA_ "GenSigSendType" SG_ 1109 ARC_OD_DynProp_Obj_08_RR 8;
BA_ "GenSigSendType" SG_ 1109 ARC_OD_Length_Obj_08_RR 8;
BA_ "GenSigSendType" SG_ 1109 ARC_OD_MaintenanceState_Obj_08_R 8;
BA_ "GenSigSendType" SG_ 1109 ARC_OD_Width_Obj_08_RR 8;
BA_ "GenSigSendType" SG_ 1109 ARC_OD_RCS_Obj_08_RR 8;
BA_ "GenSigSendType" SG_ 1109 ARC_OD_Orientation_Obj_08_RR 8;
BA_ "GenSigSendType" SG_ 1109 ARC_OD_LifeCycle_Obj_08_RR 8;
BA_ "GenSigSendType" SG_ 1109 ARC_OD_DistX_Obj_09_RR 8;
BA_ "GenSigSendType" SG_ 1109 ARC_OD_VabsX_Obj_09_RR 8;
BA_ "GenSigSendType" SG_ 1109 ARC_OD_AabsX_Obj_09_RR 8;
BA_ "GenSigSendType" SG_ 1109 ARC_OD_AabsX_Obj_08_RR 8;
BA_ "GenSigSendType" SG_ 1109 ARC_OD_DistY_Obj_09_RR 8;
BA_ "GenSigSendType" SG_ 1109 ARC_OD_VabsY_Obj_09_RR 8;
BA_ "GenSigSendType" SG_ 1109 ARC_OD_AabsY_Obj_09_RR 8;
BA_ "GenSigSendType" SG_ 1109 ARC_OD_DistXStd_Obj_09_RR 8;
BA_ "GenSigSendType" SG_ 1109 ARC_OD_DistYStd_Obj_09_RR 8;
BA_ "GenSigSendType" SG_ 1109 ARC_OD_VabsXStd_Obj_09_RR 8;
BA_ "GenSigSendType" SG_ 1109 ARC_OD_VabsYStd_Obj_09_RR 8;
BA_ "GenSigSendType" SG_ 1109 ARC_OD_AabsXStd_Obj_09_RR 8;
BA_ "GenSigSendType" SG_ 1109 ARC_OD_Classification_Obj_09_RR 8;
BA_ "GenSigSendType" SG_ 1109 ARC_OD_AabsYStd_Obj_09_RR 8;
BA_ "GenSigSendType" SG_ 1109 ARC_OD_ClassConf_Obj_09_RR 8;
BA_ "GenSigSendType" SG_ 1109 ARC_OD_DistY_Obj_08_RR 8;
BA_ "GenSigSendType" SG_ 1109 ARC_OD_ProbOfExist_Obj_09_RR 8;
BA_ "GenSigSendType" SG_ 1109 ARC_OD_DynProp_Obj_09_RR 8;
BA_ "GenSigSendType" SG_ 1109 ARC_OD_Length_Obj_09_RR 8;
BA_ "GenSigSendType" SG_ 1109 ARC_OD_MaintenanceState_Obj_09_R 8;
BA_ "GenSigSendType" SG_ 1109 ARC_OD_Width_Obj_09_RR 8;
BA_ "GenSigSendType" SG_ 1109 ARC_OD_RCS_Obj_09_RR 8;
BA_ "GenSigSendType" SG_ 1109 ARC_OD_Orientation_Obj_09_RR 8;
BA_ "GenSigSendType" SG_ 1109 ARC_OD_LifeCycle_Obj_09_RR 8;
BA_ "GenSigSendType" SG_ 1109 ARC_OD_ObstacleProb_Obj_08_RR 8;
BA_ "GenSigSendType" SG_ 1109 ARC_OD_ObstacleProb_Obj_09_RR 8;
BA_ "GenSigSendType" SG_ 1109 ARC_OD_VabsY_Obj_08_RR 8;
BA_ "GenSigSendType" SG_ 1109 ARC_OD_ID_08_RR 8;
BA_ "GenSigSendType" SG_ 1109 ARC_OD_ID_09_RR 8;
BA_ "GenSigSendType" SG_ 1109 ARC_OD_MsgCounter_Obj_08_09_RR 8;
BA_ "GenSigSendType" SG_ 1109 ARC_OD_CRC8_Obj_08_09_RR 8;
BA_ "GenSigSendType" SG_ 1109 ARC_OD_AabsY_Obj_08_RR 8;
BA_ "GenSigSendType" SG_ 1109 ARC_OD_DistXStd_Obj_08_RR 8;
BA_ "GenSigSendType" SG_ 1109 ARC_OD_DistYStd_Obj_08_RR 8;
BA_ "GenSigSendType" SG_ 1109 ARC_OD_VabsXStd_Obj_08_RR 8;
BA_ "GenSigSendType" SG_ 1109 ARC_OD_VabsYStd_Obj_08_RR 8;
BA_ "GenSigSendType" SG_ 1109 ARC_OD_AabsXStd_Obj_08_RR 8;
BA_ "GenSigSendType" SG_ 1108 DistHeight_Obj_07_RR 8;
BA_ "GenSigSendType" SG_ 1108 DistHeight_Obj_06_RR 8;
BA_ "GenSigSendType" SG_ 1108 ARC_OD_DistX_Obj_06_RR 8;
BA_ "GenSigSendType" SG_ 1108 ARC_OD_Classification_Obj_06_RR 8;
BA_ "GenSigSendType" SG_ 1108 ARC_OD_AabsYStd_Obj_06_RR 8;
BA_ "GenSigSendType" SG_ 1108 ARC_OD_ClassConf_Obj_06_RR 8;
BA_ "GenSigSendType" SG_ 1108 ARC_OD_ProbOfExist_Obj_06_RR 8;
BA_ "GenSigSendType" SG_ 1108 ARC_OD_VabsX_Obj_06_RR 8;
BA_ "GenSigSendType" SG_ 1108 ARC_OD_DynProp_Obj_06_RR 8;
BA_ "GenSigSendType" SG_ 1108 ARC_OD_Length_Obj_06_RR 8;
BA_ "GenSigSendType" SG_ 1108 ARC_OD_MaintenanceState_Obj_06_R 8;
BA_ "GenSigSendType" SG_ 1108 ARC_OD_Width_Obj_06_RR 8;
BA_ "GenSigSendType" SG_ 1108 ARC_OD_RCS_Obj_06_RR 8;
BA_ "GenSigSendType" SG_ 1108 ARC_OD_Orientation_Obj_06_RR 8;
BA_ "GenSigSendType" SG_ 1108 ARC_OD_LifeCycle_Obj_06_RR 8;
BA_ "GenSigSendType" SG_ 1108 ARC_OD_DistX_Obj_07_RR 8;
BA_ "GenSigSendType" SG_ 1108 ARC_OD_VabsX_Obj_07_RR 8;
BA_ "GenSigSendType" SG_ 1108 ARC_OD_AabsX_Obj_07_RR 8;
BA_ "GenSigSendType" SG_ 1108 ARC_OD_AabsX_Obj_06_RR 8;
BA_ "GenSigSendType" SG_ 1108 ARC_OD_DistY_Obj_07_RR 8;
BA_ "GenSigSendType" SG_ 1108 ARC_OD_VabsY_Obj_07_RR 8;
BA_ "GenSigSendType" SG_ 1108 ARC_OD_AabsY_Obj_07_RR 8;
BA_ "GenSigSendType" SG_ 1108 ARC_OD_DistXStd_Obj_07_RR 8;
BA_ "GenSigSendType" SG_ 1108 ARC_OD_DistYStd_Obj_07_RR 8;
BA_ "GenSigSendType" SG_ 1108 ARC_OD_VabsXStd_Obj_07_RR 8;
BA_ "GenSigSendType" SG_ 1108 ARC_OD_VabsYStd_Obj_07_RR 8;
BA_ "GenSigSendType" SG_ 1108 ARC_OD_AabsXStd_Obj_07_RR 8;
BA_ "GenSigSendType" SG_ 1108 ARC_OD_Classification_Obj_07_RR 8;
BA_ "GenSigSendType" SG_ 1108 ARC_OD_AabsYStd_Obj_07_RR 8;
BA_ "GenSigSendType" SG_ 1108 ARC_OD_ClassConf_Obj_07_RR 8;
BA_ "GenSigSendType" SG_ 1108 ARC_OD_DistY_Obj_06_RR 8;
BA_ "GenSigSendType" SG_ 1108 ARC_OD_ProbOfExist_Obj_07_RR 8;
BA_ "GenSigSendType" SG_ 1108 ARC_OD_DynProp_Obj_07_RR 8;
BA_ "GenSigSendType" SG_ 1108 ARC_OD_Length_Obj_07_RR 8;
BA_ "GenSigSendType" SG_ 1108 ARC_OD_MaintenanceState_Obj_07_R 8;
BA_ "GenSigSendType" SG_ 1108 ARC_OD_Width_Obj_07_RR 8;
BA_ "GenSigSendType" SG_ 1108 ARC_OD_RCS_Obj_07_RR 8;
BA_ "GenSigSendType" SG_ 1108 ARC_OD_Orientation_Obj_07_RR 8;
BA_ "GenSigSendType" SG_ 1108 ARC_OD_LifeCycle_Obj_07_RR 8;
BA_ "GenSigSendType" SG_ 1108 ARC_OD_ObstacleProb_Obj_06_RR 8;
BA_ "GenSigSendType" SG_ 1108 ARC_OD_ObstacleProb_Obj_07_RR 8;
BA_ "GenSigSendType" SG_ 1108 ARC_OD_VabsY_Obj_06_RR 8;
BA_ "GenSigSendType" SG_ 1108 ARC_OD_ID_06_RR 8;
BA_ "GenSigSendType" SG_ 1108 ARC_OD_ID_07_RR 8;
BA_ "GenSigSendType" SG_ 1108 ARC_OD_MsgCounter_Obj_06_07_RR 8;
BA_ "GenSigSendType" SG_ 1108 ARC_OD_CRC8_Obj_06_07_RR 8;
BA_ "GenSigSendType" SG_ 1108 ARC_OD_AabsY_Obj_06_RR 8;
BA_ "GenSigSendType" SG_ 1108 ARC_OD_DistXStd_Obj_06_RR 8;
BA_ "GenSigSendType" SG_ 1108 ARC_OD_DistYStd_Obj_06_RR 8;
BA_ "GenSigSendType" SG_ 1108 ARC_OD_VabsXStd_Obj_06_RR 8;
BA_ "GenSigSendType" SG_ 1108 ARC_OD_VabsYStd_Obj_06_RR 8;
BA_ "GenSigSendType" SG_ 1108 ARC_OD_AabsXStd_Obj_06_RR 8;
BA_ "GenSigSendType" SG_ 1107 DistHeight_Obj_05_RR 8;
BA_ "GenSigSendType" SG_ 1107 DistHeight_Obj_04_RR 8;
BA_ "GenSigSendType" SG_ 1107 ARC_OD_DistX_Obj_04_RR 8;
BA_ "GenSigSendType" SG_ 1107 ARC_OD_Classification_Obj_04_RR 8;
BA_ "GenSigSendType" SG_ 1107 ARC_OD_AabsYStd_Obj_04_RR 8;
BA_ "GenSigSendType" SG_ 1107 ARC_OD_ClassConf_Obj_04_RR 8;
BA_ "GenSigSendType" SG_ 1107 ARC_OD_ProbOfExist_Obj_04_RR 8;
BA_ "GenSigSendType" SG_ 1107 ARC_OD_VabsX_Obj_04_RR 8;
BA_ "GenSigSendType" SG_ 1107 ARC_OD_DynProp_Obj_04_RR 8;
BA_ "GenSigSendType" SG_ 1107 ARC_OD_Length_Obj_04_RR 8;
BA_ "GenSigSendType" SG_ 1107 ARC_OD_MaintenanceState_Obj_04_R 8;
BA_ "GenSigSendType" SG_ 1107 ARC_OD_Width_Obj_04_RR 8;
BA_ "GenSigSendType" SG_ 1107 ARC_OD_RCS_Obj_04_RR 8;
BA_ "GenSigSendType" SG_ 1107 ARC_OD_Orientation_Obj_04_RR 8;
BA_ "GenSigSendType" SG_ 1107 ARC_OD_LifeCycle_Obj_04_RR 8;
BA_ "GenSigSendType" SG_ 1107 ARC_OD_DistX_Obj_05_RR 8;
BA_ "GenSigSendType" SG_ 1107 ARC_OD_VabsX_Obj_05_RR 8;
BA_ "GenSigSendType" SG_ 1107 ARC_OD_AabsX_Obj_05_RR 8;
BA_ "GenSigSendType" SG_ 1107 ARC_OD_AabsX_Obj_04_RR 8;
BA_ "GenSigSendType" SG_ 1107 ARC_OD_DistY_Obj_05_RR 8;
BA_ "GenSigSendType" SG_ 1107 ARC_OD_VabsY_Obj_05_RR 8;
BA_ "GenSigSendType" SG_ 1107 ARC_OD_AabsY_Obj_05_RR 8;
BA_ "GenSigSendType" SG_ 1107 ARC_OD_DistXStd_Obj_05_RR 8;
BA_ "GenSigSendType" SG_ 1107 ARC_OD_DistYStd_Obj_05_RR 8;
BA_ "GenSigSendType" SG_ 1107 ARC_OD_VabsXStd_Obj_05_RR 8;
BA_ "GenSigSendType" SG_ 1107 ARC_OD_VabsYStd_Obj_05_RR 8;
BA_ "GenSigSendType" SG_ 1107 ARC_OD_AabsXStd_Obj_05_RR 8;
BA_ "GenSigSendType" SG_ 1107 ARC_OD_Classification_Obj_05_RR 8;
BA_ "GenSigSendType" SG_ 1107 ARC_OD_AabsYStd_Obj_05_RR 8;
BA_ "GenSigSendType" SG_ 1107 ARC_OD_ClassConf_Obj_05_RR 8;
BA_ "GenSigSendType" SG_ 1107 ARC_OD_DistY_Obj_04_RR 8;
BA_ "GenSigSendType" SG_ 1107 ARC_OD_ProbOfExist_Obj_05_RR 8;
BA_ "GenSigSendType" SG_ 1107 ARC_OD_DynProp_Obj_05_RR 8;
BA_ "GenSigSendType" SG_ 1107 ARC_OD_Length_Obj_05_RR 8;
BA_ "GenSigSendType" SG_ 1107 ARC_OD_MaintenanceState_Obj_05_R 8;
BA_ "GenSigSendType" SG_ 1107 ARC_OD_Width_Obj_05_RR 8;
BA_ "GenSigSendType" SG_ 1107 ARC_OD_RCS_Obj_05_RR 8;
BA_ "GenSigSendType" SG_ 1107 ARC_OD_Orientation_Obj_05_RR 8;
BA_ "GenSigSendType" SG_ 1107 ARC_OD_LifeCycle_Obj_05_RR 8;
BA_ "GenSigSendType" SG_ 1107 ARC_OD_ObstacleProb_Obj_04_RR 8;
BA_ "GenSigSendType" SG_ 1107 ARC_OD_ObstacleProb_Obj_05_RR 8;
BA_ "GenSigSendType" SG_ 1107 ARC_OD_VabsY_Obj_04_RR 8;
BA_ "GenSigSendType" SG_ 1107 ARC_OD_ID_04_RR 8;
BA_ "GenSigSendType" SG_ 1107 ARC_OD_ID_05_RR 8;
BA_ "GenSigSendType" SG_ 1107 ARC_OD_MsgCounter_Obj_04_05_RR 8;
BA_ "GenSigSendType" SG_ 1107 ARC_OD_CRC8_Obj_04_05_RR 8;
BA_ "GenSigSendType" SG_ 1107 ARC_OD_AabsY_Obj_04_RR 8;
BA_ "GenSigSendType" SG_ 1107 ARC_OD_DistXStd_Obj_04_RR 8;
BA_ "GenSigSendType" SG_ 1107 ARC_OD_DistYStd_Obj_04_RR 8;
BA_ "GenSigSendType" SG_ 1107 ARC_OD_VabsXStd_Obj_04_RR 8;
BA_ "GenSigSendType" SG_ 1107 ARC_OD_VabsYStd_Obj_04_RR 8;
BA_ "GenSigSendType" SG_ 1107 ARC_OD_AabsXStd_Obj_04_RR 8;
BA_ "GenSigSendType" SG_ 1106 DistHeight_Obj_03_RR 8;
BA_ "GenSigSendType" SG_ 1106 DistHeight_Obj_02_RR 8;
BA_ "GenSigSendType" SG_ 1106 ARC_OD_DistX_Obj_02_RR 8;
BA_ "GenSigSendType" SG_ 1106 ARC_OD_Classification_Obj_02_RR 8;
BA_ "GenSigSendType" SG_ 1106 ARC_OD_AabsYStd_Obj_02_RR 8;
BA_ "GenSigSendType" SG_ 1106 ARC_OD_ClassConf_Obj_02_RR 8;
BA_ "GenSigSendType" SG_ 1106 ARC_OD_ProbOfExist_Obj_02_RR 8;
BA_ "GenSigSendType" SG_ 1106 ARC_OD_VabsX_Obj_02_RR 8;
BA_ "GenSigSendType" SG_ 1106 ARC_OD_DynProp_Obj_02_RR 8;
BA_ "GenSigSendType" SG_ 1106 ARC_OD_Length_Obj_02_RR 8;
BA_ "GenSigSendType" SG_ 1106 ARC_OD_MaintenanceState_Obj_02_R 8;
BA_ "GenSigSendType" SG_ 1106 ARC_OD_Width_Obj_02_RR 8;
BA_ "GenSigSendType" SG_ 1106 ARC_OD_RCS_Obj_02_RR 8;
BA_ "GenSigSendType" SG_ 1106 ARC_OD_Orientation_Obj_02_RR 8;
BA_ "GenSigSendType" SG_ 1106 ARC_OD_LifeCycle_Obj_02_RR 8;
BA_ "GenSigSendType" SG_ 1106 ARC_OD_DistX_Obj_03_RR 8;
BA_ "GenSigSendType" SG_ 1106 ARC_OD_VabsX_Obj_03_RR 8;
BA_ "GenSigSendType" SG_ 1106 ARC_OD_AabsX_Obj_03_RR 8;
BA_ "GenSigSendType" SG_ 1106 ARC_OD_AabsX_Obj_02_RR 8;
BA_ "GenSigSendType" SG_ 1106 ARC_OD_DistY_Obj_03_RR 8;
BA_ "GenSigSendType" SG_ 1106 ARC_OD_VabsY_Obj_03_RR 8;
BA_ "GenSigSendType" SG_ 1106 ARC_OD_AabsY_Obj_03_RR 8;
BA_ "GenSigSendType" SG_ 1106 ARC_OD_DistXStd_Obj_03_RR 8;
BA_ "GenSigSendType" SG_ 1106 ARC_OD_DistYStd_Obj_03_RR 8;
BA_ "GenSigSendType" SG_ 1106 ARC_OD_VabsXStd_Obj_03_RR 8;
BA_ "GenSigSendType" SG_ 1106 ARC_OD_VabsYStd_Obj_03_RR 8;
BA_ "GenSigSendType" SG_ 1106 ARC_OD_AabsXStd_Obj_03_RR 8;
BA_ "GenSigSendType" SG_ 1106 ARC_OD_Classification_Obj_03_RR 8;
BA_ "GenSigSendType" SG_ 1106 ARC_OD_AabsYStd_Obj_03_RR 8;
BA_ "GenSigSendType" SG_ 1106 ARC_OD_ClassConf_Obj_03_RR 8;
BA_ "GenSigSendType" SG_ 1106 ARC_OD_DistY_Obj_02_RR 8;
BA_ "GenSigSendType" SG_ 1106 ARC_OD_ProbOfExist_Obj_03_RR 8;
BA_ "GenSigSendType" SG_ 1106 ARC_OD_DynProp_Obj_03_RR 8;
BA_ "GenSigSendType" SG_ 1106 ARC_OD_Length_Obj_03_RR 8;
BA_ "GenSigSendType" SG_ 1106 ARC_OD_MaintenanceState_Obj_03_R 8;
BA_ "GenSigSendType" SG_ 1106 ARC_OD_Width_Obj_03_RR 8;
BA_ "GenSigSendType" SG_ 1106 ARC_OD_RCS_Obj_03_RR 8;
BA_ "GenSigSendType" SG_ 1106 ARC_OD_Orientation_Obj_03_RR 8;
BA_ "GenSigSendType" SG_ 1106 ARC_OD_LifeCycle_Obj_03_RR 8;
BA_ "GenSigSendType" SG_ 1106 ARC_OD_ObstacleProb_Obj_02_RR 8;
BA_ "GenSigSendType" SG_ 1106 ARC_OD_ObstacleProb_Obj_03_RR 8;
BA_ "GenSigSendType" SG_ 1106 ARC_OD_VabsY_Obj_02_RR 8;
BA_ "GenSigSendType" SG_ 1106 ARC_OD_ID_02_RR 8;
BA_ "GenSigSendType" SG_ 1106 ARC_OD_ID_03_RR 8;
BA_ "GenSigSendType" SG_ 1106 ARC_OD_MsgCounter_Obj_02_03_RR 8;
BA_ "GenSigSendType" SG_ 1106 ARC_OD_CRC8_Obj_02_03_RR 8;
BA_ "GenSigSendType" SG_ 1106 ARC_OD_AabsY_Obj_02_RR 8;
BA_ "GenSigSendType" SG_ 1106 ARC_OD_DistXStd_Obj_02_RR 8;
BA_ "GenSigSendType" SG_ 1106 ARC_OD_DistYStd_Obj_02_RR 8;
BA_ "GenSigSendType" SG_ 1106 ARC_OD_VabsXStd_Obj_02_RR 8;
BA_ "GenSigSendType" SG_ 1106 ARC_OD_VabsYStd_Obj_02_RR 8;
BA_ "GenSigSendType" SG_ 1106 ARC_OD_AabsXStd_Obj_02_RR 8;
BA_ "GenSigSendType" SG_ 1105 DistHeight_Obj_01_RR 8;
BA_ "GenSigSendType" SG_ 1105 DistHeight_Obj_00_RR 8;
BA_ "GenSigSendType" SG_ 1105 ARC_OD_DistX_Obj_00_RR 8;
BA_ "GenSigSendType" SG_ 1105 ARC_OD_Classification_Obj_00_RR 8;
BA_ "GenSigSendType" SG_ 1105 ARC_OD_AabsYStd_Obj_00_RR 8;
BA_ "GenSigSendType" SG_ 1105 ARC_OD_ClassConf_Obj_00_RR 8;
BA_ "GenSigSendType" SG_ 1105 ARC_OD_ProbOfExist_Obj_00_RR 8;
BA_ "GenSigSendType" SG_ 1105 ARC_OD_VabsX_Obj_00_RR 8;
BA_ "GenSigSendType" SG_ 1105 ARC_OD_DynProp_Obj_00_RR 8;
BA_ "GenSigSendType" SG_ 1105 ARC_OD_Length_Obj_00_RR 8;
BA_ "GenSigSendType" SG_ 1105 ARC_OD_MaintenanceState_Obj_00_R 8;
BA_ "GenSigSendType" SG_ 1105 ARC_OD_Width_Obj_00_RR 8;
BA_ "GenSigSendType" SG_ 1105 ARC_OD_RCS_Obj_00_RR 8;
BA_ "GenSigSendType" SG_ 1105 ARC_OD_Orientation_Obj_00_RR 8;
BA_ "GenSigSendType" SG_ 1105 ARC_OD_LifeCycle_Obj_00_RR 8;
BA_ "GenSigSendType" SG_ 1105 ARC_OD_DistX_Obj_01_RR 8;
BA_ "GenSigSendType" SG_ 1105 ARC_OD_VabsX_Obj_01_RR 8;
BA_ "GenSigSendType" SG_ 1105 ARC_OD_AabsX_Obj_01_RR 8;
BA_ "GenSigSendType" SG_ 1105 ARC_OD_AabsX_Obj_00_RR 8;
BA_ "GenSigSendType" SG_ 1105 ARC_OD_DistY_Obj_01_RR 8;
BA_ "GenSigSendType" SG_ 1105 ARC_OD_VabsY_Obj_01_RR 8;
BA_ "GenSigSendType" SG_ 1105 ARC_OD_AabsY_Obj_01_RR 8;
BA_ "GenSigSendType" SG_ 1105 ARC_OD_DistXStd_Obj_01_RR 8;
BA_ "GenSigSendType" SG_ 1105 ARC_OD_DistYStd_Obj_01_RR 8;
BA_ "GenSigSendType" SG_ 1105 ARC_OD_VabsXStd_Obj_01_RR 8;
BA_ "GenSigSendType" SG_ 1105 ARC_OD_VabsYStd_Obj_01_RR 8;
BA_ "GenSigSendType" SG_ 1105 ARC_OD_AabsXStd_Obj_01_RR 8;
BA_ "GenSigSendType" SG_ 1105 ARC_OD_Classification_Obj_01_RR 8;
BA_ "GenSigSendType" SG_ 1105 ARC_OD_AabsYStd_Obj_01_RR 8;
BA_ "GenSigSendType" SG_ 1105 ARC_OD_ClassConf_Obj_01_RR 8;
BA_ "GenSigSendType" SG_ 1105 ARC_OD_DistY_Obj_00_RR 8;
BA_ "GenSigSendType" SG_ 1105 ARC_OD_ProbOfExist_Obj_01_RR 8;
BA_ "GenSigSendType" SG_ 1105 ARC_OD_DynProp_Obj_01_RR 8;
BA_ "GenSigSendType" SG_ 1105 ARC_OD_Length_Obj_01_RR 8;
BA_ "GenSigSendType" SG_ 1105 ARC_OD_MaintenanceState_Obj_01_R 8;
BA_ "GenSigSendType" SG_ 1105 ARC_OD_Width_Obj_01_RR 8;
BA_ "GenSigSendType" SG_ 1105 ARC_OD_RCS_Obj_01_RR 8;
BA_ "GenSigSendType" SG_ 1105 ARC_OD_Orientation_Obj_01_RR 8;
BA_ "GenSigSendType" SG_ 1105 ARC_OD_LifeCycle_Obj_01_RR 8;
BA_ "GenSigSendType" SG_ 1105 ARC_OD_ObstacleProb_Obj_00_RR 8;
BA_ "GenSigSendType" SG_ 1105 ARC_OD_ObstacleProb_Obj_01_RR 8;
BA_ "GenSigSendType" SG_ 1105 ARC_OD_VabsY_Obj_00_RR 8;
BA_ "GenSigSendType" SG_ 1105 ARC_OD_ID_00_RR 8;
BA_ "GenSigSendType" SG_ 1105 ARC_OD_ID_01_RR 8;
BA_ "GenSigSendType" SG_ 1105 ARC_OD_MsgCounter_Obj_00_01_RR 8;
BA_ "GenSigSendType" SG_ 1105 ARC_OD_CRC8_Obj_00_01_RR 8;
BA_ "GenSigSendType" SG_ 1105 ARC_OD_AabsY_Obj_00_RR 8;
BA_ "GenSigSendType" SG_ 1105 ARC_OD_DistXStd_Obj_00_RR 8;
BA_ "GenSigSendType" SG_ 1105 ARC_OD_DistYStd_Obj_00_RR 8;
BA_ "GenSigSendType" SG_ 1105 ARC_OD_VabsXStd_Obj_00_RR 8;
BA_ "GenSigSendType" SG_ 1105 ARC_OD_VabsYStd_Obj_00_RR 8;
BA_ "GenSigSendType" SG_ 1105 ARC_OD_AabsXStd_Obj_00_RR 8;
BA_ "GenSigSendType" SG_ 1616 ARC_OD_TimeStampGlobSec_FL 8;
BA_ "GenSigSendType" SG_ 1616 ARC_OD_CycleCounter_FL 8;
BA_ "GenSigSendType" SG_ 1616 ARC_OD_NumOfObjects_FL 8;
BA_ "GenSigSendType" SG_ 1616 ARC_OD_TaskValidFlag_FL 8;
BA_ "GenSigSendType" SG_ 1616 ARC_OD_ExtendedCycleFlag_FL 8;
BA_ "GenSigSendType" SG_ 1616 ARC_OD_Latency_FL 8;
BA_ "GenSigSendType" SG_ 1616 ARC_OD_MsgCounter_Header_FL 8;
BA_ "GenSigSendType" SG_ 1616 ARC_OD_CRC8_Header_FL 8;
BA_ "GenSigSendType" SG_ 1616 ARC_OD_TimeStampGlobNanoSec_FL 8;
BA_ "GenSigSendType" SG_ 1616 ARC_OD_TimeStampLocal_FL 8;
BA_ "GenSigSendType" SG_ 1616 ARC_OD_MeasCounter_FL 8;
BA_ "GenSigSendType" SG_ 1360 ARC_OD_TimeStampGlobSec_FR 8;
BA_ "GenSigSendType" SG_ 1360 ARC_OD_CycleCounter_FR 8;
BA_ "GenSigSendType" SG_ 1360 ARC_OD_NumOfObjects_FR 8;
BA_ "GenSigSendType" SG_ 1360 ARC_OD_TaskValidFlag_FR 8;
BA_ "GenSigSendType" SG_ 1360 ARC_OD_ExtendedCycleFlag_FR 8;
BA_ "GenSigSendType" SG_ 1360 ARC_OD_Latency_FR 8;
BA_ "GenSigSendType" SG_ 1360 ARC_OD_MsgCounter_Header_FR 8;
BA_ "GenSigSendType" SG_ 1360 ARC_OD_CRC8_Header_FR 8;
BA_ "GenSigSendType" SG_ 1360 ARC_OD_TimeStampGlobNanoSec_FR 8;
BA_ "GenSigSendType" SG_ 1360 ARC_OD_TimeStampLocal_FR 8;
BA_ "GenSigSendType" SG_ 1360 ARC_OD_MeasCounter_FR 8;
BA_ "GenSigSendType" SG_ 1104 ARC_OD_TimeStampGlobSec_RR 8;
BA_ "GenSigSendType" SG_ 1104 ARC_OD_CycleCounter_RR 8;
BA_ "GenSigSendType" SG_ 1104 ARC_OD_NumOfObjects_RR 8;
BA_ "GenSigSendType" SG_ 1104 ARC_OD_TaskValidFlag_RR 8;
BA_ "GenSigSendType" SG_ 1104 ARC_OD_ExtendedCycleFlag_RR 8;
BA_ "GenSigSendType" SG_ 1104 ARC_OD_Latency_RR 8;
BA_ "GenSigSendType" SG_ 1104 ARC_OD_MsgCounter_Header_RR 8;
BA_ "GenSigSendType" SG_ 1104 ARC_OD_CRC8_Header_RR 8;
BA_ "GenSigSendType" SG_ 1104 ARC_OD_TimeStampGlobNanoSec_RR 8;
BA_ "GenSigSendType" SG_ 1104 ARC_OD_TimeStampLocal_RR 8;
BA_ "GenSigSendType" SG_ 1104 ARC_OD_MeasCounter_RR 8;
BA_ "GenSigSendType" SG_ 102 ARC_ERROR_STATE_FR 8;
BA_ "GenSigSendType" SG_ 102 ARC_CFG_Mode_FR 8;
BA_ "GenSigSendType" SG_ 102 ARC_CFG_TmeSynEnFl_FR 8;
BA_ "GenSigSendType" SG_ 102 ARC_CONFIG_STATE_FR_RC 8;
BA_ "GenSigSendType" SG_ 102 ARC_CONFIG_STATE_FR_CRC 8;
BA_ "GenSigSendType" SG_ 105 ARC_ERROR_STATE_FL 8;
BA_ "GenSigSendType" SG_ 105 ARC_CFG_Mode_FL 8;
BA_ "GenSigSendType" SG_ 105 ARC_CFG_TmeSynEnFl_FL 8;
BA_ "GenSigSendType" SG_ 105 ARC_CONFIG_STATE_FL_RC 8;
BA_ "GenSigSendType" SG_ 105 ARC_CONFIG_STATE_FL_CRC 8;
BA_ "GenSigSendType" SG_ 99 ARC_ERROR_STATE_RR 8;
BA_ "GenSigSendType" SG_ 99 ARC_CFG_Mode_RR 8;
BA_ "GenSigSendType" SG_ 99 ARC_CFG_TmeSynEnFl_RR 8;
BA_ "GenSigSendType" SG_ 99 ARC_CONFIG_STATE_RR_RC 8;
BA_ "GenSigSendType" SG_ 99 ARC_CONFIG_STATE_RR_CRC 8;
BA_ "GenSigSendType" SG_ 96 ARC_ERROR_STATE_RL 8;
BA_ "GenSigSendType" SG_ 96 ARC_CFG_Mode_RL 8;
BA_ "GenSigSendType" SG_ 96 ARC_CFG_TmeSynEnFl_RL 8;
BA_ "GenSigSendType" SG_ 96 ARC_CONFIG_STATE_RL_RC 8;
BA_ "GenSigSendType" SG_ 96 ARC_CONFIG_STATE_RL_CRC 8;
BA_ "GenSigSendType" SG_ 848 ARC_OD_TimeStampGlobSec_RL 8;
BA_ "GenSigSendType" SG_ 848 ARC_OD_CycleCounter_RL 8;
BA_ "GenSigSendType" SG_ 848 ARC_OD_NumOfObjects_RL 8;
BA_ "GenSigSendType" SG_ 848 ARC_OD_TaskValidFlag_RL 8;
BA_ "GenSigSendType" SG_ 848 ARC_OD_ExtendedCycleFlag_RL 8;
BA_ "GenSigSendType" SG_ 848 ARC_OD_Latency_RL 8;
BA_ "GenSigSendType" SG_ 848 ARC_OD_MsgCounter_Header_RL 8;
BA_ "GenSigSendType" SG_ 848 ARC_OD_CRC8_Header_RL 8;
BA_ "GenSigSendType" SG_ 848 ARC_OD_TimeStampGlobNanoSec_RL 8;
BA_ "GenSigSendType" SG_ 848 ARC_OD_TimeStampLocal_RL 8;
BA_ "GenSigSendType" SG_ 848 ARC_OD_MeasCounter_RL 8;
BA_ "GenSigSendType" SG_ 849 DistHeight_Obj_01_RL 8;
BA_ "GenSigSendType" SG_ 849 DistHeight_Obj_00_RL 8;
BA_ "GenSigSendType" SG_ 849 ARC_OD_DistX_Obj_00_RL 8;
BA_ "GenSigSendType" SG_ 849 ARC_OD_Classification_Obj_00_RL 8;
BA_ "GenSigSendType" SG_ 849 ARC_OD_AabsYStd_Obj_00_RL 8;
BA_ "GenSigSendType" SG_ 849 ARC_OD_ClassConf_Obj_00_RL 8;
BA_ "GenSigSendType" SG_ 849 ARC_OD_ProbOfExist_Obj_00_RL 8;
BA_ "GenSigSendType" SG_ 849 ARC_OD_VabsX_Obj_00_RL 8;
BA_ "GenSigSendType" SG_ 849 ARC_OD_DynProp_Obj_00_RL 8;
BA_ "GenSigSendType" SG_ 849 ARC_OD_Length_Obj_00_RL 8;
BA_ "GenSigSendType" SG_ 849 ARC_OD_MaintenanceState_Obj_0061 8;
BA_ "GenSigSendType" SG_ 849 ARC_OD_Width_Obj_00_RL 8;
BA_ "GenSigSendType" SG_ 849 ARC_OD_RCS_Obj_00_RL 8;
BA_ "GenSigSendType" SG_ 849 ARC_OD_Orientation_Obj_00_RL 8;
BA_ "GenSigSendType" SG_ 849 ARC_OD_LifeCycle_Obj_00_RL 8;
BA_ "GenSigSendType" SG_ 849 ARC_OD_DistX_Obj_01_RL 8;
BA_ "GenSigSendType" SG_ 849 ARC_OD_VabsX_Obj_01_RL 8;
BA_ "GenSigSendType" SG_ 849 ARC_OD_AabsX_Obj_01_RL 8;
BA_ "GenSigSendType" SG_ 849 ARC_OD_AabsX_Obj_00_RL 8;
BA_ "GenSigSendType" SG_ 849 ARC_OD_DistY_Obj_01_RL 8;
BA_ "GenSigSendType" SG_ 849 ARC_OD_VabsY_Obj_01_RL 8;
BA_ "GenSigSendType" SG_ 849 ARC_OD_AabsY_Obj_01_RL 8;
BA_ "GenSigSendType" SG_ 849 ARC_OD_DistXStd_Obj_01_RL 8;
BA_ "GenSigSendType" SG_ 849 ARC_OD_DistYStd_Obj_01_RL 8;
BA_ "GenSigSendType" SG_ 849 ARC_OD_VabsXStd_Obj_01_RL 8;
BA_ "GenSigSendType" SG_ 849 ARC_OD_VabsYStd_Obj_01_RL 8;
BA_ "GenSigSendType" SG_ 849 ARC_OD_AabsXStd_Obj_01_RL 8;
BA_ "GenSigSendType" SG_ 849 ARC_OD_Classification_Obj_01_RL 8;
BA_ "GenSigSendType" SG_ 849 ARC_OD_AabsYStd_Obj_01_RL 8;
BA_ "GenSigSendType" SG_ 849 ARC_OD_ClassConf_Obj_01_RL 8;
BA_ "GenSigSendType" SG_ 849 ARC_OD_DistY_Obj_00_RL 8;
BA_ "GenSigSendType" SG_ 849 ARC_OD_ProbOfExist_Obj_01_RL 8;
BA_ "GenSigSendType" SG_ 849 ARC_OD_DynProp_Obj_01_RL 8;
BA_ "GenSigSendType" SG_ 849 ARC_OD_Length_Obj_01_RL 8;
BA_ "GenSigSendType" SG_ 849 ARC_OD_MaintenanceState_Obj_0062 8;
BA_ "GenSigSendType" SG_ 849 ARC_OD_Width_Obj_01_RL 8;
BA_ "GenSigSendType" SG_ 849 ARC_OD_RCS_Obj_01_RL 8;
BA_ "GenSigSendType" SG_ 849 ARC_OD_Orientation_Obj_01_RL 8;
BA_ "GenSigSendType" SG_ 849 ARC_OD_LifeCycle_Obj_01_RL 8;
BA_ "GenSigSendType" SG_ 849 ARC_OD_ObstacleProb_Obj_00_RL 8;
BA_ "GenSigSendType" SG_ 849 ARC_OD_ObstacleProb_Obj_01_RL 8;
BA_ "GenSigSendType" SG_ 849 ARC_OD_VabsY_Obj_00_RL 8;
BA_ "GenSigSendType" SG_ 849 ARC_OD_ID_00_RL 8;
BA_ "GenSigSendType" SG_ 849 ARC_OD_ID_01_RL 8;
BA_ "GenSigSendType" SG_ 849 ARC_OD_MsgCounter_Obj_00_01_RL 8;
BA_ "GenSigSendType" SG_ 849 ARC_OD_CRC8_Obj_00_01_RL 8;
BA_ "GenSigSendType" SG_ 849 ARC_OD_AabsY_Obj_00_RL 8;
BA_ "GenSigSendType" SG_ 849 ARC_OD_DistXStd_Obj_00_RL 8;
BA_ "GenSigSendType" SG_ 849 ARC_OD_DistYStd_Obj_00_RL 8;
BA_ "GenSigSendType" SG_ 849 ARC_OD_VabsXStd_Obj_00_RL 8;
BA_ "GenSigSendType" SG_ 849 ARC_OD_VabsYStd_Obj_00_RL 8;
BA_ "GenSigSendType" SG_ 849 ARC_OD_AabsXStd_Obj_00_RL 8;
BA_ "GenSigSendType" SG_ 850 DistHeight_Obj_03_RL 8;
BA_ "GenSigSendType" SG_ 850 DistHeight_Obj_02_RL 8;
BA_ "GenSigSendType" SG_ 850 ARC_OD_DistX_Obj_02_RL 8;
BA_ "GenSigSendType" SG_ 850 ARC_OD_Classification_Obj_02_RL 8;
BA_ "GenSigSendType" SG_ 850 ARC_OD_AabsYStd_Obj_02_RL 8;
BA_ "GenSigSendType" SG_ 850 ARC_OD_ClassConf_Obj_02_RL 8;
BA_ "GenSigSendType" SG_ 850 ARC_OD_ProbOfExist_Obj_02_RL 8;
BA_ "GenSigSendType" SG_ 850 ARC_OD_VabsX_Obj_02_RL 8;
BA_ "GenSigSendType" SG_ 850 ARC_OD_DynProp_Obj_02_RL 8;
BA_ "GenSigSendType" SG_ 850 ARC_OD_Length_Obj_02_RL 8;
BA_ "GenSigSendType" SG_ 850 ARC_OD_MaintenanceState_Obj_0063 8;
BA_ "GenSigSendType" SG_ 850 ARC_OD_Width_Obj_02_RL 8;
BA_ "GenSigSendType" SG_ 850 ARC_OD_RCS_Obj_02_RL 8;
BA_ "GenSigSendType" SG_ 850 ARC_OD_Orientation_Obj_02_RL 8;
BA_ "GenSigSendType" SG_ 850 ARC_OD_LifeCycle_Obj_02_RL 8;
BA_ "GenSigSendType" SG_ 850 ARC_OD_DistX_Obj_03_RL 8;
BA_ "GenSigSendType" SG_ 850 ARC_OD_VabsX_Obj_03_RL 8;
BA_ "GenSigSendType" SG_ 850 ARC_OD_AabsX_Obj_03_RL 8;
BA_ "GenSigSendType" SG_ 850 ARC_OD_AabsX_Obj_02_RL 8;
BA_ "GenSigSendType" SG_ 850 ARC_OD_DistY_Obj_03_RL 8;
BA_ "GenSigSendType" SG_ 850 ARC_OD_VabsY_Obj_03_RL 8;
BA_ "GenSigSendType" SG_ 850 ARC_OD_AabsY_Obj_03_RL 8;
BA_ "GenSigSendType" SG_ 850 ARC_OD_DistXStd_Obj_03_RL 8;
BA_ "GenSigSendType" SG_ 850 ARC_OD_DistYStd_Obj_03_RL 8;
BA_ "GenSigSendType" SG_ 850 ARC_OD_VabsXStd_Obj_03_RL 8;
BA_ "GenSigSendType" SG_ 850 ARC_OD_VabsYStd_Obj_03_RL 8;
BA_ "GenSigSendType" SG_ 850 ARC_OD_AabsXStd_Obj_03_RL 8;
BA_ "GenSigSendType" SG_ 850 ARC_OD_Classification_Obj_03_RL 8;
BA_ "GenSigSendType" SG_ 850 ARC_OD_AabsYStd_Obj_03_RL 8;
BA_ "GenSigSendType" SG_ 850 ARC_OD_ClassConf_Obj_03_RL 8;
BA_ "GenSigSendType" SG_ 850 ARC_OD_DistY_Obj_02_RL 8;
BA_ "GenSigSendType" SG_ 850 ARC_OD_ProbOfExist_Obj_03_RL 8;
BA_ "GenSigSendType" SG_ 850 ARC_OD_DynProp_Obj_03_RL 8;
BA_ "GenSigSendType" SG_ 850 ARC_OD_Length_Obj_03_RL 8;
BA_ "GenSigSendType" SG_ 850 ARC_OD_MaintenanceState_Obj_0064 8;
BA_ "GenSigSendType" SG_ 850 ARC_OD_Width_Obj_03_RL 8;
BA_ "GenSigSendType" SG_ 850 ARC_OD_RCS_Obj_03_RL 8;
BA_ "GenSigSendType" SG_ 850 ARC_OD_Orientation_Obj_03_RL 8;
BA_ "GenSigSendType" SG_ 850 ARC_OD_LifeCycle_Obj_03_RL 8;
BA_ "GenSigSendType" SG_ 850 ARC_OD_ObstacleProb_Obj_02_RL 8;
BA_ "GenSigSendType" SG_ 850 ARC_OD_ObstacleProb_Obj_03_RL 8;
BA_ "GenSigSendType" SG_ 850 ARC_OD_VabsY_Obj_02_RL 8;
BA_ "GenSigSendType" SG_ 850 ARC_OD_ID_02_RL 8;
BA_ "GenSigSendType" SG_ 850 ARC_OD_ID_03_RL 8;
BA_ "GenSigSendType" SG_ 850 ARC_OD_MsgCounter_Obj_02_03_RL 8;
BA_ "GenSigSendType" SG_ 850 ARC_OD_CRC8_Obj_02_03_RL 8;
BA_ "GenSigSendType" SG_ 850 ARC_OD_AabsY_Obj_02_RL 8;
BA_ "GenSigSendType" SG_ 850 ARC_OD_DistXStd_Obj_02_RL 8;
BA_ "GenSigSendType" SG_ 850 ARC_OD_DistYStd_Obj_02_RL 8;
BA_ "GenSigSendType" SG_ 850 ARC_OD_VabsXStd_Obj_02_RL 8;
BA_ "GenSigSendType" SG_ 850 ARC_OD_VabsYStd_Obj_02_RL 8;
BA_ "GenSigSendType" SG_ 850 ARC_OD_AabsXStd_Obj_02_RL 8;
BA_ "GenSigSendType" SG_ 851 DistHeight_Obj_05_RL 8;
BA_ "GenSigSendType" SG_ 851 DistHeight_Obj_04_RL 8;
BA_ "GenSigSendType" SG_ 851 ARC_OD_DistX_Obj_04_RL 8;
BA_ "GenSigSendType" SG_ 851 ARC_OD_Classification_Obj_04_RL 8;
BA_ "GenSigSendType" SG_ 851 ARC_OD_AabsYStd_Obj_04_RL 8;
BA_ "GenSigSendType" SG_ 851 ARC_OD_ClassConf_Obj_04_RL 8;
BA_ "GenSigSendType" SG_ 851 ARC_OD_ProbOfExist_Obj_04_RL 8;
BA_ "GenSigSendType" SG_ 851 ARC_OD_VabsX_Obj_04_RL 8;
BA_ "GenSigSendType" SG_ 851 ARC_OD_DynProp_Obj_04_RL 8;
BA_ "GenSigSendType" SG_ 851 ARC_OD_Length_Obj_04_RL 8;
BA_ "GenSigSendType" SG_ 851 ARC_OD_MaintenanceState_Obj_0065 8;
BA_ "GenSigSendType" SG_ 851 ARC_OD_Width_Obj_04_RL 8;
BA_ "GenSigSendType" SG_ 851 ARC_OD_RCS_Obj_04_RL 8;
BA_ "GenSigSendType" SG_ 851 ARC_OD_Orientation_Obj_04_RL 8;
BA_ "GenSigSendType" SG_ 851 ARC_OD_LifeCycle_Obj_04_RL 8;
BA_ "GenSigSendType" SG_ 851 ARC_OD_DistX_Obj_05_RL 8;
BA_ "GenSigSendType" SG_ 851 ARC_OD_VabsX_Obj_05_RL 8;
BA_ "GenSigSendType" SG_ 851 ARC_OD_AabsX_Obj_05_RL 8;
BA_ "GenSigSendType" SG_ 851 ARC_OD_AabsX_Obj_04_RL 8;
BA_ "GenSigSendType" SG_ 851 ARC_OD_DistY_Obj_05_RL 8;
BA_ "GenSigSendType" SG_ 851 ARC_OD_VabsY_Obj_05_RL 8;
BA_ "GenSigSendType" SG_ 851 ARC_OD_AabsY_Obj_05_RL 8;
BA_ "GenSigSendType" SG_ 851 ARC_OD_DistXStd_Obj_05_RL 8;
BA_ "GenSigSendType" SG_ 851 ARC_OD_DistYStd_Obj_05_RL 8;
BA_ "GenSigSendType" SG_ 851 ARC_OD_VabsXStd_Obj_05_RL 8;
BA_ "GenSigSendType" SG_ 851 ARC_OD_VabsYStd_Obj_05_RL 8;
BA_ "GenSigSendType" SG_ 851 ARC_OD_AabsXStd_Obj_05_RL 8;
BA_ "GenSigSendType" SG_ 851 ARC_OD_Classification_Obj_05_RL 8;
BA_ "GenSigSendType" SG_ 851 ARC_OD_AabsYStd_Obj_05_RL 8;
BA_ "GenSigSendType" SG_ 851 ARC_OD_ClassConf_Obj_05_RL 8;
BA_ "GenSigSendType" SG_ 851 ARC_OD_DistY_Obj_04_RL 8;
BA_ "GenSigSendType" SG_ 851 ARC_OD_ProbOfExist_Obj_05_RL 8;
BA_ "GenSigSendType" SG_ 851 ARC_OD_DynProp_Obj_05_RL 8;
BA_ "GenSigSendType" SG_ 851 ARC_OD_Length_Obj_05_RL 8;
BA_ "GenSigSendType" SG_ 851 ARC_OD_MaintenanceState_Obj_0066 8;
BA_ "GenSigSendType" SG_ 851 ARC_OD_Width_Obj_05_RL 8;
BA_ "GenSigSendType" SG_ 851 ARC_OD_RCS_Obj_05_RL 8;
BA_ "GenSigSendType" SG_ 851 ARC_OD_Orientation_Obj_05_RL 8;
BA_ "GenSigSendType" SG_ 851 ARC_OD_LifeCycle_Obj_05_RL 8;
BA_ "GenSigSendType" SG_ 851 ARC_OD_ObstacleProb_Obj_04_RL 8;
BA_ "GenSigSendType" SG_ 851 ARC_OD_ObstacleProb_Obj_05_RL 8;
BA_ "GenSigSendType" SG_ 851 ARC_OD_VabsY_Obj_04_RL 8;
BA_ "GenSigSendType" SG_ 851 ARC_OD_ID_04_RL 8;
BA_ "GenSigSendType" SG_ 851 ARC_OD_ID_05_RL 8;
BA_ "GenSigSendType" SG_ 851 ARC_OD_MsgCounter_Obj_04_05_RL 8;
BA_ "GenSigSendType" SG_ 851 ARC_OD_CRC8_Obj_04_05_RL 8;
BA_ "GenSigSendType" SG_ 851 ARC_OD_AabsY_Obj_04_RL 8;
BA_ "GenSigSendType" SG_ 851 ARC_OD_DistXStd_Obj_04_RL 8;
BA_ "GenSigSendType" SG_ 851 ARC_OD_DistYStd_Obj_04_RL 8;
BA_ "GenSigSendType" SG_ 851 ARC_OD_VabsXStd_Obj_04_RL 8;
BA_ "GenSigSendType" SG_ 851 ARC_OD_VabsYStd_Obj_04_RL 8;
BA_ "GenSigSendType" SG_ 851 ARC_OD_AabsXStd_Obj_04_RL 8;
BA_ "GenSigSendType" SG_ 852 DistHeight_Obj_07_RL 8;
BA_ "GenSigSendType" SG_ 852 DistHeight_Obj_06_RL 8;
BA_ "GenSigSendType" SG_ 852 ARC_OD_DistX_Obj_06_RL 8;
BA_ "GenSigSendType" SG_ 852 ARC_OD_Classification_Obj_06_RL 8;
BA_ "GenSigSendType" SG_ 852 ARC_OD_AabsYStd_Obj_06_RL 8;
BA_ "GenSigSendType" SG_ 852 ARC_OD_ClassConf_Obj_06_RL 8;
BA_ "GenSigSendType" SG_ 852 ARC_OD_ProbOfExist_Obj_06_RL 8;
BA_ "GenSigSendType" SG_ 852 ARC_OD_VabsX_Obj_06_RL 8;
BA_ "GenSigSendType" SG_ 852 ARC_OD_DynProp_Obj_06_RL 8;
BA_ "GenSigSendType" SG_ 852 ARC_OD_Length_Obj_06_RL 8;
BA_ "GenSigSendType" SG_ 852 ARC_OD_MaintenanceState_Obj_0067 8;
BA_ "GenSigSendType" SG_ 852 ARC_OD_Width_Obj_06_RL 8;
BA_ "GenSigSendType" SG_ 852 ARC_OD_RCS_Obj_06_RL 8;
BA_ "GenSigSendType" SG_ 852 ARC_OD_Orientation_Obj_06_RL 8;
BA_ "GenSigSendType" SG_ 852 ARC_OD_LifeCycle_Obj_06_RL 8;
BA_ "GenSigSendType" SG_ 852 ARC_OD_DistX_Obj_07_RL 8;
BA_ "GenSigSendType" SG_ 852 ARC_OD_VabsX_Obj_07_RL 8;
BA_ "GenSigSendType" SG_ 852 ARC_OD_AabsX_Obj_07_RL 8;
BA_ "GenSigSendType" SG_ 852 ARC_OD_AabsX_Obj_06_RL 8;
BA_ "GenSigSendType" SG_ 852 ARC_OD_DistY_Obj_07_RL 8;
BA_ "GenSigSendType" SG_ 852 ARC_OD_VabsY_Obj_07_RL 8;
BA_ "GenSigSendType" SG_ 852 ARC_OD_AabsY_Obj_07_RL 8;
BA_ "GenSigSendType" SG_ 852 ARC_OD_DistXStd_Obj_07_RL 8;
BA_ "GenSigSendType" SG_ 852 ARC_OD_DistYStd_Obj_07_RL 8;
BA_ "GenSigSendType" SG_ 852 ARC_OD_VabsXStd_Obj_07_RL 8;
BA_ "GenSigSendType" SG_ 852 ARC_OD_VabsYStd_Obj_07_RL 8;
BA_ "GenSigSendType" SG_ 852 ARC_OD_AabsXStd_Obj_07_RL 8;
BA_ "GenSigSendType" SG_ 852 ARC_OD_Classification_Obj_07_RL 8;
BA_ "GenSigSendType" SG_ 852 ARC_OD_AabsYStd_Obj_07_RL 8;
BA_ "GenSigSendType" SG_ 852 ARC_OD_ClassConf_Obj_07_RL 8;
BA_ "GenSigSendType" SG_ 852 ARC_OD_DistY_Obj_06_RL 8;
BA_ "GenSigSendType" SG_ 852 ARC_OD_ProbOfExist_Obj_07_RL 8;
BA_ "GenSigSendType" SG_ 852 ARC_OD_DynProp_Obj_07_RL 8;
BA_ "GenSigSendType" SG_ 852 ARC_OD_Length_Obj_07_RL 8;
BA_ "GenSigSendType" SG_ 852 ARC_OD_MaintenanceState_Obj_0068 8;
BA_ "GenSigSendType" SG_ 852 ARC_OD_Width_Obj_07_RL 8;
BA_ "GenSigSendType" SG_ 852 ARC_OD_RCS_Obj_07_RL 8;
BA_ "GenSigSendType" SG_ 852 ARC_OD_Orientation_Obj_07_RL 8;
BA_ "GenSigSendType" SG_ 852 ARC_OD_LifeCycle_Obj_07_RL 8;
BA_ "GenSigSendType" SG_ 852 ARC_OD_ObstacleProb_Obj_06_RL 8;
BA_ "GenSigSendType" SG_ 852 ARC_OD_ObstacleProb_Obj_07_RL 8;
BA_ "GenSigSendType" SG_ 852 ARC_OD_VabsY_Obj_06_RL 8;
BA_ "GenSigSendType" SG_ 852 ARC_OD_ID_06_RL 8;
BA_ "GenSigSendType" SG_ 852 ARC_OD_ID_07_RL 8;
BA_ "GenSigSendType" SG_ 852 ARC_OD_MsgCounter_Obj_06_07_RL 8;
BA_ "GenSigSendType" SG_ 852 ARC_OD_CRC8_Obj_06_07_RL 8;
BA_ "GenSigSendType" SG_ 852 ARC_OD_AabsY_Obj_06_RL 8;
BA_ "GenSigSendType" SG_ 852 ARC_OD_DistXStd_Obj_06_RL 8;
BA_ "GenSigSendType" SG_ 852 ARC_OD_DistYStd_Obj_06_RL 8;
BA_ "GenSigSendType" SG_ 852 ARC_OD_VabsXStd_Obj_06_RL 8;
BA_ "GenSigSendType" SG_ 852 ARC_OD_VabsYStd_Obj_06_RL 8;
BA_ "GenSigSendType" SG_ 852 ARC_OD_AabsXStd_Obj_06_RL 8;
BA_ "GenSigSendType" SG_ 853 DistHeight_Obj_09_RL 8;
BA_ "GenSigSendType" SG_ 853 DistHeight_Obj_08_RL 8;
BA_ "GenSigSendType" SG_ 853 ARC_OD_DistX_Obj_08_RL 8;
BA_ "GenSigSendType" SG_ 853 ARC_OD_Classification_Obj_08_RL 8;
BA_ "GenSigSendType" SG_ 853 ARC_OD_AabsYStd_Obj_08_RL 8;
BA_ "GenSigSendType" SG_ 853 ARC_OD_ClassConf_Obj_08_RL 8;
BA_ "GenSigSendType" SG_ 853 ARC_OD_ProbOfExist_Obj_08_RL 8;
BA_ "GenSigSendType" SG_ 853 ARC_OD_VabsX_Obj_08_RL 8;
BA_ "GenSigSendType" SG_ 853 ARC_OD_DynProp_Obj_08_RL 8;
BA_ "GenSigSendType" SG_ 853 ARC_OD_Length_Obj_08_RL 8;
BA_ "GenSigSendType" SG_ 853 ARC_OD_MaintenanceState_Obj_0069 8;
BA_ "GenSigSendType" SG_ 853 ARC_OD_Width_Obj_08_RL 8;
BA_ "GenSigSendType" SG_ 853 ARC_OD_RCS_Obj_08_RL 8;
BA_ "GenSigSendType" SG_ 853 ARC_OD_Orientation_Obj_08_RL 8;
BA_ "GenSigSendType" SG_ 853 ARC_OD_LifeCycle_Obj_08_RL 8;
BA_ "GenSigSendType" SG_ 853 ARC_OD_DistX_Obj_09_RL 8;
BA_ "GenSigSendType" SG_ 853 ARC_OD_VabsX_Obj_09_RL 8;
BA_ "GenSigSendType" SG_ 853 ARC_OD_AabsX_Obj_09_RL 8;
BA_ "GenSigSendType" SG_ 853 ARC_OD_AabsX_Obj_08_RL 8;
BA_ "GenSigSendType" SG_ 853 ARC_OD_DistY_Obj_09_RL 8;
BA_ "GenSigSendType" SG_ 853 ARC_OD_VabsY_Obj_09_RL 8;
BA_ "GenSigSendType" SG_ 853 ARC_OD_AabsY_Obj_09_RL 8;
BA_ "GenSigSendType" SG_ 853 ARC_OD_DistXStd_Obj_09_RL 8;
BA_ "GenSigSendType" SG_ 853 ARC_OD_DistYStd_Obj_09_RL 8;
BA_ "GenSigSendType" SG_ 853 ARC_OD_VabsXStd_Obj_09_RL 8;
BA_ "GenSigSendType" SG_ 853 ARC_OD_VabsYStd_Obj_09_RL 8;
BA_ "GenSigSendType" SG_ 853 ARC_OD_AabsXStd_Obj_09_RL 8;
BA_ "GenSigSendType" SG_ 853 ARC_OD_Classification_Obj_09_RL 8;
BA_ "GenSigSendType" SG_ 853 ARC_OD_AabsYStd_Obj_09_RL 8;
BA_ "GenSigSendType" SG_ 853 ARC_OD_ClassConf_Obj_09_RL 8;
BA_ "GenSigSendType" SG_ 853 ARC_OD_DistY_Obj_08_RL 8;
BA_ "GenSigSendType" SG_ 853 ARC_OD_ProbOfExist_Obj_09_RL 8;
BA_ "GenSigSendType" SG_ 853 ARC_OD_DynProp_Obj_09_RL 8;
BA_ "GenSigSendType" SG_ 853 ARC_OD_Length_Obj_09_RL 8;
BA_ "GenSigSendType" SG_ 853 ARC_OD_MaintenanceState_Obj_0070 8;
BA_ "GenSigSendType" SG_ 853 ARC_OD_Width_Obj_09_RL 8;
BA_ "GenSigSendType" SG_ 853 ARC_OD_RCS_Obj_09_RL 8;
BA_ "GenSigSendType" SG_ 853 ARC_OD_Orientation_Obj_09_RL 8;
BA_ "GenSigSendType" SG_ 853 ARC_OD_LifeCycle_Obj_09_RL 8;
BA_ "GenSigSendType" SG_ 853 ARC_OD_ObstacleProb_Obj_08_RL 8;
BA_ "GenSigSendType" SG_ 853 ARC_OD_ObstacleProb_Obj_09_RL 8;
BA_ "GenSigSendType" SG_ 853 ARC_OD_VabsY_Obj_08_RL 8;
BA_ "GenSigSendType" SG_ 853 ARC_OD_ID_08_RL 8;
BA_ "GenSigSendType" SG_ 853 ARC_OD_ID_09_RL 8;
BA_ "GenSigSendType" SG_ 853 ARC_OD_MsgCounter_Obj_08_09_RL 8;
BA_ "GenSigSendType" SG_ 853 ARC_OD_CRC8_Obj_08_09_RL 8;
BA_ "GenSigSendType" SG_ 853 ARC_OD_AabsY_Obj_08_RL 8;
BA_ "GenSigSendType" SG_ 853 ARC_OD_DistXStd_Obj_08_RL 8;
BA_ "GenSigSendType" SG_ 853 ARC_OD_DistYStd_Obj_08_RL 8;
BA_ "GenSigSendType" SG_ 853 ARC_OD_VabsXStd_Obj_08_RL 8;
BA_ "GenSigSendType" SG_ 853 ARC_OD_VabsYStd_Obj_08_RL 8;
BA_ "GenSigSendType" SG_ 853 ARC_OD_AabsXStd_Obj_08_RL 8;
BA_ "GenSigSendType" SG_ 854 DistHeight_Obj_11_RL 8;
BA_ "GenSigSendType" SG_ 854 DistHeight_Obj_10_RL 8;
BA_ "GenSigSendType" SG_ 854 ARC_OD_DistX_Obj_10_RL 8;
BA_ "GenSigSendType" SG_ 854 ARC_OD_Classification_Obj_10_RL 8;
BA_ "GenSigSendType" SG_ 854 ARC_OD_AabsYStd_Obj_10_RL 8;
BA_ "GenSigSendType" SG_ 854 ARC_OD_ClassConf_Obj_10_RL 8;
BA_ "GenSigSendType" SG_ 854 ARC_OD_ProbOfExist_Obj_10_RL 8;
BA_ "GenSigSendType" SG_ 854 ARC_OD_VabsX_Obj_10_RL 8;
BA_ "GenSigSendType" SG_ 854 ARC_OD_DynProp_Obj_10_RL 8;
BA_ "GenSigSendType" SG_ 854 ARC_OD_Length_Obj_10_RL 8;
BA_ "GenSigSendType" SG_ 854 ARC_OD_MaintenanceState_Obj_0071 8;
BA_ "GenSigSendType" SG_ 854 ARC_OD_Width_Obj_10_RL 8;
BA_ "GenSigSendType" SG_ 854 ARC_OD_RCS_Obj_10_RL 8;
BA_ "GenSigSendType" SG_ 854 ARC_OD_Orientation_Obj_10_RL 8;
BA_ "GenSigSendType" SG_ 854 ARC_OD_LifeCycle_Obj_10_RL 8;
BA_ "GenSigSendType" SG_ 854 ARC_OD_DistX_Obj_11_RL 8;
BA_ "GenSigSendType" SG_ 854 ARC_OD_VabsX_Obj_11_RL 8;
BA_ "GenSigSendType" SG_ 854 ARC_OD_AabsX_Obj_11_RL 8;
BA_ "GenSigSendType" SG_ 854 ARC_OD_AabsX_Obj_10_RL 8;
BA_ "GenSigSendType" SG_ 854 ARC_OD_DistY_Obj_11_RL 8;
BA_ "GenSigSendType" SG_ 854 ARC_OD_VabsY_Obj_11_RL 8;
BA_ "GenSigSendType" SG_ 854 ARC_OD_AabsY_Obj_11_RL 8;
BA_ "GenSigSendType" SG_ 854 ARC_OD_DistXStd_Obj_11_RL 8;
BA_ "GenSigSendType" SG_ 854 ARC_OD_DistYStd_Obj_11_RL 8;
BA_ "GenSigSendType" SG_ 854 ARC_OD_VabsXStd_Obj_11_RL 8;
BA_ "GenSigSendType" SG_ 854 ARC_OD_VabsYStd_Obj_11_RL 8;
BA_ "GenSigSendType" SG_ 854 ARC_OD_AabsXStd_Obj_11_RL 8;
BA_ "GenSigSendType" SG_ 854 ARC_OD_Classification_Obj_11_RL 8;
BA_ "GenSigSendType" SG_ 854 ARC_OD_AabsYStd_Obj_11_RL 8;
BA_ "GenSigSendType" SG_ 854 ARC_OD_ClassConf_Obj_11_RL 8;
BA_ "GenSigSendType" SG_ 854 ARC_OD_DistY_Obj_10_RL 8;
BA_ "GenSigSendType" SG_ 854 ARC_OD_ProbOfExist_Obj_11_RL 8;
BA_ "GenSigSendType" SG_ 854 ARC_OD_DynProp_Obj_11_RL 8;
BA_ "GenSigSendType" SG_ 854 ARC_OD_Length_Obj_11_RL 8;
BA_ "GenSigSendType" SG_ 854 ARC_OD_MaintenanceState_Obj_0072 8;
BA_ "GenSigSendType" SG_ 854 ARC_OD_Width_Obj_11_RL 8;
BA_ "GenSigSendType" SG_ 854 ARC_OD_RCS_Obj_11_RL 8;
BA_ "GenSigSendType" SG_ 854 ARC_OD_Orientation_Obj_11_RL 8;
BA_ "GenSigSendType" SG_ 854 ARC_OD_LifeCycle_Obj_11_RL 8;
BA_ "GenSigSendType" SG_ 854 ARC_OD_ObstacleProb_Obj_10_RL 8;
BA_ "GenSigSendType" SG_ 854 ARC_OD_ObstacleProb_Obj_11_RL 8;
BA_ "GenSigSendType" SG_ 854 ARC_OD_VabsY_Obj_10_RL 8;
BA_ "GenSigSendType" SG_ 854 ARC_OD_ID_10_RL 8;
BA_ "GenSigSendType" SG_ 854 ARC_OD_ID_11_RL 8;
BA_ "GenSigSendType" SG_ 854 ARC_OD_MsgCounter_Obj_10_11_RL 8;
BA_ "GenSigSendType" SG_ 854 ARC_OD_CRC8_Obj_10_11_RL 8;
BA_ "GenSigSendType" SG_ 854 ARC_OD_AabsY_Obj_10_RL 8;
BA_ "GenSigSendType" SG_ 854 ARC_OD_DistXStd_Obj_10_RL 8;
BA_ "GenSigSendType" SG_ 854 ARC_OD_DistYStd_Obj_10_RL 8;
BA_ "GenSigSendType" SG_ 854 ARC_OD_VabsXStd_Obj_10_RL 8;
BA_ "GenSigSendType" SG_ 854 ARC_OD_VabsYStd_Obj_10_RL 8;
BA_ "GenSigSendType" SG_ 854 ARC_OD_AabsXStd_Obj_10_RL 8;
BA_ "GenSigSendType" SG_ 855 DistHeight_Obj_13_RL 8;
BA_ "GenSigSendType" SG_ 855 DistHeight_Obj_12_RL 8;
BA_ "GenSigSendType" SG_ 855 ARC_OD_DistX_Obj_12_RL 8;
BA_ "GenSigSendType" SG_ 855 ARC_OD_Classification_Obj_12_RL 8;
BA_ "GenSigSendType" SG_ 855 ARC_OD_AabsYStd_Obj_12_RL 8;
BA_ "GenSigSendType" SG_ 855 ARC_OD_ClassConf_Obj_12_RL 8;
BA_ "GenSigSendType" SG_ 855 ARC_OD_ProbOfExist_Obj_12_RL 8;
BA_ "GenSigSendType" SG_ 855 ARC_OD_VabsX_Obj_12_RL 8;
BA_ "GenSigSendType" SG_ 855 ARC_OD_DynProp_Obj_12_RL 8;
BA_ "GenSigSendType" SG_ 855 ARC_OD_Length_Obj_12_RL 8;
BA_ "GenSigSendType" SG_ 855 ARC_OD_MaintenanceState_Obj_0073 8;
BA_ "GenSigSendType" SG_ 855 ARC_OD_Width_Obj_12_RL 8;
BA_ "GenSigSendType" SG_ 855 ARC_OD_RCS_Obj_12_RL 8;
BA_ "GenSigSendType" SG_ 855 ARC_OD_Orientation_Obj_12_RL 8;
BA_ "GenSigSendType" SG_ 855 ARC_OD_LifeCycle_Obj_12_RL 8;
BA_ "GenSigSendType" SG_ 855 ARC_OD_DistX_Obj_13_RL 8;
BA_ "GenSigSendType" SG_ 855 ARC_OD_VabsX_Obj_13_RL 8;
BA_ "GenSigSendType" SG_ 855 ARC_OD_AabsX_Obj_13_RL 8;
BA_ "GenSigSendType" SG_ 855 ARC_OD_AabsX_Obj_12_RL 8;
BA_ "GenSigSendType" SG_ 855 ARC_OD_DistY_Obj_13_RL 8;
BA_ "GenSigSendType" SG_ 855 ARC_OD_VabsY_Obj_13_RL 8;
BA_ "GenSigSendType" SG_ 855 ARC_OD_AabsY_Obj_13_RL 8;
BA_ "GenSigSendType" SG_ 855 ARC_OD_DistXStd_Obj_13_RL 8;
BA_ "GenSigSendType" SG_ 855 ARC_OD_DistYStd_Obj_13_RL 8;
BA_ "GenSigSendType" SG_ 855 ARC_OD_VabsXStd_Obj_13_RL 8;
BA_ "GenSigSendType" SG_ 855 ARC_OD_VabsYStd_Obj_13_RL 8;
BA_ "GenSigSendType" SG_ 855 ARC_OD_AabsXStd_Obj_13_RL 8;
BA_ "GenSigSendType" SG_ 855 ARC_OD_Classification_Obj_13_RL 8;
BA_ "GenSigSendType" SG_ 855 ARC_OD_AabsYStd_Obj_13_RL 8;
BA_ "GenSigSendType" SG_ 855 ARC_OD_ClassConf_Obj_13_RL 8;
BA_ "GenSigSendType" SG_ 855 ARC_OD_DistY_Obj_12_RL 8;
BA_ "GenSigSendType" SG_ 855 ARC_OD_ProbOfExist_Obj_13_RL 8;
BA_ "GenSigSendType" SG_ 855 ARC_OD_DynProp_Obj_13_RL 8;
BA_ "GenSigSendType" SG_ 855 ARC_OD_Length_Obj_13_RL 8;
BA_ "GenSigSendType" SG_ 855 ARC_OD_MaintenanceState_Obj_0074 8;
BA_ "GenSigSendType" SG_ 855 ARC_OD_Width_Obj_13_RL 8;
BA_ "GenSigSendType" SG_ 855 ARC_OD_RCS_Obj_13_RL 8;
BA_ "GenSigSendType" SG_ 855 ARC_OD_Orientation_Obj_13_RL 8;
BA_ "GenSigSendType" SG_ 855 ARC_OD_LifeCycle_Obj_13_RL 8;
BA_ "GenSigSendType" SG_ 855 ARC_OD_ObstacleProb_Obj_12_RL 8;
BA_ "GenSigSendType" SG_ 855 ARC_OD_ObstacleProb_Obj_13_RL 8;
BA_ "GenSigSendType" SG_ 855 ARC_OD_VabsY_Obj_12_RL 8;
BA_ "GenSigSendType" SG_ 855 ARC_OD_ID_12_RL 8;
BA_ "GenSigSendType" SG_ 855 ARC_OD_ID_13_RL 8;
BA_ "GenSigSendType" SG_ 855 ARC_OD_MsgCounter_Obj_12_13_RL 8;
BA_ "GenSigSendType" SG_ 855 ARC_OD_CRC8_Obj_12_13_RL 8;
BA_ "GenSigSendType" SG_ 855 ARC_OD_AabsY_Obj_12_RL 8;
BA_ "GenSigSendType" SG_ 855 ARC_OD_DistXStd_Obj_12_RL 8;
BA_ "GenSigSendType" SG_ 855 ARC_OD_DistYStd_Obj_12_RL 8;
BA_ "GenSigSendType" SG_ 855 ARC_OD_VabsXStd_Obj_12_RL 8;
BA_ "GenSigSendType" SG_ 855 ARC_OD_VabsYStd_Obj_12_RL 8;
BA_ "GenSigSendType" SG_ 855 ARC_OD_AabsXStd_Obj_12_RL 8;
VAL_ 1121 ARC_OD_Classification_Obj_32_RR 0 "Unknow" 1 "Person" 2 "Bimo" 3 "Car" 4 "Truck" 5 "Barrier" 6 "Reserved" 7 "Reserved";
VAL_ 1121 ARC_OD_DynProp_Obj_32_RR 0 "MOVING" 1 "STATIONARY" 2 "ONCOMING" 3 "CROSSING_LEFT2RIGHT" 4 "CROSSING_RIGHT2LEFT" 5 "UNKNOWN" 6 "STOPPED" 7 "RESERVED";
VAL_ 1121 ARC_OD_MaintenanceState_Obj_32_R 0 "INVALID" 1 "NEW" 2 "MEASURED" 3 "PREDICTED";
VAL_ 1121 ARC_OD_Classification_Obj_33_RR 0 "Unknow" 1 "Person" 2 "Bimo" 3 "Car" 4 "Truck" 5 "Barrier" 6 "Reserved" 7 "Reserved";
VAL_ 1121 ARC_OD_DynProp_Obj_33_RR 0 "STATIONAR" 1 "MOVIN" 2 "ONCOMING" 3 "STOPPE" 4 "CROSSING_LEFT2RIGH" 5 "CROSSING_RIGHT2LEF" 6 "RESERVE" 7 "RESERVED";
VAL_ 1121 ARC_OD_MaintenanceState_Obj_33_R 0 "INVALID" 1 "NEW" 2 "MEASURED" 3 "PREDICTED";
VAL_ 1120 ARC_OD_Classification_Obj_30_RR 0 "Unknow" 1 "Person" 2 "Bimo" 3 "Car" 4 "Truck" 5 "Barrier" 6 "Reserved" 7 "Reserved";
VAL_ 1120 ARC_OD_DynProp_Obj_30_RR 0 "MOVING" 1 "STATIONARY" 2 "ONCOMING" 3 "CROSSING_LEFT2RIGHT" 4 "CROSSING_RIGHT2LEFT" 5 "UNKNOWN" 6 "STOPPED" 7 "RESERVED";
VAL_ 1120 ARC_OD_MaintenanceState_Obj_30_R 0 "INVALID" 1 "NEW" 2 "MEASURED" 3 "PREDICTED";
VAL_ 1120 ARC_OD_Classification_Obj_31_RR 0 "Unknow" 1 "Person" 2 "Bimo" 3 "Car" 4 "Truck" 5 "Barrier" 6 "Reserved" 7 "Reserved";
VAL_ 1120 ARC_OD_DynProp_Obj_31_RR 0 "STATIONAR" 1 "MOVIN" 2 "ONCOMING" 3 "STOPPE" 4 "CROSSING_LEFT2RIGH" 5 "CROSSING_RIGHT2LEF" 6 "RESERVE" 7 "RESERVED";
VAL_ 1120 ARC_OD_MaintenanceState_Obj_31_R 0 "INVALID" 1 "NEW" 2 "MEASURED" 3 "PREDICTED";
VAL_ 1119 ARC_OD_Classification_Obj_28_RR 0 "Unknow" 1 "Person" 2 "Bimo" 3 "Car" 4 "Truck" 5 "Barrier" 6 "Reserved" 7 "Reserved";
VAL_ 1119 ARC_OD_DynProp_Obj_28_RR 0 "MOVING" 1 "STATIONARY" 2 "ONCOMING" 3 "CROSSING_LEFT2RIGHT" 4 "CROSSING_RIGHT2LEFT" 5 "UNKNOWN" 6 "STOPPED" 7 "RESERVED";
VAL_ 1119 ARC_OD_MaintenanceState_Obj_28_R 0 "INVALID" 1 "NEW" 2 "MEASURED" 3 "PREDICTED";
VAL_ 1119 ARC_OD_Classification_Obj_29_RR 0 "Unknow" 1 "Person" 2 "Bimo" 3 "Car" 4 "Truck" 5 "Barrier" 6 "Reserved" 7 "Reserved";
VAL_ 1119 ARC_OD_DynProp_Obj_29_RR 0 "STATIONAR" 1 "MOVIN" 2 "ONCOMING" 3 "STOPPE" 4 "CROSSING_LEFT2RIGH" 5 "CROSSING_RIGHT2LEF" 6 "RESERVE" 7 "RESERVED";
VAL_ 1119 ARC_OD_MaintenanceState_Obj_29_R 0 "INVALID" 1 "NEW" 2 "MEASURED" 3 "PREDICTED";
VAL_ 1118 ARC_OD_Classification_Obj_26_RR 0 "Unknow" 1 "Person" 2 "Bimo" 3 "Car" 4 "Truck" 5 "Barrier" 6 "Reserved" 7 "Reserved";
VAL_ 1118 ARC_OD_DynProp_Obj_26_RR 0 "MOVING" 1 "STATIONARY" 2 "ONCOMING" 3 "CROSSING_LEFT2RIGHT" 4 "CROSSING_RIGHT2LEFT" 5 "UNKNOWN" 6 "STOPPED" 7 "RESERVED";
VAL_ 1118 ARC_OD_MaintenanceState_Obj_26_R 0 "INVALID" 1 "NEW" 2 "MEASURED" 3 "PREDICTED";
VAL_ 1118 ARC_OD_Classification_Obj_27_RR 0 "Unknow" 1 "Person" 2 "Bimo" 3 "Car" 4 "Truck" 5 "Barrier" 6 "Reserved" 7 "Reserved";
VAL_ 1118 ARC_OD_DynProp_Obj_27_RR 0 "STATIONAR" 1 "MOVIN" 2 "ONCOMING" 3 "STOPPE" 4 "CROSSING_LEFT2RIGH" 5 "CROSSING_RIGHT2LEF" 6 "RESERVE" 7 "RESERVED";
VAL_ 1118 ARC_OD_MaintenanceState_Obj_27_R 0 "INVALID" 1 "NEW" 2 "MEASURED" 3 "PREDICTED";
VAL_ 1117 ARC_OD_Classification_Obj_24_RR 0 "Unknow" 1 "Person" 2 "Bimo" 3 "Car" 4 "Truck" 5 "Barrier" 6 "Reserved" 7 "Reserved";
VAL_ 1117 ARC_OD_DynProp_Obj_24_RR 0 "MOVING" 1 "STATIONARY" 2 "ONCOMING" 3 "CROSSING_LEFT2RIGHT" 4 "CROSSING_RIGHT2LEFT" 5 "UNKNOWN" 6 "STOPPED" 7 "RESERVED";
VAL_ 1117 ARC_OD_MaintenanceState_Obj_24_R 0 "INVALID" 1 "NEW" 2 "MEASURED" 3 "PREDICTED";
VAL_ 1117 ARC_OD_Classification_Obj_25_RR 0 "Unknow" 1 "Person" 2 "Bimo" 3 "Car" 4 "Truck" 5 "Barrier" 6 "Reserved" 7 "Reserved";
VAL_ 1117 ARC_OD_DynProp_Obj_25_RR 0 "STATIONAR" 1 "MOVIN" 2 "ONCOMING" 3 "STOPPE" 4 "CROSSING_LEFT2RIGH" 5 "CROSSING_RIGHT2LEF" 6 "RESERVE" 7 "RESERVED";
VAL_ 1117 ARC_OD_MaintenanceState_Obj_25_R 0 "INVALID" 1 "NEW" 2 "MEASURED" 3 "PREDICTED";
VAL_ 1116 ARC_OD_Classification_Obj_22_RR 0 "Unknow" 1 "Person" 2 "Bimo" 3 "Car" 4 "Truck" 5 "Barrier" 6 "Reserved" 7 "Reserved";
VAL_ 1116 ARC_OD_DynProp_Obj_22_RR 0 "MOVING" 1 "STATIONARY" 2 "ONCOMING" 3 "CROSSING_LEFT2RIGHT" 4 "CROSSING_RIGHT2LEFT" 5 "UNKNOWN" 6 "STOPPED" 7 "RESERVED";
VAL_ 1116 ARC_OD_MaintenanceState_Obj_22_R 0 "INVALID" 1 "NEW" 2 "MEASURED" 3 "PREDICTED";
VAL_ 1116 ARC_OD_Classification_Obj_23_RR 0 "Unknow" 1 "Person" 2 "Bimo" 3 "Car" 4 "Truck" 5 "Barrier" 6 "Reserved" 7 "Reserved";
VAL_ 1116 ARC_OD_DynProp_Obj_23_RR 0 "STATIONAR" 1 "MOVIN" 2 "ONCOMING" 3 "STOPPE" 4 "CROSSING_LEFT2RIGH" 5 "CROSSING_RIGHT2LEF" 6 "RESERVE" 7 "RESERVED";
VAL_ 1116 ARC_OD_MaintenanceState_Obj_23_R 0 "INVALID" 1 "NEW" 2 "MEASURED" 3 "PREDICTED";
VAL_ 1115 ARC_OD_Classification_Obj_20_RR 0 "Unknow" 1 "Person" 2 "Bimo" 3 "Car" 4 "Truck" 5 "Barrier" 6 "Reserved" 7 "Reserved";
VAL_ 1115 ARC_OD_DynProp_Obj_20_RR 0 "MOVING" 1 "STATIONARY" 2 "ONCOMING" 3 "CROSSING_LEFT2RIGHT" 4 "CROSSING_RIGHT2LEFT" 5 "UNKNOWN" 6 "STOPPED" 7 "RESERVED";
VAL_ 1115 ARC_OD_MaintenanceState_Obj_20_R 0 "INVALID" 1 "NEW" 2 "MEASURED" 3 "PREDICTED";
VAL_ 1115 ARC_OD_Classification_Obj_21_RR 0 "Unknow" 1 "Person" 2 "Bimo" 3 "Car" 4 "Truck" 5 "Barrier" 6 "Reserved" 7 "Reserved";
VAL_ 1115 ARC_OD_DynProp_Obj_21_RR 0 "STATIONAR" 1 "MOVIN" 2 "ONCOMING" 3 "STOPPE" 4 "CROSSING_LEFT2RIGH" 5 "CROSSING_RIGHT2LEF" 6 "RESERVE" 7 "RESERVED";
VAL_ 1115 ARC_OD_MaintenanceState_Obj_21_R 0 "INVALID" 1 "NEW" 2 "MEASURED" 3 "PREDICTED";
VAL_ 1114 ARC_OD_Classification_Obj_18_RR 0 "Unknow" 1 "Person" 2 "Bimo" 3 "Car" 4 "Truck" 5 "Barrier" 6 "Reserved" 7 "Reserved";
VAL_ 1114 ARC_OD_DynProp_Obj_18_RR 0 "MOVING" 1 "STATIONARY" 2 "ONCOMING" 3 "CROSSING_LEFT2RIGHT" 4 "CROSSING_RIGHT2LEFT" 5 "UNKNOWN" 6 "STOPPED" 7 "RESERVED";
VAL_ 1114 ARC_OD_MaintenanceState_Obj_18_R 0 "INVALID" 1 "NEW" 2 "MEASURED" 3 "PREDICTED";
VAL_ 1114 ARC_OD_Classification_Obj_19_RR 0 "Unknow" 1 "Person" 2 "Bimo" 3 "Car" 4 "Truck" 5 "Barrier" 6 "Reserved" 7 "Reserved";
VAL_ 1114 ARC_OD_DynProp_Obj_19_RR 0 "STATIONAR" 1 "MOVIN" 2 "ONCOMING" 3 "STOPPE" 4 "CROSSING_LEFT2RIGH" 5 "CROSSING_RIGHT2LEF" 6 "RESERVE" 7 "RESERVED";
VAL_ 1114 ARC_OD_MaintenanceState_Obj_19_R 0 "INVALID" 1 "NEW" 2 "MEASURED" 3 "PREDICTED";
VAL_ 1113 ARC_OD_Classification_Obj_16_RR 0 "Unknow" 1 "Person" 2 "Bimo" 3 "Car" 4 "Truck" 5 "Barrier" 6 "Reserved" 7 "Reserved";
VAL_ 1113 ARC_OD_DynProp_Obj_16_RR 0 "MOVING" 1 "STATIONARY" 2 "ONCOMING" 3 "CROSSING_LEFT2RIGHT" 4 "CROSSING_RIGHT2LEFT" 5 "UNKNOWN" 6 "STOPPED" 7 "RESERVED";
VAL_ 1113 ARC_OD_MaintenanceState_Obj_16_R 0 "INVALID" 1 "NEW" 2 "MEASURED" 3 "PREDICTED";
VAL_ 1113 ARC_OD_Classification_Obj_17_RR 0 "Unknow" 1 "Person" 2 "Bimo" 3 "Car" 4 "Truck" 5 "Barrier" 6 "Reserved" 7 "Reserved";
VAL_ 1113 ARC_OD_DynProp_Obj_17_RR 0 "STATIONAR" 1 "MOVIN" 2 "ONCOMING" 3 "STOPPE" 4 "CROSSING_LEFT2RIGH" 5 "CROSSING_RIGHT2LEF" 6 "RESERVE" 7 "RESERVED";
VAL_ 1113 ARC_OD_MaintenanceState_Obj_17_R 0 "INVALID" 1 "NEW" 2 "MEASURED" 3 "PREDICTED";
VAL_ 1112 ARC_OD_Classification_Obj_14_RR 0 "Unknow" 1 "Person" 2 "Bimo" 3 "Car" 4 "Truck" 5 "Barrier" 6 "Reserved" 7 "Reserved";
VAL_ 1112 ARC_OD_DynProp_Obj_14_RR 0 "MOVING" 1 "STATIONARY" 2 "ONCOMING" 3 "CROSSING_LEFT2RIGHT" 4 "CROSSING_RIGHT2LEFT" 5 "UNKNOWN" 6 "STOPPED" 7 "RESERVED";
VAL_ 1112 ARC_OD_MaintenanceState_Obj_14_R 0 "INVALID" 1 "NEW" 2 "MEASURED" 3 "PREDICTED";
VAL_ 1112 ARC_OD_Classification_Obj_15_RR 0 "Unknow" 1 "Person" 2 "Bimo" 3 "Car" 4 "Truck" 5 "Barrier" 6 "Reserved" 7 "Reserved";
VAL_ 1112 ARC_OD_DynProp_Obj_15_RR 0 "STATIONAR" 1 "MOVIN" 2 "ONCOMING" 3 "STOPPE" 4 "CROSSING_LEFT2RIGH" 5 "CROSSING_RIGHT2LEF" 6 "RESERVE" 7 "RESERVED";
VAL_ 1112 ARC_OD_MaintenanceState_Obj_15_R 0 "INVALID" 1 "NEW" 2 "MEASURED" 3 "PREDICTED";
VAL_ 1111 ARC_OD_Classification_Obj_12_RR 0 "Unknow" 1 "Person" 2 "Bimo" 3 "Car" 4 "Truck" 5 "Barrier" 6 "Reserved" 7 "Reserved";
VAL_ 1111 ARC_OD_DynProp_Obj_12_RR 0 "MOVING" 1 "STATIONARY" 2 "ONCOMING" 3 "CROSSING_LEFT2RIGHT" 4 "CROSSING_RIGHT2LEFT" 5 "UNKNOWN" 6 "STOPPED" 7 "RESERVED";
VAL_ 1111 ARC_OD_MaintenanceState_Obj_12_R 0 "INVALID" 1 "NEW" 2 "MEASURED" 3 "PREDICTED";
VAL_ 1111 ARC_OD_Classification_Obj_13_RR 0 "Unknow" 1 "Person" 2 "Bimo" 3 "Car" 4 "Truck" 5 "Barrier" 6 "Reserved" 7 "Reserved";
VAL_ 1111 ARC_OD_DynProp_Obj_13_RR 0 "STATIONAR" 1 "MOVIN" 2 "ONCOMING" 3 "STOPPE" 4 "CROSSING_LEFT2RIGH" 5 "CROSSING_RIGHT2LEF" 6 "RESERVE" 7 "RESERVED";
VAL_ 1111 ARC_OD_MaintenanceState_Obj_13_R 0 "INVALID" 1 "NEW" 2 "MEASURED" 3 "PREDICTED";
VAL_ 1110 ARC_OD_Classification_Obj_10_RR 0 "Unknow" 1 "Person" 2 "Bimo" 3 "Car" 4 "Truck" 5 "Barrier" 6 "Reserved" 7 "Reserved";
VAL_ 1110 ARC_OD_DynProp_Obj_10_RR 0 "MOVING" 1 "STATIONARY" 2 "ONCOMING" 3 "CROSSING_LEFT2RIGHT" 4 "CROSSING_RIGHT2LEFT" 5 "UNKNOWN" 6 "STOPPED" 7 "RESERVED";
VAL_ 1110 ARC_OD_MaintenanceState_Obj_10_R 0 "INVALID" 1 "NEW" 2 "MEASURED" 3 "PREDICTED";
VAL_ 1110 ARC_OD_Classification_Obj_11_RR 0 "Unknow" 1 "Person" 2 "Bimo" 3 "Car" 4 "Truck" 5 "Barrier" 6 "Reserved" 7 "Reserved";
VAL_ 1110 ARC_OD_DynProp_Obj_11_RR 0 "STATIONAR" 1 "MOVIN" 2 "ONCOMING" 3 "STOPPE" 4 "CROSSING_LEFT2RIGH" 5 "CROSSING_RIGHT2LEF" 6 "RESERVE" 7 "RESERVED";
VAL_ 1110 ARC_OD_MaintenanceState_Obj_11_R 0 "INVALID" 1 "NEW" 2 "MEASURED" 3 "PREDICTED";
VAL_ 1109 ARC_OD_Classification_Obj_08_RR 0 "Unknow" 1 "Person" 2 "Bimo" 3 "Car" 4 "Truck" 5 "Barrier" 6 "Reserved" 7 "Reserved";
VAL_ 1109 ARC_OD_DynProp_Obj_08_RR 0 "MOVING" 1 "STATIONARY" 2 "ONCOMING" 3 "CROSSING_LEFT2RIGHT" 4 "CROSSING_RIGHT2LEFT" 5 "UNKNOWN" 6 "STOPPED" 7 "RESERVED";
VAL_ 1109 ARC_OD_MaintenanceState_Obj_08_R 0 "INVALID" 1 "NEW" 2 "MEASURED" 3 "PREDICTED";
VAL_ 1109 ARC_OD_Classification_Obj_09_RR 0 "Unknow" 1 "Person" 2 "Bimo" 3 "Car" 4 "Truck" 5 "Barrier" 6 "Reserved" 7 "Reserved";
VAL_ 1109 ARC_OD_DynProp_Obj_09_RR 0 "STATIONAR" 1 "MOVIN" 2 "ONCOMING" 3 "STOPPE" 4 "CROSSING_LEFT2RIGH" 5 "CROSSING_RIGHT2LEF" 6 "RESERVE" 7 "RESERVED";
VAL_ 1109 ARC_OD_MaintenanceState_Obj_09_R 0 "INVALID" 1 "NEW" 2 "MEASURED" 3 "PREDICTED";
VAL_ 1108 ARC_OD_Classification_Obj_06_RR 0 "Unknow" 1 "Person" 2 "Bimo" 3 "Car" 4 "Truck" 5 "Barrier" 6 "Reserved" 7 "Reserved";
VAL_ 1108 ARC_OD_DynProp_Obj_06_RR 0 "MOVING" 1 "STATIONARY" 2 "ONCOMING" 3 "CROSSING_LEFT2RIGHT" 4 "CROSSING_RIGHT2LEFT" 5 "UNKNOWN" 6 "STOPPED" 7 "RESERVED";
VAL_ 1108 ARC_OD_MaintenanceState_Obj_06_R 0 "INVALID" 1 "NEW" 2 "MEASURED" 3 "PREDICTED";
VAL_ 1108 ARC_OD_Classification_Obj_07_RR 0 "Unknow" 1 "Person" 2 "Bimo" 3 "Car" 4 "Truck" 5 "Barrier" 6 "Reserved" 7 "Reserved";
VAL_ 1108 ARC_OD_DynProp_Obj_07_RR 0 "STATIONAR" 1 "MOVIN" 2 "ONCOMING" 3 "STOPPE" 4 "CROSSING_LEFT2RIGH" 5 "CROSSING_RIGHT2LEF" 6 "RESERVE" 7 "RESERVED";
VAL_ 1108 ARC_OD_MaintenanceState_Obj_07_R 0 "INVALID" 1 "NEW" 2 "MEASURED" 3 "PREDICTED";
VAL_ 1107 ARC_OD_Classification_Obj_04_RR 0 "Unknow" 1 "Person" 2 "Bimo" 3 "Car" 4 "Truck" 5 "Barrier" 6 "Reserved" 7 "Reserved";
VAL_ 1107 ARC_OD_DynProp_Obj_04_RR 0 "MOVING" 1 "STATIONARY" 2 "ONCOMING" 3 "CROSSING_LEFT2RIGHT" 4 "CROSSING_RIGHT2LEFT" 5 "UNKNOWN" 6 "STOPPED" 7 "RESERVED";
VAL_ 1107 ARC_OD_MaintenanceState_Obj_04_R 0 "INVALID" 1 "NEW" 2 "MEASURED" 3 "PREDICTED";
VAL_ 1107 ARC_OD_Classification_Obj_05_RR 0 "Unknow" 1 "Person" 2 "Bimo" 3 "Car" 4 "Truck" 5 "Barrier" 6 "Reserved" 7 "Reserved";
VAL_ 1107 ARC_OD_DynProp_Obj_05_RR 0 "STATIONAR" 1 "MOVIN" 2 "ONCOMING" 3 "STOPPE" 4 "CROSSING_LEFT2RIGH" 5 "CROSSING_RIGHT2LEF" 6 "RESERVE" 7 "RESERVED";
VAL_ 1107 ARC_OD_MaintenanceState_Obj_05_R 0 "INVALID" 1 "NEW" 2 "MEASURED" 3 "PREDICTED";
VAL_ 1106 ARC_OD_Classification_Obj_02_RR 0 "Unknow" 1 "Person" 2 "Bimo" 3 "Car" 4 "Truck" 5 "Barrier" 6 "Reserved" 7 "Reserved";
VAL_ 1106 ARC_OD_DynProp_Obj_02_RR 0 "MOVING" 1 "STATIONARY" 2 "ONCOMING" 3 "CROSSING_LEFT2RIGHT" 4 "CROSSING_RIGHT2LEFT" 5 "UNKNOWN" 6 "STOPPED" 7 "RESERVED";
VAL_ 1106 ARC_OD_MaintenanceState_Obj_02_R 0 "INVALID" 1 "NEW" 2 "MEASURED" 3 "PREDICTED";
VAL_ 1106 ARC_OD_Classification_Obj_03_RR 0 "Unknow" 1 "Person" 2 "Bimo" 3 "Car" 4 "Truck" 5 "Barrier" 6 "Reserved" 7 "Reserved";
VAL_ 1106 ARC_OD_DynProp_Obj_03_RR 0 "STATIONAR" 1 "MOVIN" 2 "ONCOMING" 3 "STOPPE" 4 "CROSSING_LEFT2RIGH" 5 "CROSSING_RIGHT2LEF" 6 "RESERVE" 7 "RESERVED";
VAL_ 1106 ARC_OD_MaintenanceState_Obj_03_R 0 "INVALID" 1 "NEW" 2 "MEASURED" 3 "PREDICTED";
VAL_ 1105 ARC_OD_Classification_Obj_00_RR 0 "Unknow" 1 "Person" 2 "Bimo" 3 "Car" 4 "Truck" 5 "Barrier" 6 "Reserved" 7 "Reserved";
VAL_ 1105 ARC_OD_DynProp_Obj_00_RR 0 "MOVING" 1 "STATIONARY" 2 "ONCOMING" 3 "CROSSING_LEFT2RIGHT" 4 "CROSSING_RIGHT2LEFT" 5 "UNKNOWN" 6 "STOPPED" 7 "RESERVED";
VAL_ 1105 ARC_OD_MaintenanceState_Obj_00_R 0 "INVALID" 1 "NEW" 2 "MEASURED" 3 "PREDICTED";
VAL_ 1105 ARC_OD_Classification_Obj_01_RR 0 "Unknow" 1 "Person" 2 "Bimo" 3 "Car" 4 "Truck" 5 "Barrier" 6 "Reserved" 7 "Reserved";
VAL_ 1105 ARC_OD_DynProp_Obj_01_RR 0 "STATIONAR" 1 "MOVIN" 2 "ONCOMING" 3 "STOPPE" 4 "CROSSING_LEFT2RIGH" 5 "CROSSING_RIGHT2LEF" 6 "RESERVE" 7 "RESERVED";
VAL_ 1105 ARC_OD_MaintenanceState_Obj_01_R 0 "INVALID" 1 "NEW" 2 "MEASURED" 3 "PREDICTED";
VAL_ 1616 ARC_OD_TaskValidFlag_FL 0 "INVALI" 1 "VALI";
VAL_ 1616 ARC_OD_ExtendedCycleFlag_FL 0 "FALS" 1 "TRU";
VAL_ 1360 ARC_OD_TaskValidFlag_FR 0 "INVALI" 1 "VALI";
VAL_ 1360 ARC_OD_ExtendedCycleFlag_FR 0 "FALS" 1 "TRU";
VAL_ 1104 ARC_OD_TaskValidFlag_RR 0 "INVALI" 1 "VALI";
VAL_ 1104 ARC_OD_ExtendedCycleFlag_RR 0 "FALS" 1 "TRU";
VAL_ 102 ARC_ERROR_STATE_FR 0 "NO ERROR" 1 "ERROR";
VAL_ 102 ARC_CFG_Mode_FR 1 "MODE A" 2 "MODE B" 4 "MODE C" 8 "RESERVE" 16 "RESERVE" 64 "RESERVE" 128 "REAR";
VAL_ 102 ARC_CFG_TmeSynEnFl_FR 0 "DISABLE" 1 "ENABLE";
VAL_ 105 ARC_ERROR_STATE_FL 0 "NO ERROR" 1 "ERROR";
VAL_ 105 ARC_CFG_Mode_FL 1 "MODE A" 2 "MODE B" 4 "MODE C" 8 "RESERVE" 16 "RESERVE" 64 "RESERVE" 128 "REAR";
VAL_ 105 ARC_CFG_TmeSynEnFl_FL 0 "DISABLE" 1 "ENABLE";
VAL_ 99 ARC_ERROR_STATE_RR 0 "NO ERROR" 1 "ERROR";
VAL_ 99 ARC_CFG_Mode_RR 1 "MODE A" 2 "MODE B" 4 "MODE C" 8 "RESERVE" 16 "RESERVE" 64 "RESERVE" 128 "REAR";
VAL_ 99 ARC_CFG_TmeSynEnFl_RR 0 "DISABLE" 1 "ENABLE";
VAL_ 96 ARC_ERROR_STATE_RL 0 "NO ERROR" 1 "ERROR";
VAL_ 96 ARC_CFG_Mode_RL 1 "MODE A" 2 "MODE B" 4 "MODE C" 8 "RESERVE" 16 "RESERVE" 64 "RESERVE" 128 "REAR";
VAL_ 96 ARC_CFG_TmeSynEnFl_RL 0 "DISABLE" 1 "ENABLE";
VAL_ 848 ARC_OD_TaskValidFlag_RL 0 "INVALI" 1 "VALI";
VAL_ 848 ARC_OD_ExtendedCycleFlag_RL 0 "FALS" 1 "TRU";
VAL_ 849 ARC_OD_Classification_Obj_00_RL 0 "Unknow" 1 "Person" 2 "Bimo" 3 "Car" 4 "Truck" 5 "Barrier" 6 "Reserved" 7 "Reserved";
VAL_ 849 ARC_OD_DynProp_Obj_00_RL 0 "MOVING" 1 "STATIONARY" 2 "ONCOMING" 3 "CROSSING_LEFT2RIGHT" 4 "CROSSING_RIGHT2LEFT" 5 "UNKNOWN" 6 "STOPPED" 7 "RESERVED";
VAL_ 849 ARC_OD_MaintenanceState_Obj_0061 0 "INVALID" 1 "NEW" 2 "MEASURED" 3 "PREDICTED";
VAL_ 849 ARC_OD_Classification_Obj_01_RL 0 "Unknow" 1 "Person" 2 "Bimo" 3 "Car" 4 "Truck" 5 "Barrier" 6 "Reserved" 7 "Reserved";
VAL_ 849 ARC_OD_DynProp_Obj_01_RL 0 "STATIONAR" 1 "MOVIN" 2 "ONCOMING" 3 "STOPPE" 4 "CROSSING_LEFT2RIGH" 5 "CROSSING_RIGHT2LEF" 6 "RESERVE" 7 "RESERVED";
VAL_ 849 ARC_OD_MaintenanceState_Obj_0062 0 "INVALID" 1 "NEW" 2 "MEASURED" 3 "PREDICTED";
VAL_ 850 ARC_OD_Classification_Obj_02_RL 0 "Unknow" 1 "Person" 2 "Bimo" 3 "Car" 4 "Truck" 5 "Barrier" 6 "Reserved" 7 "Reserved";
VAL_ 850 ARC_OD_DynProp_Obj_02_RL 0 "MOVING" 1 "STATIONARY" 2 "ONCOMING" 3 "CROSSING_LEFT2RIGHT" 4 "CROSSING_RIGHT2LEFT" 5 "UNKNOWN" 6 "STOPPED" 7 "RESERVED";
VAL_ 850 ARC_OD_MaintenanceState_Obj_0063 0 "INVALID" 1 "NEW" 2 "MEASURED" 3 "PREDICTED";
VAL_ 850 ARC_OD_Classification_Obj_03_RL 0 "Unknow" 1 "Person" 2 "Bimo" 3 "Car" 4 "Truck" 5 "Barrier" 6 "Reserved" 7 "Reserved";
VAL_ 850 ARC_OD_DynProp_Obj_03_RL 0 "STATIONAR" 1 "MOVIN" 2 "ONCOMING" 3 "STOPPE" 4 "CROSSING_LEFT2RIGH" 5 "CROSSING_RIGHT2LEF" 6 "RESERVE" 7 "RESERVED";
VAL_ 850 ARC_OD_MaintenanceState_Obj_0064 0 "INVALID" 1 "NEW" 2 "MEASURED" 3 "PREDICTED";
VAL_ 851 ARC_OD_Classification_Obj_04_RL 0 "Unknow" 1 "Person" 2 "Bimo" 3 "Car" 4 "Truck" 5 "Barrier" 6 "Reserved" 7 "Reserved";
VAL_ 851 ARC_OD_DynProp_Obj_04_RL 0 "MOVING" 1 "STATIONARY" 2 "ONCOMING" 3 "CROSSING_LEFT2RIGHT" 4 "CROSSING_RIGHT2LEFT" 5 "UNKNOWN" 6 "STOPPED" 7 "RESERVED";
VAL_ 851 ARC_OD_MaintenanceState_Obj_0065 0 "INVALID" 1 "NEW" 2 "MEASURED" 3 "PREDICTED";
VAL_ 851 ARC_OD_Classification_Obj_05_RL 0 "Unknow" 1 "Person" 2 "Bimo" 3 "Car" 4 "Truck" 5 "Barrier" 6 "Reserved" 7 "Reserved";
VAL_ 851 ARC_OD_DynProp_Obj_05_RL 0 "STATIONAR" 1 "MOVIN" 2 "ONCOMING" 3 "STOPPE" 4 "CROSSING_LEFT2RIGH" 5 "CROSSING_RIGHT2LEF" 6 "RESERVE" 7 "RESERVED";
VAL_ 851 ARC_OD_MaintenanceState_Obj_0066 0 "INVALID" 1 "NEW" 2 "MEASURED" 3 "PREDICTED";
VAL_ 852 ARC_OD_Classification_Obj_06_RL 0 "Unknow" 1 "Person" 2 "Bimo" 3 "Car" 4 "Truck" 5 "Barrier" 6 "Reserved" 7 "Reserved";
VAL_ 852 ARC_OD_DynProp_Obj_06_RL 0 "MOVING" 1 "STATIONARY" 2 "ONCOMING" 3 "CROSSING_LEFT2RIGHT" 4 "CROSSING_RIGHT2LEFT" 5 "UNKNOWN" 6 "STOPPED" 7 "RESERVED";
VAL_ 852 ARC_OD_MaintenanceState_Obj_0067 0 "INVALID" 1 "NEW" 2 "MEASURED" 3 "PREDICTED";
VAL_ 852 ARC_OD_Classification_Obj_07_RL 0 "Unknow" 1 "Person" 2 "Bimo" 3 "Car" 4 "Truck" 5 "Barrier" 6 "Reserved" 7 "Reserved";
VAL_ 852 ARC_OD_DynProp_Obj_07_RL 0 "STATIONAR" 1 "MOVIN" 2 "ONCOMING" 3 "STOPPE" 4 "CROSSING_LEFT2RIGH" 5 "CROSSING_RIGHT2LEF" 6 "RESERVE" 7 "RESERVED";
VAL_ 852 ARC_OD_MaintenanceState_Obj_0068 0 "INVALID" 1 "NEW" 2 "MEASURED" 3 "PREDICTED";
VAL_ 853 ARC_OD_Classification_Obj_08_RL 0 "Unknow" 1 "Person" 2 "Bimo" 3 "Car" 4 "Truck" 5 "Barrier" 6 "Reserved" 7 "Reserved";
VAL_ 853 ARC_OD_DynProp_Obj_08_RL 0 "MOVING" 1 "STATIONARY" 2 "ONCOMING" 3 "CROSSING_LEFT2RIGHT" 4 "CROSSING_RIGHT2LEFT" 5 "UNKNOWN" 6 "STOPPED" 7 "RESERVED";
VAL_ 853 ARC_OD_MaintenanceState_Obj_0069 0 "INVALID" 1 "NEW" 2 "MEASURED" 3 "PREDICTED";
VAL_ 853 ARC_OD_Classification_Obj_09_RL 0 "Unknow" 1 "Person" 2 "Bimo" 3 "Car" 4 "Truck" 5 "Barrier" 6 "Reserved" 7 "Reserved";
VAL_ 853 ARC_OD_DynProp_Obj_09_RL 0 "STATIONAR" 1 "MOVIN" 2 "ONCOMING" 3 "STOPPE" 4 "CROSSING_LEFT2RIGH" 5 "CROSSING_RIGHT2LEF" 6 "RESERVE" 7 "RESERVED";
VAL_ 853 ARC_OD_MaintenanceState_Obj_0070 0 "INVALID" 1 "NEW" 2 "MEASURED" 3 "PREDICTED";
VAL_ 854 ARC_OD_Classification_Obj_10_RL 0 "Unknow" 1 "Person" 2 "Bimo" 3 "Car" 4 "Truck" 5 "Barrier" 6 "Reserved" 7 "Reserved";
VAL_ 854 ARC_OD_DynProp_Obj_10_RL 0 "MOVING" 1 "STATIONARY" 2 "ONCOMING" 3 "CROSSING_LEFT2RIGHT" 4 "CROSSING_RIGHT2LEFT" 5 "UNKNOWN" 6 "STOPPED" 7 "RESERVED";
VAL_ 854 ARC_OD_MaintenanceState_Obj_0071 0 "INVALID" 1 "NEW" 2 "MEASURED" 3 "PREDICTED";
VAL_ 854 ARC_OD_Classification_Obj_11_RL 0 "Unknow" 1 "Person" 2 "Bimo" 3 "Car" 4 "Truck" 5 "Barrier" 6 "Reserved" 7 "Reserved";
VAL_ 854 ARC_OD_DynProp_Obj_11_RL 0 "STATIONAR" 1 "MOVIN" 2 "ONCOMING" 3 "STOPPE" 4 "CROSSING_LEFT2RIGH" 5 "CROSSING_RIGHT2LEF" 6 "RESERVE" 7 "RESERVED";
VAL_ 854 ARC_OD_MaintenanceState_Obj_0072 0 "INVALID" 1 "NEW" 2 "MEASURED" 3 "PREDICTED";
VAL_ 855 ARC_OD_Classification_Obj_12_RL 0 "Unknow" 1 "Person" 2 "Bimo" 3 "Car" 4 "Truck" 5 "Barrier" 6 "Reserved" 7 "Reserved";
VAL_ 855 ARC_OD_DynProp_Obj_12_RL 0 "MOVING" 1 "STATIONARY" 2 "ONCOMING" 3 "CROSSING_LEFT2RIGHT" 4 "CROSSING_RIGHT2LEFT" 5 "UNKNOWN" 6 "STOPPED" 7 "RESERVED";
VAL_ 855 ARC_OD_MaintenanceState_Obj_0073 0 "INVALID" 1 "NEW" 2 "MEASURED" 3 "PREDICTED";
VAL_ 855 ARC_OD_Classification_Obj_13_RL 0 "Unknow" 1 "Person" 2 "Bimo" 3 "Car" 4 "Truck" 5 "Barrier" 6 "Reserved" 7 "Reserved";
VAL_ 855 ARC_OD_DynProp_Obj_13_RL 0 "STATIONAR" 1 "MOVIN" 2 "ONCOMING" 3 "STOPPE" 4 "CROSSING_LEFT2RIGH" 5 "CROSSING_RIGHT2LEF" 6 "RESERVE" 7 "RESERVED";
VAL_ 855 ARC_OD_MaintenanceState_Obj_0074 0 "INVALID" 1 "NEW" 2 "MEASURED" 3 "PREDICTED";
