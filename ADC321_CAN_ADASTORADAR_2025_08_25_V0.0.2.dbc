VERSION "created by freetech"

NS_ :

BS_:

BU_: radar ADC

BO_ 1649 ChassisMsg: 64 ADC
 SG_ YawRate : 7|12@0+ (0.0625,-128) [-128|127.875] "deg/s"  radar
 SG_ V_Speed : 23|15@0+ (0.015625,0) [0|511.98] "km/h"  radar
 SG_ ANGLE : 39|16@0+ (0.0625,-2048) [-2048|2047.9375] "deg"  radar
 SG_ STATE : 11|3@0+ (1,0) [0|5] ""  radar
 SG_ egoAccLgt : 55|12@0+ (0.01,-20.47) [-20.47|20.47] "m/s2"  radar
 SG_ egoAccLat : 151|12@0+ (0.01,-20.47) [-20.47|20.47] "m/s2"  radar
 SG_ WhlSpdFL : 71|15@0+ (0.015625,0) [0|511.98] "km/h"  radar
 SG_ WhlSpdRL : 87|15@0+ (0.015625,0) [0|511.98] "km/h"  radar
 SG_ WhlSpdFR : 103|15@0+ (0.015625,0) [0|511.98] "km/h"  radar
 SG_ WhlSpdRR : 119|15@0+ (0.015625,0) [0|511.98] "km/h"  radar
 SG_ StrgWhlAngGrd : 135|12@0+ (1,-2048) [-2048|2047] "deg/s"  radar
 SG_ YawRateV : 59|1@0+ (1,0) [0|1] ""  radar
 SG_ V_SpeedV : 24|1@0+ (1,0) [0|1] ""  radar
 SG_ ANGLE_V : 155|1@0+ (1,0) [0|1] ""  radar
 SG_ STATE_V : 8|1@0+ (1,0) [0|1] ""  radar
 SG_ WhlSpdFLV : 72|1@0+ (1,0) [0|1] ""  radar
 SG_ WhlSpdRLV : 88|1@0+ (1,0) [0|1] ""  radar
 SG_ WhlSpdFRV : 104|1@0+ (1,0) [0|1] ""  radar
 SG_ WhlSpdRRV : 120|1@0+ (1,0) [0|1] ""  radar
 SG_ StrgWhlAngGrdV : 139|1@0+ (1,0) [0|1] ""  radar
 SG_ egoAccLgtV : 153|1@0+ (1,0) [0|1] ""  radar
 SG_ egoAccLatV : 154|1@0+ (1,0) [0|1] ""  radar

BO_ 1650 ADC_TimeSync: 16 ADC
 SG_ Sync_Counter : 19|4@0+ (1,0) [0|15] ""  radar
 SG_ Sync_CRC : 15|8@0+ (1,0) [0|255] ""  radar
 SG_ Sync_OVS : 25|2@0+ (1,0) [0|3] ""  radar
 SG_ Sync_Resd : 31|5@0+ (1,0) [0|31] ""  radar
 SG_ Sync_SGW : 26|1@0+ (1,0) [0|1] ""  radar
 SG_ Sync_SyncTime : 39|32@0+ (1,0) [0|4294967295] ""  radar
 SG_ Sync_TimeDomain : 23|4@0+ (1,0) [0|15] ""  radar
 SG_ Sync_Type : 7|8@0+ (1,0) [0|255] ""  radar

BO_ 1651 BodyInfo: 32 ADC
 SG_ BCM_RLDoorOpenSt : 1|2@0+ (1,0) [0|3] ""  radar
 SG_ BCM_RRDoorOpenSt : 5|2@0+ (1,0) [0|3] ""  radar
 SG_ BCM_FRDoorOpenSt : 7|2@0+ (1,0) [0|3] ""  radar
 SG_ BCM_FLDoorOpenSt : 3|2@0+ (1,0) [0|3] ""  radar
 SG_ Trunk_cover : 8|1@0+ (1,0) [0|1] ""  radar
 SG_ Engine_hood : 9|1@0+ (1,0) [0|1] ""  radar
 SG_ TurnLeft : 12|3@0+ (1,0) [0|4] ""  radar
 SG_ TurnRight : 15|3@0+ (1,0) [0|4] ""  radar
 SG_ TurnSignalLever : 20|3@0+ (1,0) [0|7] ""  radar
 SG_ PowerSupply : 39|3@0+ (1,0) [0|7] ""  radar
 SG_ FuncMode : 23|3@0+ (1,0) [0|7] ""  radar
 SG_ VehUsgMd : 31|3@0+ (1,0) [0|1] ""  radar
 SG_ FrtWprSw : 28|3@0+ (1,0) [0|7] ""  radar

CM_ SG_ 1650 Sync_Counter "-";
CM_ SG_ 1650 Sync_CRC "-CRC";
CM_ SG_ 1650 Sync_OVS "- Overflow of seconds";
CM_ SG_ 1650 Sync_Resd "-";
CM_ SG_ 1650 Sync_SGW "-";
CM_ SG_ 1650 Sync_SyncTime "-";
CM_ SG_ 1650 Sync_TimeDomain "-";
CM_ SG_ 1650 Sync_Type "-";
CM_ SG_ 1651 TurnLeft ":TurnLight   ";
BA_DEF_ BO_  "GenMsgCycleTime" INT 0 65535;
BA_DEF_ BO_  "GenMsgSendType" ENUM  "Cycle";
BA_DEF_ BO_  "VFrameFormat" ENUM  "StandardCAN","ExtendedCAN","reserved","reserved","reserved","reserved","reserved","reserved","reserved","reserved","reserved","reserved","reserved","reserved","StandardCAN_FD","ExtendedCAN_FD";
BA_DEF_ SG_  "GenSigILSupport" ENUM  "No","Yes";
BA_DEF_ SG_  "GenSigSendType" ENUM  "Cyclic","OnWrite","OnWriteWithRepetition","OnChange","OnChangeWithRepetition","IfActive","IfActiveWithRepetition","NoSigSendType";
BA_DEF_ SG_  "GenSigStartValue" FLOAT 0 100000000000;
BA_DEF_  "BusType" STRING ;
BA_DEF_DEF_  "GenMsgCycleTime" 0;
BA_DEF_DEF_  "GenMsgSendType" "";
BA_DEF_DEF_  "VFrameFormat" "";
BA_DEF_DEF_  "GenSigILSupport" "Yes";
BA_DEF_DEF_  "GenSigSendType" "NoSigSendType";
BA_DEF_DEF_  "GenSigStartValue" 0;
BA_DEF_DEF_  "BusType" "";
BA_ "BusType" "CAN FD";
BA_ "GenMsgCycleTime" BO_ 1649 20;
BA_ "GenMsgSendType" BO_ 1649 0;
BA_ "VFrameFormat" BO_ 1649 14;
BA_ "GenMsgCycleTime" BO_ 1650 500;
BA_ "GenMsgSendType" BO_ 1650 0;
BA_ "VFrameFormat" BO_ 1650 14;
BA_ "GenMsgCycleTime" BO_ 1651 100;
BA_ "GenMsgSendType" BO_ 1651 0;
BA_ "VFrameFormat" BO_ 1651 14;
BA_ "GenSigStartValue" SG_ 1649 YawRate 2048;
BA_ "GenSigStartValue" SG_ 1649 ANGLE 32768;
BA_ "GenSigStartValue" SG_ 1649 egoAccLgt 2047;
BA_ "GenSigStartValue" SG_ 1649 egoAccLat 2047;
BA_ "GenSigStartValue" SG_ 1649 StrgWhlAngGrd 2048;
VAL_ 1649 STATE 0 "_STATE_Invalid " 1 "_STATE_P" 2 "_STATE_N " 3 "_STATE_R" 4 "_STATE_D" ;
VAL_ 1649 YawRateV 0 "_YawRateV_invalid" 1 "_YawRateV_valid" ;
VAL_ 1649 V_SpeedV 0 "_V_SpeedV_invalid" 1 "_V_SpeedV_valid" ;
VAL_ 1649 ANGLE_V 0 "_ANGLE_V_invalid" 1 "_ANGLE_V_valid" ;
VAL_ 1649 STATE_V 0 "_STATE_V_invalid" 1 "_STATE_V_valid" ;
VAL_ 1649 WhlSpdFLV 0 "_WhlSpdFLV_invalid" 1 "_WhlSpdFLV_valid" ;
VAL_ 1649 WhlSpdRLV 0 "_WhlSpdRLV_invalid" 1 "_WhlSpdRLV_valid" ;
VAL_ 1649 WhlSpdFRV 0 "_WhlSpdFRV_invalid" 1 "_WhlSpdFRV_valid" ;
VAL_ 1649 WhlSpdRRV 0 "_WhlSpdRRV_invalid" 1 "_WhlSpdRRV_valid" ;
VAL_ 1649 StrgWhlAngGrdV 0 "_StrgWhlAngGrdV_invalid" 1 "_StrgWhlAngGrdV_valid" ;
VAL_ 1649 egoAccLgtV 0 "_egoAccLgtV_invalid" 1 "_egoAccLgtV_valid" ;
VAL_ 1649 egoAccLatV 0 "_egoAccLatV_invalid" 1 "_egoAccLatV_valid" ;
VAL_ 1650 Sync_Type 16 "_Sync_Type_SYNC" 24 "_Sync_Type_FollowUp" ;
VAL_ 1651 BCM_RLDoorOpenSt 0 "BodyInfo_BCM_RLDoorOpenSt_close" 1 "BodyInfo_BCM_RLDoorOpenSt_open" 2 "BodyInfo_BCM_RLDoorOpenSt_reserved" ;
VAL_ 1651 BCM_RRDoorOpenSt 0 "_BCM_RRDoorOpenSt_close" 1 "_BCM_RRDoorOpenSt_open" 2 "_BCM_RRDoorOpenSt_reserved" ;
VAL_ 1651 BCM_FRDoorOpenSt 0 "_BCM_FRDoorOpenSt_close" 1 "_BCM_FRDoorOpenSt_open" 2 "_BCM_FRDoorOpenSt_reserved" ;
VAL_ 1651 BCM_FLDoorOpenSt 0 "_BCM_FLDoorOpenSt_close" 1 "_BCM_FLDoorOpenSt_open" 2 "_BCM_FLDoorOpenSt_reserved" ;
VAL_ 1651 Trunk_cover 0 "_Trunk_cover_close" 1 "_Trunk_cover_open" ;
VAL_ 1651 Engine_hood 0 "_Engine_hood_close" 1 "_Engine_hood_open" ;
VAL_ 1651 TurnLeft 0 "_TurnLeft_close" 1 "_TurnLeft_open" ;
VAL_ 1651 TurnRight 0 "_TurnRight_close" 1 "_TurnRight_open" ;
VAL_ 1651 TurnSignalLever 0 "_TurnSignalLever_close" 1 "_TurnSignalLever_TurnLeftLight" 2 "_TurnSignalLever_TurnLeftHeavy" 3 "_TurnSignalLever_TurnRightLight" 4 "_TurnSignalLever_TurnRightHeavy" ;
VAL_ 1651 PowerSupply 0 "_PowerSupply_OFF" 1 "_PowerSupply_ACC" 2 "_PowerSupply_Run" 3 "_PowerSupply_Crank" ;
VAL_ 1651 FuncMode 0 "_FuncMode_FactoryMode" 1 "_FuncMode_TransMode" 2 "_FuncMode_ShowRoomMode" 3 "_FuncMode_DiagMode" 4 "_FuncMode_EOLMode" 5 "_FuncMode_NormalMode" 6 "_FuncMode_Reserved" ;
VAL_ 1651 VehUsgMd 0 "_VehUsgMd_Reservd" 1 "_VehUsgMd_OFF" 2 "_VehUsgMd_ON" 4 "_VehUsgMd_NormalDriving" 5 "_VehUsgMd_AutomatedDriving" 6 "_VehUsgMd_Reserve1" 7 "_VehUsgMd_Reserve2" ;
VAL_ 1651 FrtWprSw 0 "_FrtWprSw_ Unknown" 1 "_FrtWprSw_ Off" 2 "_FrtWprSw_ Auto" 3 "_FrtWprSw_ Slow" 4 "_FrtWprSw_ Fast" 5 "_FrtWprSw_ ImmediateWash" 6 "_FrtWprSw_ Error" 7 "_FrtWprSw_ Intermittent" ;
